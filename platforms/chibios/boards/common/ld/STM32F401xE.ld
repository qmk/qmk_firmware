/*
 * Copyright 2006..2018 Giovanni Di Sirio
 * Copyright 2022 QMK contributors
 * SPDX-License-Identifier: GPL-2.0-or-later
 */

f4xx_flash_size = 512k;
f4xx_ram1_size = 96k;
f4xx_ram2_size = 0;
f4xx_ram4_size = 0;
f4xx_ram5_size = 0;

INCLUDE stm32f4xx_common.ld
