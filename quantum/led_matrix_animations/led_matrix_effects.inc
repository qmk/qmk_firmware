// Add your new core led matrix effect here, order determins enum order, requires "led_matrix_animations/ directory
#include "led_matrix_animations/solid_anim.h"
#include "led_matrix_animations/alpha_mods_anim.h"
#include "led_matrix_animations/breathing_anim.h"
#include "led_matrix_animations/band_anim.h"
#include "led_matrix_animations/band_pinwheel_anim.h"
#include "led_matrix_animations/band_spiral_anim.h"
#include "led_matrix_animations/cycle_left_right_anim.h"
#include "led_matrix_animations/cycle_up_down_anim.h"
#include "led_matrix_animations/cycle_out_in_anim.h"
#include "led_matrix_animations/dual_beacon_anim.h"
#include "led_matrix_animations/solid_reactive_simple_anim.h"
#include "led_matrix_animations/solid_reactive_wide.h"
#include "led_matrix_animations/solid_reactive_cross.h"
#include "led_matrix_animations/solid_reactive_nexus.h"
#include "led_matrix_animations/solid_splash_anim.h"
#include "led_matrix_animations/wave_left_right_anim.h"
#include "led_matrix_animations/wave_up_down_anim.h"
