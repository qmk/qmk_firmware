// Add your new core rgb matrix effect here, order determines enum order
#include "solid_color_anim.h"
#include "alpha_mods_anim.h"
#include "gradient_up_down_anim.h"
#include "gradient_left_right_anim.h"
#include "breathing_anim.h"
#include "colorband_sat_anim.h"
#include "colorband_val_anim.h"
#include "colorband_pinwheel_sat_anim.h"
#include "colorband_pinwheel_val_anim.h"
#include "colorband_spiral_sat_anim.h"
#include "colorband_spiral_val_anim.h"
#include "cycle_all_anim.h"
#include "cycle_left_right_anim.h"
#include "cycle_up_down_anim.h"
#include "rainbow_moving_chevron_anim.h"
#include "cycle_out_in_anim.h"
#include "cycle_out_in_dual_anim.h"
#include "cycle_pinwheel_anim.h"
#include "cycle_spiral_anim.h"
#include "dual_beacon_anim.h"
#include "rainbow_beacon_anim.h"
#include "rainbow_pinwheels_anim.h"
#include "flower_blooming_anim.h"
#include "raindrops_anim.h"
#include "jellybean_raindrops_anim.h"
#include "hue_breathing_anim.h"
#include "hue_pendulum_anim.h"
#include "hue_wave_anim.h"
#include "pixel_rain_anim.h"
#include "pixel_flow_anim.h"
#include "pixel_fractal_anim.h"
#include "typing_heatmap_anim.h"
#include "digital_rain_anim.h"
#include "solid_reactive_simple_anim.h"
#include "solid_reactive_anim.h"
#include "solid_reactive_wide.h"
#include "solid_reactive_cross.h"
#include "solid_reactive_nexus.h"
#include "splash_anim.h"
#include "solid_splash_anim.h"
#include "starlight_anim.h"
#include "starlight_dual_sat_anim.h"
#include "starlight_dual_hue_anim.h"
#include "riverflow_anim.h"