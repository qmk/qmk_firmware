/* Copyright 2023 str studio
 *
 * This program is free software: you can redistribute it and/or modify
 * it under the terms of the GNU General Public License as published by
 * the Free Software Foundation, either version 2 of the License, or
 * (at your option) any later version.
 *
 * This program is distributed in the hope that it will be useful,
 * but WITHOUT ANY WARRANTY; without even the implied warranty of
 * MERCHANTABILITY or FITNESS FOR A PARTICULAR PURPOSE.  See the
 * GNU General Public License for more details.
 *
 * You should have received a copy of the GNU General Public License
 * along with this program.  If not, see <http://www.gnu.org/licenses/>.
 */

#ifdef OLED_ENABLE

// static void print_status_narrow(void) {
//     // Print current mode
//     // oled_write_P(PSTR("\n\n"), false);
//     // oled_write_ln_P(PSTR("MODE"), false);
//     // oled_write_ln_P(PSTR(""), false);
//     if (keymap_config.swap_lctl_lgui) {
//         oled_write_ln_P(PSTR("MAC"), false);
//     } else {
//         oled_write_ln_P(PSTR("WIN"), false);
//     }

//     switch (get_highest_layer(default_layer_state)) {
//         case 0: //_NUMBER
//             oled_write_ln_P(PSTR("num"), false);
//             break;
//         case 1: //_LOWER
//             oled_write_ln_P(PSTR("mod"), false);
//             break;
//         default:
//             oled_write_P(PSTR("ukn"), false);
//     }
//     // oled_write_P(PSTR("\n\n"), false);
//     // Print current layer
//     // oled_write_ln_P(PSTR("LAYER"), false);
//     switch (get_highest_layer(layer_state)) {
//         // case _COLEMAK:
//         case 0: //_NUMBER
//             oled_write_P(PSTR("Base\n"), false);
//             break;
//         case 1: //_LOWER
//             oled_write_P(PSTR("Lower"), false);
//             break;
//         default:
//             oled_write_ln_P(PSTR("nkn"), false);
//     }
//     // oled_write_P(PSTR("\n\n"), false);
//     // led_t led_usb_state = host_keyboard_led_state();
//     // oled_write_ln_P(PSTR("CPSLK"), led_usb_state.caps_lock);
// }


/* KEYBOARD PET START */

/* settings */
#    define MIN_WALK_SPEED      10
#    define MIN_RUN_SPEED       40

/* advanced settings */
#    define ANIM_FRAME_DURATION 200  // how long each frame lasts in ms
#    define ANIM_SIZE           96   // number of bytes in array. If you change sprites, minimize for adequate firmware size. max is 1024

/* timers */
uint32_t anim_timer = 0;

/* current frame */
uint8_t current_frame = 0;

/* status variables */
int   current_wpm = 0;
led_t led_usb_state;

bool isSneaking = false;
bool isJumping  = false;
bool showedJump = true;

/* logic */
static void render_luna(int LUNA_X, int LUNA_Y) {
    /* Sit */
    static const char PROGMEM sit[2][ANIM_SIZE] = {/* 'sit1', 32x22px */
                                                   {
                                                       0x00, 0x00, 0x00, 0x00, 0x00, 0x00, 0x00, 0x00, 0x00, 0x00, 0x00, 0x00,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 0x00,
                                                   },

                                                   /* 'sit2', 32x22px */
                                                   {0x00, 0x00, 0x00, 0x00, 0x00, 0x00, 0x00, 0x00, 0x00, 0x00, 0x00, 0x00, 0x00,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 0x00, 0x00}};

    /* Walk */
    static const char PROGMEM walk[2][ANIM_SIZE] = {/* 'walk1', 32x22px */
                                                    {
                                                        0x00, 0x00, 0x00, 0x00, 0x00, 0x80, 0x40, 0x20, 0x10, 0x90, 0x90, 0x90, 0xa0,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 0x00,
                                                    },

                                                    /* 'walk2', 32x22px */
                                                    {
                                                        0x00, 0x00, 0x00, 0x00, 0x00, 0x00, 0x80, 0x40, 0x20, 0x20, 0x20, 0x40, 0x80,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 0x00,
                                                    }};

    /* Run */
    static const char PROGMEM run[2][ANIM_SIZE] = {/* 'run1', 32x22px */
                                                   {
                                                       0x00, 0x00, 0x00, 0x00, 0xe0, 0x10, 0x08, 0x08, 0xc8, 0xb0, 0x80, 0x80,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 0x00,
                                                   },

                                                   /* 'run2', 32x22px */
                                                   {
                                                       0x00, 0x00, 0x00, 0xe0, 0x10, 0x10, 0xf0, 0x00, 0x00, 0x00, 0x00, 0x00,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 0x00,
                                                   }};

    /* Bark */
    static const char PROGMEM bark[2][ANIM_SIZE] = {/* 'bark1', 32x22px */
                                                    {
                                                        0x00, 0xc0, 0x20, 0x10, 0xd0, 0x30, 0x00, 0x00, 0x00, 0x00, 0x00, 0x00, 0x00,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 0x00,
                                                    },

                                                    /* 'bark2', 32x22px */
                                                    {
                                                        0x00, 0xe0, 0x10, 0x10, 0xf0, 0x00, 0x00, 0x00, 0x00, 0x00, 0x00, 0x00, 0x00,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 0x00,
                                                    }};

    /* Sneak */
    static const char PROGMEM sneak[2][ANIM_SIZE] = {/* 'sneak1', 32x22px */
                                                     {
                                                         0x00, 0x00, 0x00, 0x00, 0x00, 0x00, 0x80, 0x40, 0x40, 0x40, 0x40, 0x80, 0x00,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 0x00,
                                                     },

                                                     /* 'sneak2', 32x22px */
                                                     {
                                                         0x00, 0x00, 0x00, 0x00, 0x00, 0x00, 0x80, 0x40, 0x40, 0x40, 0x80, 0x00, 0x00,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 0x00,
                                                     }};

    /* animation */
    void animate_luna(void) {
        /* jump */
        if (isJumping || !showedJump) {
            /* clear */
            oled_set_cursor(LUNA_X, LUNA_Y + 2);
            oled_write("     ", false);

            oled_set_cursor(LUNA_X, LUNA_Y - 1);

            showedJump = true;
        } else {
            /* clear */
            oled_set_cursor(LUNA_X, LUNA_Y - 1);
            oled_write("     ", false);

            oled_set_cursor(LUNA_X, LUNA_Y);
        }

        /* switch frame */
        current_frame = (current_frame + 1) % 2;

        /* current status */
        if (led_usb_state.caps_lock) {
            oled_write_raw_P(bark[current_frame], ANIM_SIZE);

        } else if (isSneaking) {
            oled_write_raw_P(sneak[current_frame], ANIM_SIZE);

        } else if (current_wpm <= MIN_WALK_SPEED) {
            oled_write_raw_P(sit[current_frame], ANIM_SIZE);

        } else if (current_wpm <= MIN_RUN_SPEED) {
            oled_write_raw_P(walk[current_frame], ANIM_SIZE);

        } else {
            oled_write_raw_P(run[current_frame], ANIM_SIZE);
        }
    }

#    if OLED_TIMEOUT > 0
    /* the animation prevents the normal timeout from occuring */
    if (last_input_activity_elapsed() > OLED_TIMEOUT && last_led_activity_elapsed() > OLED_TIMEOUT) {
        oled_off();
        return;
    } else {
        oled_on();
    }
#    endif

    /* animation timer */
    if (timer_elapsed32(anim_timer) > ANIM_FRAME_DURATION) {
        anim_timer = timer_read32();
        animate_luna();
    }
}

/* KEYBOARD PET END */


static void print_status_narrow(void) {

    /* Print current mode */
    oled_set_cursor(0, 0);
    // if (keymap_config.swap_lctl_lgui) {
    //     oled_write_raw_P(mac_logo, sizeof(mac_logo));
    // } else {
    //     oled_write_raw_P(windows_logo, sizeof(windows_logo));
    // }

    // oled_set_cursor(0, 3);

    // switch (get_highest_layer(default_layer_state)) {
    //     case _QWERTY:
    //         oled_write("QWRTY", false);
    //         break;
    //     case _GAMING:
    //         oled_write("GAMES", false);
    //         break;
    //     default:
    //         oled_write("UNDEF", false);
    // }

    // oled_set_cursor(0, 5);

    // /* Print current layer */
    // oled_write("LAYER", false);

    // oled_set_cursor(0, 6);

    // switch (get_highest_layer(layer_state)) {
    //     case _QWERTY:
    //         oled_write("Base ", false);
    //         break;
    //     case _GAMING:
    //         oled_write("Games", false);
    //         break;
    //     case _RAISE:
    //         oled_write("Raise", false);
    //         break;
    //     case _LOWER:
    //         oled_write("Lower", false);
    //         break;
    //     case _ADJUST:
    //         oled_write("Adj  ", false);
    //         break;
    //     default:
    //         oled_write("Undef", false);
    // }

    // /* caps lock */
    // oled_set_cursor(0, 8);
    // oled_write("CPSLK", led_usb_state.caps_lock);

    /* KEYBOARD PET RENDER START */

    // render_luna(0, 13);
    render_luna(0, 0);

    // led_t led_usb_state = host_keyboard_led_state();
    // oled_write_ln_P(PSTR("NUMLCK"), led_usb_state.num_lock);

    /* KEYBOARD PET RENDER END */
    /* wpm counter */
    uint8_t n = get_current_wpm();
    char    wpm_str[4];
    oled_set_cursor(0, 14);
    wpm_str[3] = '\0';
    wpm_str[2] = '0' + n % 10;
    wpm_str[1] = '0' + (n /= 10) % 10;
    wpm_str[0] = '0' + n / 10;
    oled_write(wpm_str, false);

    oled_set_cursor(0, 15);
    oled_write(" wpm", false);
}

oled_rotation_t oled_init_user(oled_rotation_t rotation) {
    /* KEYBOARD PET VARIABLES START */

    current_wpm   = get_current_wpm();
    // led_usb_state = host_keyboard_led_state();

    /* KEYBOARD PET VARIABLES END */

    if (is_keyboard_master()) {
        return OLED_ROTATION_270;
    }
    return rotation;
}

bool oled_task_user(void) {
    print_status_narrow();
    
    return false;
}

#endif