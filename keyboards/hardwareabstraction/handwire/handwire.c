// Copyright 2022 Andy Tsai (@atsai)
// SPDX-License-Identifier: GPL-2.0-or-later

#include "quantum.h"

static uint16_t buzzer_timer = 0;
static uint8_t buzzer_dwell = 15;
static uint8_t buzzer_dwell_change = 1;
static bool buzzer_on = false;
static bool buzzer_active = false;

static bool initial_keypress = false;

enum custom_keycodes{
    KC_HPTON = QK_KB_0,
    KC_HPTOFF,
    KC_HPTTOG,
    KC_HPTRST,
    KC_HPTFBK,
    KC_HPTCONT,
    KC_HPTDWLI,
    KC_HPTDWLD,
    KC_BZTOG,
    KC_BZRST,
    KC_BZDWLI,
    KC_BZDWLD
};

// Documentation: custom_quantum_functions.md
void keyboard_post_init_kb(void){
    gpio_set_pin_output(BUZZER_PIN);
    keyboard_post_init_user();
}

void housekeeping_task_kb(void){
    if(buzzer_on){
        if(buzzer_active && timer_elapsed(buzzer_timer) > buzzer_dwell){
        buzzer_active = false;
        gpio_write_pin_low(BUZZER_PIN);
        }
    }
}

bool process_record_kb(uint16_t keycode, keyrecord_t *record) {
    if (record->event.pressed){                         // true when pressed, false when released
        initial_keypress = true;

        if(buzzer_on){
            if(!buzzer_active){
                buzzer_active = true;
                buzzer_timer = timer_read();
                gpio_write_pin_high(BUZZER_PIN);
            }
        }

        switch (keycode) {
            #ifdef HAPTIC_ENABLE
            case KC_HPTON:
                haptic_enable();
                break;

            case KC_HPTOFF:
                haptic_disable();
                break;

            case KC_HPTTOG:
                haptic_toggle();
                break;

            case KC_HPTRST:
                haptic_reset();
                break;

            case KC_HPTFBK:
                haptic_feedback_toggle();
                break;

            case KC_HPTCONT:
                haptic_toggle_continuous();
                break;

            case KC_HPTDWLI:
                haptic_dwell_increase();
                break;

            case KC_HPTDWLD:
                haptic_dwell_decrease();
                break;
            #endif

            case KC_BZTOG:
                buzzer_on = !buzzer_on;
                if(buzzer_on == true){
                    buzzer_active = true;
                    buzzer_timer = timer_read();
                    gpio_write_pin_high(BUZZER_PIN);
                }
                else{
                    gpio_write_pin_low(BUZZER_PIN);
                }
                break;

            case KC_BZRST:
                buzzer_dwell = 12;
                break;

            case KC_BZDWLI:
                buzzer_dwell += buzzer_dwell_change;
                break;

            case KC_BZDWLD:
                if(buzzer_dwell - buzzer_dwell_change > 1){
                    buzzer_dwell -= buzzer_dwell_change;
                }
                break;
        }
    }
    return process_record_user(keycode, record);
}

#ifdef OLED_ENABLE
#define IDLE_FRAMES 5
#define IDLE_SPEED 20   // Idle WPM

// #define PREP_FRAMES 1

#define TAP_FRAMES 2
#define TAP_SPEED 40    // Move Bongo Cat WPM

#define ANIM_FRAME_DURATION 200  // How long each frame lasts in ms
#define ANIM_SIZE 550  // Number of bytes in array, minimize for adequate firmware size, max is 1024

// Variables for display layer and haptic status on OLED
static uint8_t layer = 0;
extern haptic_config_t haptic_config;

// Variables for frames, timer, and sleep
uint32_t anim_timer         = 0;
uint32_t anim_sleep         = 0;
uint8_t  current_idle_frame = 0;
// uint8_t  current_prep_frame = 0;
uint8_t current_tap_frame   = 0;

// 5 idle frames, 1 prep frame, and 2 tap frames

static const char PROGMEM startup_screen[] = {
	0x00, 0x00, 0x00, 0x00, 0x00, 0x00, 0x00, 0x00, 0x00, 0x00, 0x00, 0x00, 0x00, 0x00, 0x00, 0x00,
	0x00, 0x00, 0x00, 0x00, 0x00, 0x00, 0x00, 0x00, 0x00, 0x00, 0x00, 0x00, 0x00, 0x00, 0x00, 0x00,
	0x00, 0x00, 0x00, 0x00, 0x00, 0x00, 0x00, 0x00, 0x00, 0x00, 0x00, 0x00, 0x00, 0x00, 0x00, 0x00,
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	0x00, 0x00, 0x00, 0x00, 0x00, 0x00, 0x00, 0x00, 0x00, 0x00, 0x00, 0x00, 0x00, 0x00, 0x00, 0x00
};

static void render_anim(void) {
    static const char PROGMEM idle[IDLE_FRAMES][ANIM_SIZE] = {{0x00, 0x00, 0x00, 0x00, 0x00, 0x00, 0x00, 0x00, 0x00, 0x00, 0x00, 0x00, 0x00,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 0x00,
                                                               0x00, 0x00, 0x00, 0x00, 0x00, 0x00, 0x00, 0x00, 0x00, 0x00, 0x00, 0x00, 0x00,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 0x01,
                                                               0x00, 0x00, 0x00, 0x00, 0x00, 0x00, 0x00, 0x00, 0x00, 0x00, 0x00, 0x00, 0x00,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 0x00,
                                                               0x00, 0x00, 0x00, 0x00, 0x00, 0x00, 0x00, 0x00, 0x00, 0x00, 0x00, 0x00, 0x00,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 0x00, 0x00},
                                                              {0x00, 0x00, 0x00, 0x00, 0x00, 0x00, 0x00, 0x00, 0x00, 0x00, 0x00, 0x00, 0x00,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 0x00,
                                                               0x00, 0x00, 0x00, 0x00, 0x00, 0x00, 0x00, 0x00, 0x00, 0x00, 0x00, 0x00, 0x00,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 0x01,
                                                               0x00, 0x00, 0x00, 0x00, 0x00, 0x00, 0x00, 0x00, 0x00, 0x00, 0x00, 0x00, 0x00,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 0x00,
                                                               0x00, 0x00, 0x00, 0x00, 0x00, 0x00, 0x00, 0x00, 0x00, 0x00, 0x00, 0x00, 0x00,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 0x00, 0x00},
                                                              {0x00, 0x00, 0x00, 0x00, 0x00, 0x00, 0x00, 0x00, 0x00, 0x00, 0x00, 0x00, 0x00,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 0x00,
                                                               0x00, 0x00, 0x00, 0x00, 0x00, 0x00, 0x00, 0x00, 0x00, 0x00, 0x00, 0x00, 0x00,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 0x01,
                                                               0x00, 0x00, 0x00, 0x00, 0x00, 0x00, 0x00, 0x00, 0x00, 0x00, 0x00, 0x00, 0x00,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 0x00,
                                                               0x00, 0x00, 0x00, 0x00, 0x00, 0x00, 0x00, 0x00, 0x00, 0x00, 0x00, 0x00, 0x00,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 0x00, 0x00},
                                                              {0x00, 0x00, 0x00, 0x00, 0x00, 0x00, 0x00, 0x00, 0x00, 0x00, 0x00, 0x00, 0x00,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 0x00,
                                                               0x00, 0x00, 0x00, 0x00, 0x00, 0x00, 0x00, 0x00, 0x00, 0x00, 0x00, 0x00, 0x00,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 0x01,
                                                               0x00, 0x00, 0x00, 0x00, 0x00, 0x00, 0x00, 0x00, 0x00, 0x00, 0x00, 0x00, 0x00,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 0x00,
                                                               0x00, 0x00, 0x00, 0x00, 0x00, 0x00, 0x00, 0x00, 0x00, 0x00, 0x00, 0x00, 0x00,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 0x00, 0x00},
                                                              {0x00, 0x00, 0x00, 0x00, 0x00, 0x00, 0x00, 0x00, 0x00, 0x00, 0x00, 0x00, 0x00,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 0x00,
                                                               0x00, 0x00, 0x00, 0x00, 0x00, 0x00, 0x00, 0x00, 0x00, 0x00, 0x00, 0x00, 0x00,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 0x01,
                                                               0x00, 0x00, 0x00, 0x00, 0x00, 0x00, 0x00, 0x00, 0x00, 0x00, 0x00, 0x00, 0x00,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 0x00,
                                                               0x00, 0x00, 0x00, 0x00, 0x00, 0x00, 0x00, 0x00, 0x00, 0x00, 0x00, 0x00, 0x00,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 0x00, 0x00}};
    static const char PROGMEM prep[][ANIM_SIZE]            = {{0x00, 0x00, 0x00, 0x00, 0x00, 0x00, 0x00, 0x00, 0x00, 0x00, 0x00, 0x00, 0x00,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 0x00,
                                                               0x00, 0x00, 0x00, 0x00, 0x00, 0x00, 0x00, 0x00, 0x00, 0x00, 0x00, 0x00, 0x00,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 0x01,
                                                               0x00, 0x00, 0x00, 0x00, 0x00, 0x00, 0x00, 0x00, 0x00, 0x00, 0x00, 0x00, 0x00,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 0x00,
                                                               0x00, 0x00, 0x00, 0x00, 0x00, 0x00, 0x00, 0x00, 0x00, 0x00, 0x00, 0x00, 0x00,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 0x00, 0x00}};
    static const char PROGMEM tap[TAP_FRAMES][ANIM_SIZE]   = {
        {0x00, 0x00, 0x00, 0x00, 0x00, 0x00, 0x00, 0x00, 0x00, 0x00, 0x00, 0x00, 0x00,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 0x00,
         0x00, 0x00, 0x00, 0x00, 0x00, 0x00, 0x00, 0x00, 0x00, 0x00, 0x00, 0x00,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 0x01,
         0x00, 0x00, 0x00, 0x00, 0x00, 0x00, 0x00, 0x00, 0x00, 0x00, 0x00, 0x00,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 0x00,
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         0x00, 0x00, 0x00, 0x00, 0x00, 0x00, 0x00, 0x00, 0x00, 0x00, 0x00, 0x00,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 0x00, 0x00},
    };

    void animation_phase(void) {
        if (get_current_wpm() <= IDLE_SPEED) {          // Idle edge case
            current_idle_frame = (current_idle_frame + 1) % IDLE_FRAMES;
            oled_write_raw_P(idle[abs((IDLE_FRAMES - 1) - current_idle_frame)], ANIM_SIZE);
        }
        else if (get_current_wpm() > IDLE_SPEED && get_current_wpm() < TAP_SPEED) {     // Prep frame
            // oled_write_raw_P(prep[abs((PREP_FRAMES-1)-current_prep_frame)], ANIM_SIZE); // uncomment if IDLE_FRAMES >1
            oled_write_raw_P(prep[0], ANIM_SIZE);  // remove if IDLE_FRAMES >1
        }
        else if (get_current_wpm() >= TAP_SPEED) {
            current_tap_frame = (current_tap_frame + 1) % TAP_FRAMES;
            oled_write_raw_P(tap[abs((TAP_FRAMES - 1) - current_tap_frame)], ANIM_SIZE);
        }
    }

    if (get_current_wpm() != 000){       // Check for typing
        oled_on();
        if (timer_elapsed32(anim_timer) > ANIM_FRAME_DURATION) {
            anim_timer = timer_read32();
            animation_phase();
        }
        anim_sleep = timer_read32();
    }
    else
    {
        if (timer_elapsed32(anim_sleep) > OLED_TIMEOUT){         // Check timer for OLED timeout
            oled_off();
        } else {
            if (timer_elapsed32(anim_timer) > ANIM_FRAME_DURATION) {
                anim_timer = timer_read32();
                animation_phase();
            }
        }
    }
}

// Used to display current layer number on OLED
layer_state_t layer_state_set_kb(layer_state_t state){
    layer = get_highest_layer(state);
    return layer_state_set_user(state);
}

// Initialize code to rotate the OLED 180 degrees
oled_rotation_t oled_init_kb(oled_rotation_t rotation) {    // _user handled by default
    return OLED_ROTATION_180;  // Flip for headers on right side
}

// OLED Task
bool oled_task_kb(void) {
    if (!oled_task_user()) { return false; }              // Process _user OLED instead of _kb
    // Host Keyboard Layer Status
    if(initial_keypress){
        render_anim();                                    // Render the animation phases

        // Display WPM
        oled_set_cursor(0, 0);                            // Sets cursor to (column, row) using charactar spacing (5 rows on 128x32 screen, anything more will overflow back to the top)
        oled_write_P(PSTR("WPM:"), false);
        oled_write(get_u8_str(get_current_wpm(), '0'), false);

        // Display Current Layer
        oled_set_cursor(16, 0);
        oled_write_P(PSTR("L:"), false);
        oled_write(get_u8_str(layer, ' '), false);

        // Display Buzzer State
        oled_set_cursor(0, 1);
        if(buzzer_on == true){
            oled_write("BZ:ON", false);
        } else{
            oled_write("BZ:OFF", false);
        }

        // Display Haptic State
        oled_set_cursor(0, 2);
        if(haptic_config.enable == true){
            oled_write("HP:ON", false);
        } else{
            oled_write("HP:OFF", false);
        }
    }
    else{
        oled_write_raw_P(startup_screen, sizeof(startup_screen));
    }
    return false;
}
#endif
