/*
 * Copyright 2023 Norbert Pocs (norbertpocs0@gmail.com, jogme)
 * SPDX-License-Identifier: GPL-2.0-or-later
 */

#include "quantum.h"

#ifdef OLED_ENABLE
/* corresponds to the layer number in keymaps/default/keymap.c */
#define LAYER_GAME 4
oled_rotation_t oled_init_kb(oled_rotation_t rotation) {
    if (!is_keyboard_master()) {
        return OLED_ROTATION_90;
    }
    return OLED_ROTATION_270;
}

static void render_logo(void) {
    const char yeti_logo [] = {
        0x00, 0x00, 0x00, 0x00, 0x00, 0x00, 0x00, 0x00, 0x00, 0x00, 0x00, 0x00, 0x00, 0x00, 0x00, 0x00,
        0x00, 0x00, 0x00, 0x00, 0x00, 0x00, 0x00, 0x00, 0x00, 0x00, 0x00, 0x00, 0x00, 0x00, 0x00, 0x00,
        0x00, 0x00, 0x00, 0x00, 0x00, 0x00, 0x00, 0x00, 0x00, 0x00, 0x00, 0x00, 0x00, 0x00, 0x00, 0x00,
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        0x00, 0x00, 0x00, 0x00, 0x00, 0x00, 0x00, 0x00, 0x00, 0x00, 0x00, 0x00, 0x00, 0x00, 0x00, 0x00
    };

    oled_write_raw_P(yeti_logo, sizeof(yeti_logo));
}

static void oled_render_caps_lock(void) {
    led_t l = host_keyboard_led_state();
    oled_write_ln(l.caps_lock ? PSTR("Caps Lock") : PSTR(" \n"), false);
}

static void oled_render_layer_state(void) {
    switch (get_highest_layer(layer_state)) {
        case LAYER_GAME:
            oled_write_ln(PSTR("GAME"), false);
            break;
        default:
            oled_write_ln(PSTR(" \n"), false);
    }
}

static void oled_render_mods(void) {
    static uint8_t mods;
    mods = get_mods() | get_oneshot_mods();
    if (mods & MOD_MASK_SHIFT) {
        oled_write_ln(PSTR("Shft"), false);
    } else {
        oled_write_ln(PSTR(" "), false);
    }
    if (mods & MOD_MASK_CTRL) {
        oled_write_ln(PSTR("Ctrl"), false);
    } else {
        oled_write_ln(PSTR(" "), false);
    }
    if (mods & MOD_MASK_ALT) {
        oled_write_ln(PSTR("Alt"), false);
    } else {
        oled_write_ln(PSTR(" "), false);
    }
    if (mods & MOD_MASK_GUI) {
        oled_write_ln(PSTR("Win"), false);
    } else {
        oled_write_ln(PSTR(" "), false);
    }
}

bool oled_task_kb(void) {
    if (!oled_task_user()) {
        return false;
    }
    if (!is_keyboard_master()) {
        render_logo();
    } else {
        oled_write_ln(PSTR("yeti\n"), false);
        oled_render_mods();
        oled_render_caps_lock();
        oled_render_layer_state();
    }

    return false;
}
#endif
