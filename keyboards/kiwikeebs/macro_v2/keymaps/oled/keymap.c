/* Copyright 2020 KiwiKeebs
 *
 * This program is free software: you can redistribute it and/or modify
 * it under the terms of the GNU General Public License as published by
 * the Free Software Foundation, either version 2 of the License, or
 * (at your option) any later version.
 *
 * This program is distributed in the hope that it will be useful,
 * but WITHOUT ANY WARRANTY; without even the implied warranty of
 * MERCHANTABILITY or FITNESS FOR A PARTICULAR PURPOSE.  See the
 * GNU General Public License for more details.
 *
 * You should have received a copy of the GNU General Public License
 * along with this program.  If not, see <http://www.gnu.org/licenses/>.
 */
#include QMK_KEYBOARD_H
int COUNTER = 1;
char COUNTER_STR[10];
enum custom_keycodes {
    KC_CUST = SAFE_RANGE,
};
// Defines names for use in layer keycodes and the keymap
enum layer_names {
    _BASE,
    _FN
};

const uint16_t PROGMEM keymaps[][MATRIX_ROWS][MATRIX_COLS] = {
    /* Base */
    [_BASE] = LAYOUT(
        KC_DEL,  KC_HOME, LT(_FN,KC_END),
        KC_MPRV, KC_MPLY, KC_MNXT, KC_F15
    ),
    [_FN] = LAYOUT(
        RESET,    KC_UP,   _______,
        KC_LEFT, KC_DOWN, KC_RGHT, MAGIC_TOGGLE_NKRO
    )
};


 void change_tab(bool clockwise) {
     if (clockwise){
        // on keydown
            register_code(KC_LALT);
            register_code(KC_LGUI);
            register_code(KC_LEFT);
        // on keyup
            unregister_code(KC_LALT);
            unregister_code(KC_LGUI);
            unregister_code(KC_LEFT);
     }else{
        // on keydown
            register_code(KC_LALT);
            register_code(KC_LGUI);
            register_code(KC_RIGHT);
        // on keyup
            unregister_code(KC_LALT);
            unregister_code(KC_LGUI);
            unregister_code(KC_RIGHT);
            }

     }


bool encoder_update_kb(uint8_t index, bool clockwise) {


    switch(COUNTER){
        case 1:
        if (clockwise) {
            tap_code(KC_VOLD);
        } else {
            tap_code(KC_VOLU);
        }
        break;

        case 2:
        if (clockwise) {
            tap_code(KC_MPRV);
        } else {
            tap_code(KC_MNXT);
        }
        break;

        case 3:
        if (clockwise) {
            tap_code(KC_BRID);
        } else{
            tap_code(KC_BRIU);
        }
        break;

        case 4:

            change_tab(clockwise);

        break;
    }
 return true;
}

#ifdef OLED_ENABLE

 oled_rotation_t oled_init_user(oled_rotation_t rotation) { return OLED_ROTATION_0; }

    static const char PROGMEM volume_icon[] = {
    // 'Volume', 128x32px
0x00, 0x00, 0x00, 0x00, 0x00, 0x00, 0x00, 0x00, 0x00, 0x00, 0x00, 0x00, 0x00, 0x00, 0x00, 0x00,
0x00, 0x00, 0x00, 0x00, 0x00, 0x00, 0x00, 0x00, 0x00, 0x00, 0x00, 0x00, 0x00, 0x00, 0x00, 0x00,
0x00, 0x00, 0x00, 0x00, 0x00, 0x00, 0x00, 0x00, 0x00, 0x00, 0x00, 0x00, 0x00, 0x00, 0x00, 0x00,
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0x00, 0x00, 0x00, 0x00, 0x00, 0x00, 0x00, 0x00, 0x00, 0x00, 0x00, 0x00, 0x00, 0x00, 0x00, 0x00,

    };


    static const char PROGMEM music_note[] = {
    // 'Music-note' - Music Control, 128x32px
    0x00, 0x00, 0x00, 0x00, 0x00, 0x00, 0x00, 0x00, 0x00, 0x00, 0x00, 0x00, 0xc0, 0xc0, 0xc0, 0xc0,
	0xe0, 0xe0, 0xe0, 0xf0, 0xf0, 0xf0, 0x70, 0x78, 0x78, 0x78, 0x38, 0x3c, 0x3c, 0x3e, 0xfe, 0xfe,
	0x00, 0x00, 0x00, 0x00, 0x00, 0x00, 0x00, 0x00, 0x00, 0x00, 0x00, 0x00, 0x00, 0x00, 0x00, 0x00,
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	0x00, 0x00, 0x00, 0x00, 0x00, 0x00, 0x00, 0x00, 0x00, 0x00, 0x00, 0x00, 0x00, 0x00, 0x00, 0x00

    };
    static const char PROGMEM light_icon[] = {
        //"Sun Icon" - Light Control , 128x32
    0x00, 0x00, 0x00, 0x00, 0x00, 0x00, 0x60, 0xe0, 0xc0, 0x80, 0x00, 0x00, 0x00, 0x00, 0x00, 0x00,
	0xfe, 0xfe, 0x00, 0x00, 0x00, 0x00, 0x00, 0x00, 0x80, 0xc0, 0xe0, 0x60, 0x00, 0x00, 0x00, 0x00,
	0x00, 0x00, 0x00, 0x00, 0x00, 0x00, 0x00, 0x00, 0x00, 0x00, 0x00, 0x00, 0x00, 0x00, 0x00, 0x00,
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	0x00, 0x00, 0x00, 0x00, 0x00, 0x00, 0x00, 0x00, 0x00, 0x00, 0x00, 0x00, 0x00, 0x00, 0x00, 0x00
        };
    static const char PROGMEM tab_icon[] = {
    //"Tab Icon", Tab Control 128x32
    0x00, 0x00, 0xf0, 0xf8, 0x38, 0x98, 0xd8, 0xc8, 0xc8, 0x48, 0x48, 0x48, 0x48, 0x48, 0x48, 0x48,
	0x48, 0x48, 0x48, 0x48, 0x48, 0x48, 0x48, 0x48, 0x40, 0x40, 0x40, 0x00, 0x00, 0x00, 0x00, 0x00,
	0x00, 0x00, 0x00, 0x00, 0x00, 0x00, 0x00, 0x00, 0x00, 0x00, 0x00, 0x00, 0x00, 0x00, 0x00, 0x00,
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	0x00, 0x00, 0x00, 0x00, 0x00, 0x00, 0x00, 0x00, 0x00, 0x00, 0x00, 0x00, 0x00, 0x00, 0x00, 0x00
    };

  bool oled_task_user(void) {
      oled_on();
      return true;
 }

bool process_record_user(uint16_t keycode, keyrecord_t *record) {
    // Send keystrokes to host keyboard, if connected (see readme)
     if (keycode == KC_F16 && record->event.pressed) {
                    if(COUNTER > 3){
                        COUNTER = 1;
                     }
                    else{
                        COUNTER = COUNTER+1;
                    }
     }
        switch(COUNTER){
            case 1:
            oled_write_raw_P(volume_icon,sizeof(volume_icon));
            break;

            case 2:
            oled_write_raw_P(music_note,sizeof(music_note));
            break;

            case 3:
            oled_write_raw_P(light_icon,sizeof(light_icon));
            break;

            case 4:
            oled_write_raw_P(tab_icon,sizeof(tab_icon));
            break;
        }

     if (keycode == KC_F15 && record->event.pressed  && COUNTER == 2) {
            tap_code(KC_MPLY);
            }

       return true;
    }

#endif
