#include QMK_KEYBOARD_H
#include "keycodes.h"


const uint16_t PROGMEM keymaps[][MATRIX_ROWS][MATRIX_COLS] = {

    /* Keymap: BASE
     *
     * ,----------------------------------------------------                                ------------------------------------------------------------.
     * |  Esc   |   1   |  2   |   3  |  4   |  5   |   6  |                                |   7  |  8   |  9   |  0   |  -   |  =   |  \     |   `    |
     * |--------+-------+------+------+------+------+------+   ,-------+-------+-------.    +------+------+------+------+------+------+--------+--------|
     * |  Tab   |   Q   |  W   |  E   |  R   |  T   |          | Pad_7 | Pad_8 | Pad_9 |           |  Y   |  U   |  I   |  O   |  P   |   [    |  ]     |
     * |--------+-------+------+------+------+------+          +-------+-------+-------+           +------+------+------+------+------+--------+--------|
     * | CapsL  |   A   |  S   |  D   |  F   |  G   |          | Pad_4 | Pad_5 | Pad_6 |           |  H   |  J   |  K   |  L   |  ;   |   '    |        |
     * |--------+-------+------+------+------+------+          +-------+-------+-------+           +------+------+------+------+------+--------+ Enter  |
     * | LShift |   Z   |  X   |  C   |  V   |  B   |          | Pad_1 | Pad_2 | Pad_3 |           |  N   |  M   |  ,   |  .   |  /   | RShift |        |
     * |--------+-------+------+------+------+------+------+   +-------+-------+-------+    +------+------+------+------+------+------+--------+--------|
     * | LCtrl  |  GUI  | LAlt | RAlt |  Del |      | L_LFT|   |KC_NLCK| Pad_0 |KC_PDOT|    | L_RGT|      | Space|      | TO_FN|               | _TOOLS  |
     * `-------------------------------------'      `------'   `-----------------------'    `------'      `------'      `------'               `--------'
     *
     */

    [_BASE] = LAYOUT_Pallas( \
        KC_ESC ,    KC_1,    KC_2,    KC_3,    KC_4,    KC_5,    KC_6,                                      KC_7,    KC_8,    KC_9,    KC_0, KC_MINS,  KC_EQL, KC_BSLS,  KC_GRV , \
        KC_TAB ,    KC_Q,    KC_W,    KC_E,    KC_R,    KC_T,                  KC_P7, KC_P8,  KC_P9,                 KC_Y,    KC_U,    KC_I,    KC_O,    KC_P, KC_LBRC,  KC_RBRC, \
        KC_CAPS,    KC_A,    KC_S,    KC_D,    KC_F,    KC_G,                  KC_P4, KC_P5,  KC_P6,                 KC_H,    KC_J,    KC_K,    KC_L, KC_SCLN, KC_QUOT,   KC_ENT, \
        KC_LSFT,    KC_Z,    KC_X,    KC_C,    KC_V,    KC_B,                  KC_P1, KC_P2,  KC_P3,                 KC_N,    KC_M, KC_COMM,  KC_DOT, KC_SLSH, KC_RSFT,           \
        KC_LCTL, KC_LGUI, KC_LALT, KC_RALT, KC_BSPC,            L_LFT,       KC_NLCK, KC_P0,KC_PDOT,        L_RGT, KC_SPC,            TO_FN,                             L_TOOLS  \
    ),


    /* Keymap: FN
     *
     * ,----------------------------------------------------                            ------------------------------------------------------------.
     * |        |       |      |      |      |      |      |                            |      |      |      |      |      |      |        |        |
     * |--------+-------+------+------+------+------+------+   ,------+------+------.   +------+------+------+------+------+------+--------+--------|
     * |        |       |      |      |      |      |          |KC_F10|KC_F11|KC_F12|          |      |      |      |      |      |        |        |
     * |--------+-------+------+------+------+------+          +------+------+------+          +------+------+------+------+------+--------+--------|
     * |        |       |      |      |      |      |          |KC_F7 |KC_F8 |KC_F9 |          |      |      |      |      |      |        |        |
     * |--------+-------+------+------+------+------+          +------+------+------+          +------+------+------+------+------+--------+        |
     * |        |       |      |      |      |      |          |KC_F4 |KC_F5 |KC_F6 |          |      |      |      |      |      |        |        |
     * |--------+-------+------+------+------+------+-----+    +------+------+------+    +-----+------+------+------+------+------+--------+--------|
     * |        |       |      |      |      |      |     |    |KC_F1 |KC_F2 |KC_F3 |    |     |      |      |      | TO_VS|               |        |
     * `-------------------------------------'      `-----'    `--------------------'    `-----'      `------'      `------'               `--------'
     *
     */

    [_FN] = LAYOUT_Pallas(
        _______, _______, _______, _______, _______, _______, _______,                                     _______, _______, _______, _______, _______, _______, _______, _______, \
        _______, _______, _______, _______, _______, _______,                 KC_F10, KC_F11, KC_F12,               _______, _______, _______, _______, _______, _______, _______, \
        _______, _______, _______, _______, _______, _______,                  KC_F7,  KC_F8,  KC_F9,               _______, _______, _______, _______, _______, _______, _______, \
        _______, _______, _______, _______, _______, _______,                  KC_F4,  KC_F5,  KC_F6,               _______, _______, _______, _______, _______, _______,          \
        _______, _______, _______, _______, _______,          _______,         KC_F1,  KC_F2,  KC_F3,      _______,          _______,            TO_VS,                   _______  \
    ),



    /* Keymap: VS

        Visual Studio
            KC_F9 => add breakpoint
            VS_QW => quick view
            VS_PEEK => peek definition
            VS_GREF => go to implementation
            VS_INT => force show intellisense
            VS_FRM => format code CTL+K,D CTL+K,E

        KC_F12 => go to definition
        SC_SF12 => find references

        _SAVE => save CTL+S

     *
     * ,------------------------------------------------------                             -------------------------------------------------------------.
     * |        |       |      |      |      |      |        |                             |      |      |      |      |       |      |        |        |
     * |--------+-------+------+------+------+------+--------+   ,------+------+-------.   +------+------+------+------+-------+------+--------+--------|
     * |        |       |      |      |      |      |            | KC_F5|KC_F10| KC_F11|          |      |      |      |       |      |        |        |
     * |--------+-------+------+------+------+------+            +------+------+-------+          +------+------+------+-------+------+--------+--------|
     * |        |       |      |      |      |      |            | KC_F9| VS_QW|SC_SF12|          |      |      |      |       |      |        |        |
     * |--------+-------+------+------+------+------+            +------+------+-------+          +------+------+------+-------+------+--------+        |
     * |        |       |      |      |      |      |            |VS_INT|      | KC_F12|          |      |      |      |       |      |        |        |
     * |--------+-------+------+------+------+------+-------+    +------+------+-------+   +------+------+------+------+-------+------+--------+--------|
     * |        |       |      |      |      |      |       |    |VS_FRM| _SAVE|VS_GREF|   |      |      |      |      |TO_CODE|               |        |
     * `-------------------------------------'      `-------'    `---------------------'   `------'      `------'      `-------'               `--------'
     *
     */
     [_VS] = LAYOUT_Pallas(
        _______, _______, _______, _______, _______, _______, _______,                                       _______, _______, _______, _______, _______, _______, _______, _______, \
        _______, _______, _______, _______, _______, _______,                  KC_F5,  KC_F10,  KC_F11,               _______, _______, _______, _______, _______, _______, _______, \
        _______, _______, _______, _______, _______, _______,                  KC_F9,   VS_QW, SC_SF12,               _______, _______, _______, _______, _______, _______, _______, \
        _______, _______, _______, _______, _______, _______,                 VS_INT, XXXXXXX,  KC_F12,               _______, _______, _______, _______, _______, _______,          \
        _______, _______, _______, _______, _______,          _______,        VS_FRM,   _SAVE, VS_GREF,      _______,          _______,          TO_CODE,                   _______  \
    ),





    /* Keymap: CODE

        VS Code
            VSC_COM => Command palette
            VSC_FRM => format code ALT+SHIFT+F
            VSC_TRM => open terminal

        KC_F12 => go to definition
        SC_SF12 => find references

        _SAVE => save CTL+S

     *
     * ,-----------------------------------------------------                              --------------------------------------------------------------.
     * |        |       |      |      |      |      |       |                              |       |      |      |      |       |      |        |        |
     * |--------+-------+------+------+------+------+-------+   ,-------+------+-------.   +-------+------+------+------+-------+------+--------+--------|
     * |        |       |      |      |      |      |           |VSC_TRM|      |VSC_COM|           |      |      |      |       |      |        |        |
     * |--------+-------+------+------+------+------+           +-------+------+-------+           +------+------+------+-------+------+--------+--------|
     * |        |       |      |      |      |      |           |       |      |SC_SF12|           |      |      |      |       |      |        |        |
     * |--------+-------+------+------+------+------+           +-------+------+-------+           +------+------+------+-------+------+--------+        |
     * |        |       |      |      |      |      |           |       |      | KC_F12|           |      |      |      |       |      |        |        |
     * |--------+-------+------+------+------+------+-------+   +-------+------+-------+    +------+------+------+------+-------+------+--------+--------|
     * |        |       |      |      |      |      |       |   |VSC_FRM| _SAVE|       |    |      |      |      |      |TO_BASE|               |        |
     * `-------------------------------------'      `-------'   `----------------------'    `------'      `------'      `-------'               `--------'
     *
     */
     [_CODE] = LAYOUT_Pallas(
        _______, _______, _______, _______, _______, _______, _______,                                       _______, _______, _______, _______, _______, _______, _______, _______, \
        _______, _______, _______, _______, _______, _______,                VSC_TRM, XXXXXXX, VSC_COM,               _______, _______, _______, _______, _______, _______, _______, \
        _______, _______, _______, _______, _______, _______,                XXXXXXX, XXXXXXX, SC_SF12,               _______, _______, _______, _______, _______, _______, _______, \
        _______, _______, _______, _______, _______, _______,                XXXXXXX, XXXXXXX,  KC_F12,               _______, _______, _______, _______, _______, _______,          \
        _______, _______, _______, _______, _______,          _______,       VSC_FRM,   _SAVE, XXXXXXX,      _______,          _______,          TO_BASE,                   _______  \
    ),




    /* Keymap: TOOLS
    *
    * ,----------------------------------------------------                             -----------------------------------------------------------------.
    * |        |       |      |      |      |      |      |                             |TD_PSCR|      |      |      |BLToggle|RGBToggl| RGB_MOD|        |
    * |--------+-------+------+------+------+------+------+    ,------+------+------.   +-------+------+------+------+--------+--------+--------+--------|
    * |        |       |      |      |      |      |           |      |      |      |           |      |      |      |  Step  |Hue Inc |Hue Dec |        |
    * |--------+-------+------+------+------+------+           +------+------+------+           +------+------+------+--------+--------+--------+--------|
    * |        |       |      |      |      |      |           |      |      |      |           |      |      |      |  Inc   |Sat Inc |Sat Dec |        |
    * |--------+-------+------+------+------+------+           +------+------+------+           +------+------+------+--------+--------+--------+        |
    * |        |       |      |      |      |      |           |      |      |      |           |      |      |      |  Dec   |Bright +|Bright -|        |
    * |--------+-------+------+------+------+------+-------+   +------+------+------+    +------+------+------+------+--------+--------+--------+--------|
    * |        |       |      |_TOOLS|      |      |       |   |      |      |      |    |      |      |      |      |  Britg |                 |        |
    * `-------------------------------------'      `-------'   `--------------------'    `------'      `------'      `--------'                 `--------'
    *
    */
    [_TOOLS] = LAYOUT_Pallas(
        XXXXXXX, XXXXXXX, XXXXXXX, XXXXXXX, XXXXXXX, XXXXXXX, XXXXXXX,                                       XXXXXXX, XXXXXXX, XXXXXXX, XXXXXXX, BL_TOGG, RGB_TOG, RGB_MOD, XXXXXXX, \
        XXXXXXX, XXXXXXX, XXXXXXX, XXXXXXX, XXXXXXX, XXXXXXX,                XXXXXXX, XXXXXXX, XXXXXXX,               XXXXXXX, XXXXXXX, XXXXXXX, BL_STEP, RGB_HUI, RGB_HUD, XXXXXXX, \
        XXXXXXX, XXXXXXX, XXXXXXX, XXXXXXX, XXXXXXX, XXXXXXX,                XXXXXXX, XXXXXXX, XXXXXXX,               XXXXXXX, XXXXXXX, XXXXXXX,  BL_INC, RGB_SAI, RGB_SAD, XXXXXXX, \
        XXXXXXX, XXXXXXX, XXXXXXX, XXXXXXX, XXXXXXX, XXXXXXX,                XXXXXXX, XXXXXXX, XXXXXXX,               XXXXXXX, XXXXXXX, XXXXXXX,  BL_DEC, RGB_VAI, RGB_SPD,          \
        XXXXXXX, XXXXXXX, XXXXXXX, XXXXXXX, XXXXXXX,          XXXXXXX,       XXXXXXX, XXXXXXX, XXXXXXX,      XXXXXXX,          XXXXXXX,          BL_BRTG,                   L_TOOLS  \
    ),




    /* Keymap: LEFT
     *
     * ,------------------------------------------------------                            ------------------------------------------------------------.
     * |        |       |      |       |      |       |      |                            |      |      |      |      |      |      |        |        |
     * |--------+-------+------+-------+------+-------+------+   ,------+------+------.   +------+------+------+------+------+------+--------+--------|
     * |        |       |  UP  |       |      |KC_HOME|          |      |      |      |          |      |      |      |      |      |        |        |
     * |--------+-------+------+-------+------+-------+          +------+------+------+          +------+------+------+------+------+--------+--------|
     * |        | LEFT  | DOWN | RIGHT |      | KC_END|          |      |      |      |          |      |      |      |      |      |        |        |
     * |--------+-------+------+-------+------+-------+          +------+------+------+          +------+------+------+------+------+--------+        |
     * |        |  < >  |      |       |      |       |          |      |      |      |          |      |      |      |      |      |        |        |
     * |--------+-------+------+-------+------+-------+-----+    +------+------+------+    +-----+------+------+------+------+------+--------+--------|
     * |        |       |  COMM| UNCOMM| F DEL|       |     |    |      |      |      |    |     |      |      |      |      |               |        |
     * `--------------------------------------'       `-----'    `--------------------'    `-----'      `------'      `------'               `--------'
     *
     */

    [_LEFT] = LAYOUT_Pallas(
        _______, _______, _______, _______, _______, _______, _______,                                        _______, _______, _______, _______, _______, _______, _______, _______, \
        _______, _______,  KC_UP , _______, _______, KC_HOME,                 _______, _______, _______,               _______, _______, _______, _______, _______, _______, _______, \
        _______, KC_LEFT, KC_DOWN,KC_RIGHT, _______,  KC_END,                 _______, _______, _______,               _______, _______, _______, _______, _______, _______, _______, \
        _______, KC_NUBS, _______, _______, _______, _______,                 _______, _______, _______,               _______, _______, _______, _______, _______, _______,          \
        _______, _______,    COMM,  UNCOMM,  KC_DEL,            L_LFT,        _______, _______, _______,        L_RGT,          _______,          _______,                   _______  \
    ),



    /* Keymap: RIGHT
     *
     * ,----------------------------------------------------                            ---------------------------------------------------------------.
     * |        |       |      |      |      |      |      |                            |      | PREV | Play | NEXT |      |      |KC_PSCR| _SCREENSHOT|
     * |--------+-------+------+------+------+------+------+   ,------+------+------.   +------+------+------+------+------+------+--------+-----------|
     * |        |       |      |      |      |      |          |      |      |      |          |VOL DW| MUTE |VOL UP|      |      |        |           |
     * |--------+-------+------+------+------+------+          +------+------+------+          +------+------+------+------+------+--------+-----------|
     * |        |       |      |      |      |      |          |      |      |      |          |      |      |      |      |      |        |           |
     * |--------+-------+------+------+------+------+          +------+------+------+          +------+------+------+------+------+--------+           |
     * |        |       |      |      |      |      |          |      |      |      |          |      |      |      |      |      |        |           |
     * |--------+-------+------+------+------+------+-----+    +------+------+------+    +-----+------+------+------+------+------+--------+-----------|
     * |        |       |      |      |      |      |     |    |      |      |      |    |     |      |      |      |      |               |           |
     * `-------------------------------------'      `-----'    `--------------------'    `-----'      `------'      `------'               `-----------'
     *
     */

    [_RIGHT] = LAYOUT_Pallas(
        _______, _______, _______, _______, _______, _______, _______,                                        _______, KC_MPRV, KC_MPLY, KC_MNXT, _______, _______, KC_PSCR,_SCREENSHOT, \
        _______, _______, _______, _______, _______, _______,                 _______, _______, _______,               KC_VOLD, KC_MUTE, KC_VOLU, _______, _______, _______,    _______, \
        _______, _______, _______, _______, _______, _______,                 _______, _______, _______,               _______, _______, _______, _______, _______, _______,    _______, \
        _______, _______, _______, _______, _______, _______,                 _______, _______, _______,               _______, _______, _______, _______, _______, _______,             \
        _______, _______, _______, _______, _______,            L_LFT,        _______, _______, _______,        L_RGT,          _______,          _______,                      _______  \
    )
};



/*****************************************************************************************************/
/*****************************************************************************************************/
/*****************************************************************************************************/
/*****************************************************************************************************/
/*****************************************************************************************************/
/*****************************************************************************************************/

bool process_record_user(uint16_t keycode, keyrecord_t *record) {
  switch (keycode) {
    case VS_FRM:
        if (record->event.pressed) {
            SEND_STRING(SS_LCTL("kdke"));
        } else {
        }
        break;

    case COMM:
        if (record->event.pressed) {
            SEND_STRING(SS_LCTL("kc"));
        } else {
        }
        break;

    case UNCOMM:
        if (record->event.pressed) {
            SEND_STRING(SS_LCTL("ku"));
        } else {
        }
        break;
  }
  return true;
}



/*****************************************************************************************************/
/*****************************************************************************************************/
/*****************************************************************************************************/
/*****************************************************************************************************/
/*****************************************************************************************************/
/*****************************************************************************************************/

#ifdef OLED_ENABLE

oled_rotation_t oled_init_user(oled_rotation_t rotation) {
	return OLED_ROTATION_180;
}


static void render_status(void) {
    // 21 characters per line
    // 16 cols / 8 rows

    oled_write_P(PSTR("    Pallas rev 0.3   "), false);

    // Host Keyboard Layer Status
    oled_write_P(PSTR("Layer: "), false);
    switch (get_highest_layer(layer_state)) {
        case _BASE:
            oled_write_P(PSTR("Default\n"), false);
            break;
        case _FN:
            oled_write_P(PSTR("[F]\n"), false);
            break;
        case _VS:
            oled_write_P(PSTR("Visual Studio\n"), false);
            break;
        case _CODE:
            oled_write_P(PSTR("VS Code\n"), false);
            break;
        default:
            oled_write_P(PSTR("Undefined\n"), false);
    }

    // Host Keyboard LED Status
    led_t led_state = host_keyboard_led_state();
    oled_write_P(PSTR("         "), false);
    oled_write_P(led_state.num_lock ? PSTR("NUM ") : PSTR("    "), false);
    oled_write_P(led_state.caps_lock ? PSTR("CAP ") : PSTR("    "), false);
    oled_write_P(led_state.scroll_lock ? PSTR("SCR ") : PSTR("    "), false);

    oled_write_ln("", false);
    oled_write_ln("", false);
    oled_write_ln("", false);
    oled_write_ln("", false);
    oled_write_ln("", false);
}

static void render_pallas_logo(void) {
    oled_set_cursor(0, 5);

    static const char PROGMEM pallas_logo[] = {
        0x80, 0x81, 0x82, 0x83, 0x84, 0x85, 0x86, 0x87, 0x88, 0x89, 0x8A, 0x8B, 0x8C, 0x8D, 0x8E, 0x8F, 0x90, 0x91, 0x92, 0x93, 0x94,
        0xA0, 0xA1, 0xA2, 0xA3, 0xA4, 0xA5, 0xA6, 0xA7, 0xA8, 0xA9, 0xAA, 0xAB, 0xAC, 0xAD, 0xAE, 0xAF, 0xB0, 0xB1, 0xB2, 0xB3, 0xB4,
        0xC0, 0xC1, 0xC2, 0xC3, 0xC4, 0xC5, 0xC6, 0xC7, 0xC8, 0xC9, 0xCA, 0xCB, 0xCC, 0xCD, 0xCE, 0xCF, 0xD0, 0xD1, 0xD2, 0xD3, 0xD4, 0x00
    };

    oled_write_P(pallas_logo, false);
}


bool oled_task_user(void) {
    switch (get_highest_layer(layer_state)) {
        case _TOOLS:
            render_pallas_logo();
            break;
        default:
            render_status();
    }

    return false;
}
#endif
