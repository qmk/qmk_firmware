// Copyright 2024 James Gzowski
// SPDX-License-Identifier: GPL-2.0-or-later
#include QMK_KEYBOARD_H
#ifdef OLED_ENABLE
static uint8_t  oled_mode       = 0;
static uint8_t  esc_press_count = 0;
static uint16_t esc_timer       = 0;
// Stats display
void render_stats(void) {
    oled_write_P(PSTR("WPM: "), false);
    oled_write_ln(get_u8_str(get_current_wpm(), '0'), false);
    if (host_keyboard_led_state().caps_lock) {
        oled_write_P(PSTR("CAPS: On   "), false);
    } else {
        oled_write_P(PSTR("CAPS: Off  "), false);
    }
    if (keymap_config.nkro) {
        oled_write_ln("NKRO: On", false);
    } else {
        oled_write_ln("NKRO: Off", false);
    }
    oled_write_P(PSTR("LED Brightness: "), false);
    oled_write_ln(get_u8_str(rgblight_get_val(), '0'), false);
    oled_write_ln(PSTR("P: 0x6F64  V: 0x73CA"), false);
}
// Static images
static void render_caps(void) {
    static const char PROGMEM my_caps[] = {
        0,   128, 192, 192, 248, 120, 8,  8,  24, 24, 48,  96,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 240,
        248, 12,  12,  12,  12,  12,  28, 56, 0,  0,  240, 248,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 0,
        0,   0,   0,   1,   1,   1,   1,  1,  0,  0,  0,   224,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  0,
    };
    oled_write_raw_P(my_caps, sizeof(my_caps));
}
static void render_logo(void) {
    static const char PROGMEM my_logo[] = {
        0,   128, 192, 192, 248, 120, 8,  8,   24,  24, 48, 96,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  0,
        240, 248, 12,  12,  12,  12,  12, 248, 240, 0,  0,  248,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 63,
        0,   0,   15,  31,  50,  49,  48, 48,  31,  15, 0,  224,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 0,
    };
    oled_write_raw_P(my_logo, sizeof(my_logo));
}
// Render chosen display
void render_oled_display(void) {
    if (oled_mode == 0) {
        if (host_keyboard_led_state().caps_lock) {
            render_caps();
        } else {
            render_logo();
        }
    } else if (oled_mode == 1) {
        render_stats();
    }
}
// Rotate 180 degrees
oled_rotation_t oled_init_kb(oled_rotation_t rotation) {
    return OLED_ROTATION_180;
}
bool oled_task_kb(void) {
    if (!oled_task_user()) {
        return false;
    }
    render_oled_display();
    return false;
}
// Record keypress
bool process_record_kb(uint16_t keycode, keyrecord_t *record) {
    switch (keycode) {
        case KC_ESC:
            if (record->event.pressed) {
                if (timer_elapsed(esc_timer) > 250) {
                    esc_press_count = 0;
                }
                esc_press_count++;
                esc_timer = timer_read();

                if (esc_press_count == 3) {
                    oled_clear();
                    oled_mode       = (oled_mode == 0) ? 1 : 0;
                    esc_press_count = 0;
                }
            }
            break;
    }
    return process_record_user(keycode, record);
}
#endif
