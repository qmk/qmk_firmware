#include QMK_KEYBOARD_H
#include <stdio.h>
bool is_alt_tab_active = false;
uint16_t alt_tab_timer = 0;

char wpm_str[10];

enum sofle_layers {
    /* _M_XYZ = Mac Os, _W_XYZ = Win/Linux */
    _QWERTY,
    _COLEMAK,
    _LOWER,
    _RAISE,
    _ADJUST,
};

enum custom_keycodes {
    KC_QWERTY = SAFE_RANGE,
    KC_COLEMAK,
    KC_LOWER,
    KC_RAISE,
    KC_ADJUST,
    KC_PRVWD,
    KC_NXTWD,
    KC_LSTRT,
    KC_LEND,
    KC_DLINE
};

const uint16_t PROGMEM keymaps[][MATRIX_ROWS][MATRIX_COLS] = {

	[_QWERTY] = LAYOUT( \
      KC_ESC,  KC_1,    KC_2,    KC_3,    KC_4,    KC_5,    KC_LBRC,  KC_RBRC,  KC_6,    KC_7,    KC_8,    KC_9,    KC_0,    KC_BSPC, \
      KC_TAB,  KC_Q,    KC_W,    KC_E,    KC_R,    KC_T,    KC_MINS,  KC_EQL,  KC_Y,    KC_U,    KC_I,    KC_O,    KC_P,    KC_BSPC, \
      KC_ADJUST, KC_A,    KC_S,    KC_D,    KC_F,    KC_G,    KC_GRV,   KC_DEL,  KC_H,    KC_J,    KC_K,    KC_L,    KC_SCLN, KC_QUOT, \
      KC_LSFT, KC_Z,    KC_X,    KC_C,    KC_V,    KC_B,    KC_MUTE, KC_RBRC, KC_N,    KC_M,    KC_COMM, KC_DOT,  KC_SLSH, KC_ENT , \
      KC_LCTL, KC_LALT, KC_LALT, KC_LGUI, KC_LOWER, KC_SPC, KC_ENT,  KC_ENT,  KC_SPC,   KC_RAISE,    KC_LEFT, KC_DOWN, KC_UP,   KC_RGHT \
    ),
		
	[_LOWER] = LAYOUT( \
      _______, KC_F1,   KC_F2,   KC_F3,   KC_F4,   KC_F5,   _______, _______,   KC_F6,   KC_F7,   KC_F8,   KC_F9,  KC_F10,  KC_F11, \
      KC_PSLS, KC_P7, KC_P8, KC_P9, KC_NLCK, _______, _______, _______, _______, KC_PSLS, KC_P7, KC_P8, KC_P9, KC_F12, \
      KC_CAPS, KC_P4, KC_P5, KC_P6, KC_NLCK, _______, _______, _______, _______, _______, KC_P4, KC_P5, KC_P6, KC_NLCK, \
      _______, KC_P1, KC_P2, KC_P3, _______, _______, _______, _______, _______, _______, KC_P1, KC_P2, KC_P3, _______, \
      _______, KC_P0, KC_PDOT, KC_PENT, _______, _______, _______, _______, _______, _______, KC_P0, KC_PDOT, KC_PENT, _______ \
      ),
	  
	[_RAISE] = LAYOUT( \
      _______, KC_F1,   KC_F2,   KC_F3,   KC_F4,   KC_F5,   _______, _______,   KC_F6,   KC_F7,   KC_F8,   KC_F9,  KC_F10,  KC_F11, \
      KC_PSLS, KC_P7, KC_P8, KC_P9, KC_NLCK, _______, _______, _______, _______, KC_PSLS, KC_P7, KC_P8, KC_P9, KC_F12, \
      KC_CAPS, KC_P4, KC_P5, KC_P6, KC_NLCK, _______, _______, _______, _______, _______, KC_P4, KC_P5, KC_P6, KC_NLCK, \
      _______, KC_P1, KC_P2, KC_P3, _______, _______, _______, _______, _______, _______, KC_P1, KC_P2, KC_P3, _______, \
      _______, KC_P0, KC_PDOT, KC_PENT, _______, _______, _______, _______, _______, _______, KC_P0, KC_PDOT, KC_PENT, _______ \
      ),

	[_ADJUST] = LAYOUT( \
      _______, KC_F1,   KC_F2,   KC_F3,   KC_F4,   KC_F5,   _______, _______,   KC_F6,   KC_F7,   KC_F8,   KC_F9,  KC_F10,  KC_F11, \
      _______, _______, _______, _______, _______, _______, _______, _______, _______, _______, _______, _______, _______, KC_F12, \
      _______, _______, _______, _______, _______, _______, _______, _______, _______, _______, _______, _______, _______, _______, \
      _______, _______, _______, _______, _______, _______, _______, _______, _______, _______, RGB_TOG, RGB_HUI, RGB_SAI, RGB_VAI, \
      _______, _______, _______, _______, _______, _______, _______, _______, _______, RGB_RMOD, RGB_MOD, RGB_HUD, RGB_SAD, RGB_VAD \
      )

};

layer_state_t layer_state_set_user(layer_state_t state) {
    return update_tri_layer_state(state, _LOWER, _RAISE, _ADJUST);
}

#ifdef OLED_DRIVER_ENABLE

oled_rotation_t oled_init_user(oled_rotation_t rotation) {
	return OLED_ROTATION_0;
}

static void render_status(void) {
    // Host Keyboard Layer Status
    oled_write_P(PSTR("Layer: "), false);
    switch (get_highest_layer(layer_state)) {
        case _QWERTY:
            oled_write_P(PSTR("QWERTY"), false);
            break;
        case _LOWER:
            oled_write_P(PSTR("Numpad"), false);
            break;
        case _RAISE:
            oled_write_P(PSTR("F Keys"), false);
            break;
        case _ADJUST:
            oled_write_P(PSTR("RGB   "), false);
            break;
        default:
            oled_write_P(PSTR("Undefined"), false);
    }

    //Host Keyboard LED Status
    led_t led_state = host_keyboard_led_state();
    oled_write_P(led_state.num_lock ? PSTR("NUM ") : PSTR("       "), false);
    oled_write_P(led_state.caps_lock ? PSTR("CAPS ") : PSTR("       "), false);
    oled_write_P(led_state.scroll_lock ? PSTR("SCRL") : PSTR("       "), false);
}


// WPM-responsive animation stuff here
#define IDLE_FRAMES 5
#define IDLE_SPEED 40 // below this wpm value your animation will idle

// #define PREP_FRAMES 1 // uncomment if >1

#define TAP_FRAMES 2
#define TAP_SPEED 60 // above this wpm value typing animation to triggere

#define ANIM_FRAME_DURATION 200 // how long each frame lasts in ms
// #define SLEEP_TIMER 60000 // should sleep after this period of 0 wpm, needs fixing
#define ANIM_SIZE 636 // number of bytes in array, minimize for adequate firmware size, max is 1024

uint32_t anim_timer = 0;
uint32_t anim_sleep = 0;
uint8_t current_idle_frame = 0;
// uint8_t current_prep_frame = 0; // uncomment if PREP_FRAMES >1
uint8_t current_tap_frame = 0;

// Images credit j-inc(/James Incandenza) and pixelbenny. Credit to obosob for initial animation approach.
static void render_anim(void) {
    static const char PROGMEM idle[IDLE_FRAMES][ANIM_SIZE] = {
        {
        0,  0,126,126, 24, 60,102, 66,  0, 12, 28,112,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128,
        0,  0,  0,  0,192, 96, 48, 24, 12,132,198, 98,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  0,
        0,  0,252, 15,  1,  0,248, 14, 31,109,140,148,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  0,
        0,  0, 31,120,192,  0, 15, 56,124,219,152, 20,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  0,
        32, 16, 16, 16, 17, 11, 14, 12, 24, 16, 49, 35,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  8
        },
        {
        0,  0,126,126, 24, 60,102, 66,  0, 12, 28,112,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128,
        0,  0,  0,  0,192, 96, 48, 24, 12,132,198, 98,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  0,
        0,  0,252, 15,  1,  0,248, 14, 31,109,140,148,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  0,
        0,  0, 31,120,192,  0, 15, 56,124,219,152, 20,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  0,
        32, 16, 16, 16, 17, 11, 14, 12, 24, 16, 49, 35,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  8
        },
        {
        0,  0,126,126, 24, 60,102, 66,  0, 12, 28,112,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128,
        0,  0,  0,  0,192, 96, 48, 24, 12,132,198, 98,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  0,
        0,  0,252, 15,  1,  0,248, 14, 31,109,140,148,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  0,
        0,  0, 31,120,192,  0, 15, 56,124,219,152, 20,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  0,
        32, 16, 16, 16, 17, 11, 14, 12, 24, 16, 49, 35,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  8
        },
        {
        0,  0,126,126, 24, 60,102, 66,  0, 12, 28,112,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128,
        0,  0,  0,  0,192, 96, 48, 24, 12,132,198, 98,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  0,
        0,  0,252, 15,  1,  0,248, 14, 31,109,140,148,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  0,
        0,  0, 31,120,192,  0, 15, 56,124,219,152, 20,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  0,
        32, 16, 16, 16, 17, 11, 14, 12, 24, 16, 49, 35,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  8
        },
        {
        0,  0,126,126, 24, 60,102, 66,  0, 12, 28,112,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128,
        0,  0,  0,  0,192, 96, 48, 24, 12,132,198, 98,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  0,
        0,  0,252, 15,  1,  0,248, 14, 31,109,140,148,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  0,
        0,  0, 31,120,192,  0, 15, 56,124,219,152, 20,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  0,
        32, 16, 16, 16, 17, 11, 14, 12, 24, 16, 49, 35,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  8
        }
    };
    static const char PROGMEM prep[][ANIM_SIZE] = {
        {
        0,  0,126,126, 24, 60,102, 66,  0, 12, 28,112,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128,
        0,  0,  0,  0,192, 96, 48, 24, 12,132,198, 98,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  0,
        0,  0,252, 15,  1,  0,248, 14, 31,109,140,148,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  0,
        0,  0, 31,120,192,  0, 15, 56,124,219,152, 20,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  0,
        32, 16, 16, 16, 17, 11, 14, 12, 24, 16, 49, 35,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  8
        }
    };
    static const char PROGMEM tap[TAP_FRAMES][ANIM_SIZE] = {
        {
        0,  0,126,126, 24, 60,102, 66,  0, 12, 28,112,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128,
        0,  0,  0,  0,192, 96, 48, 24, 12,132,198, 98,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  0,
        0,  0,252, 15,  1,  0,248, 14, 31,109,140,148,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  0,
        0,  0, 31,120,192,  0, 15, 56,124,219,152, 20,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  0,
        32, 16, 16, 16, 17, 11, 14, 12, 24, 16, 49, 35,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  8
        },
        {
        0,  0,126,126, 24, 60,102, 66,  0, 12, 28,112,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128,
        0,  0,  0,  0,192, 96, 48, 24, 12,132,198, 98,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  0,
        0,  0,252, 15,  1,  0,248, 14, 31,109,140,148,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  0,
        0,  0, 31,120,192,  0, 15, 56,124,219,152, 20,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  0,
        32, 16, 16, 16, 17, 11, 14, 12, 24, 16, 49, 35,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  8
        },
    };

    //assumes 1 frame prep stage
    void animation_phase(void) {
        if(get_current_wpm() <=IDLE_SPEED){
            current_idle_frame = (current_idle_frame + 1) % IDLE_FRAMES;
            oled_write_raw_P(idle[abs((IDLE_FRAMES-1)-current_idle_frame)], ANIM_SIZE);
         }
         if(get_current_wpm() >IDLE_SPEED && get_current_wpm() <TAP_SPEED){
             // oled_write_raw_P(prep[abs((PREP_FRAMES-1)-current_prep_frame)], ANIM_SIZE); // uncomment if IDLE_FRAMES >1
             oled_write_raw_P(prep[0], ANIM_SIZE);  // remove if IDLE_FRAMES >1
         }
         if(get_current_wpm() >=TAP_SPEED){
             current_tap_frame = (current_tap_frame + 1) % TAP_FRAMES;
             oled_write_raw_P(tap[abs((TAP_FRAMES-1)-current_tap_frame)], ANIM_SIZE);
         }
    }
    if(get_current_wpm() != 000) {
        oled_on(); // not essential but turns on animation OLED with any alpha keypress
        if(timer_elapsed32(anim_timer) > ANIM_FRAME_DURATION) {
            anim_timer = timer_read32();
            animation_phase();
        }
        anim_sleep = timer_read32();
    } else {
        if(timer_elapsed32(anim_sleep) > OLED_TIMEOUT) {
            oled_off();
        } else {
            if(timer_elapsed32(anim_timer) > ANIM_FRAME_DURATION) {
                anim_timer = timer_read32();
                animation_phase();
            }
        }
    }
}

// static void render_skull(void) { // Helen Tseong (http://shewolfe.co/), the original artist behind the skull, sadly only allowing use of the skull for my personal use. Her (excellent) works are copyright her, and I claim no ownership. Reach out to her for permission!
//     static const char PROGMEM skull[] = {
//     };
//      oled_write_raw_P(skull, 801);
//  }

void oled_task_user(void) {
    if (is_keyboard_master()) {
        //render_skull();
        //oled_set_cursor(7,6);
        render_status();
     // Renders the current keyboard state (layer, lock, caps, scroll, etc)
    } else {
        render_anim();
        oled_set_cursor(0,6);
        sprintf(wpm_str, "       WPM: %03d", get_current_wpm());
        oled_write(wpm_str, false);

    }
}
#endif

#ifdef ENCODER_ENABLE

void encoder_update_user(uint8_t index, bool clockwise) {
    if (index == 0) {
        if (clockwise) {
            tap_code(KC_VOLU);
        } else {
            tap_code(KC_VOLD);
        }
    } else if (index == 1) {
        if (clockwise) {
              rgblight_step();
        } else {
           rgblight_step_reverse();
        }
    }
}

#endif