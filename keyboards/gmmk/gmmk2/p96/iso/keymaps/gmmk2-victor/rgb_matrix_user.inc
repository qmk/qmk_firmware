RGB_MATRIX_EFFECT(layer0)
RGB_MATRIX_EFFECT(layer1)
RGB_MATRIX_EFFECT(layer2)
RGB_MATRIX_EFFECT(layer3)
RGB_MATRIX_EFFECT(layer15)

#ifdef RGB_MATRIX_CUSTOM_EFFECT_IMPLS

static bool layer0(effect_params_t* params) {
    RGB_MATRIX_USE_LIMITS(led_min, led_max);

    rgb_matrix_set_color_all(0x12, 0x0e, 0x00);
    rgb_matrix_set_color(101, 0x4d, 0x17, 0x00);
    rgb_matrix_set_color(102, 0x4d, 0x17, 0x00);
    rgb_matrix_set_color(103, 0x4d, 0x17, 0x00);
    rgb_matrix_set_color(104, 0x4d, 0x17, 0x00);
    rgb_matrix_set_color(105, 0x4d, 0x17, 0x00);
    rgb_matrix_set_color(106, 0x4d, 0x17, 0x00);
    rgb_matrix_set_color(107, 0x4d, 0x17, 0x00);
    rgb_matrix_set_color(108, 0x4d, 0x17, 0x00);
    rgb_matrix_set_color(109, 0x4d, 0x17, 0x00);
    rgb_matrix_set_color(110, 0x4d, 0x17, 0x00);
    rgb_matrix_set_color(111, 0x4d, 0x17, 0x00);
    rgb_matrix_set_color(112, 0x4d, 0x17, 0x00);
    rgb_matrix_set_color(113, 0x4d, 0x17, 0x00);
    rgb_matrix_set_color(114, 0x4d, 0x17, 0x00);
    rgb_matrix_set_color(115, 0x4d, 0x17, 0x00);
    rgb_matrix_set_color(116, 0x4d, 0x17, 0x00);
    rgb_matrix_set_color(117, 0x4d, 0x17, 0x00);
    rgb_matrix_set_color(118, 0x4d, 0x17, 0x00);
    rgb_matrix_set_color(119, 0x4d, 0x17, 0x00);
    rgb_matrix_set_color(100, 0x4d, 0x17, 0x00);
    rgb_matrix_set_color(1,  0xff, 0xcc, 0x00); //F1

    return rgb_matrix_check_finished_leds(led_max);
}


static bool layer1(effect_params_t* params) {

    RGB_MATRIX_USE_LIMITS(led_min, led_max);

    rgb_matrix_set_color_all(0x12, 0x0e, 0x00);
    rgb_matrix_set_color(101, 0x4d, 0x17, 0x00);
    rgb_matrix_set_color(102, 0x4d, 0x17, 0x00);
    rgb_matrix_set_color(103, 0x4d, 0x17, 0x00);
    rgb_matrix_set_color(104, 0x4d, 0x17, 0x00);
    rgb_matrix_set_color(105, 0x4d, 0x17, 0x00);
    rgb_matrix_set_color(106, 0x4d, 0x17, 0x00);
    rgb_matrix_set_color(107, 0x4d, 0x17, 0x00);
    rgb_matrix_set_color(108, 0x4d, 0x17, 0x00);
    rgb_matrix_set_color(109, 0x4d, 0x17, 0x00);
    rgb_matrix_set_color(110, 0x4d, 0x17, 0x00);
    rgb_matrix_set_color(111, 0x4d, 0x17, 0x00);
    rgb_matrix_set_color(112, 0x4d, 0x17, 0x00);
    rgb_matrix_set_color(113, 0x4d, 0x17, 0x00);
    rgb_matrix_set_color(114, 0x4d, 0x17, 0x00);
    rgb_matrix_set_color(115, 0x4d, 0x17, 0x00);
    rgb_matrix_set_color(116, 0x4d, 0x17, 0x00);
    rgb_matrix_set_color(117, 0x4d, 0x17, 0x00);
    rgb_matrix_set_color(118, 0x4d, 0x17, 0x00);
    rgb_matrix_set_color(119, 0x4d, 0x17, 0x00);
    rgb_matrix_set_color(100, 0x4d, 0x17, 0x00);        
    rgb_matrix_set_color(2,  0xff, 0xcc, 0x00); //F2

    return rgb_matrix_check_finished_leds(led_max);
}

static bool layer2(effect_params_t* params) {
    RGB_MATRIX_USE_LIMITS(led_min, led_max);

    rgb_matrix_set_color_all(0x12, 0x0e, 0x00);
    rgb_matrix_set_color(101, 0x4d, 0x17, 0x00);
    rgb_matrix_set_color(102, 0x4d, 0x17, 0x00);
    rgb_matrix_set_color(103, 0x4d, 0x17, 0x00);
    rgb_matrix_set_color(104, 0x4d, 0x17, 0x00);
    rgb_matrix_set_color(105, 0x4d, 0x17, 0x00);
    rgb_matrix_set_color(106, 0x4d, 0x17, 0x00);
    rgb_matrix_set_color(107, 0x4d, 0x17, 0x00);
    rgb_matrix_set_color(108, 0x4d, 0x17, 0x00);
    rgb_matrix_set_color(109, 0x4d, 0x17, 0x00);
    rgb_matrix_set_color(110, 0x4d, 0x17, 0x00);
    rgb_matrix_set_color(111, 0x4d, 0x17, 0x00);
    rgb_matrix_set_color(112, 0x4d, 0x17, 0x00);
    rgb_matrix_set_color(113, 0x4d, 0x17, 0x00);
    rgb_matrix_set_color(114, 0x4d, 0x17, 0x00);
    rgb_matrix_set_color(115, 0x4d, 0x17, 0x00);
    rgb_matrix_set_color(116, 0x4d, 0x17, 0x00);
    rgb_matrix_set_color(117, 0x4d, 0x17, 0x00);
    rgb_matrix_set_color(118, 0x4d, 0x17, 0x00);
    rgb_matrix_set_color(119, 0x4d, 0x17, 0x00);
    rgb_matrix_set_color(100, 0x4d, 0x17, 0x00);        
    rgb_matrix_set_color(3,  0xff, 0xcc, 0x00); //F3

    return rgb_matrix_check_finished_leds(led_max);
}

static bool layer3(effect_params_t* params) {
    RGB_MATRIX_USE_LIMITS(led_min, led_max);

    rgb_matrix_set_color_all(0x12, 0x0e, 0x00);
    rgb_matrix_set_color(101, 0x4d, 0x17, 0x00);
    rgb_matrix_set_color(102, 0x4d, 0x17, 0x00);
    rgb_matrix_set_color(103, 0x4d, 0x17, 0x00);
    rgb_matrix_set_color(104, 0x4d, 0x17, 0x00);
    rgb_matrix_set_color(105, 0x4d, 0x17, 0x00);
    rgb_matrix_set_color(106, 0x4d, 0x17, 0x00);
    rgb_matrix_set_color(107, 0x4d, 0x17, 0x00);
    rgb_matrix_set_color(108, 0x4d, 0x17, 0x00);
    rgb_matrix_set_color(109, 0x4d, 0x17, 0x00);
    rgb_matrix_set_color(110, 0x4d, 0x17, 0x00);
    rgb_matrix_set_color(111, 0x4d, 0x17, 0x00);
    rgb_matrix_set_color(112, 0x4d, 0x17, 0x00);
    rgb_matrix_set_color(113, 0x4d, 0x17, 0x00);
    rgb_matrix_set_color(114, 0x4d, 0x17, 0x00);
    rgb_matrix_set_color(115, 0x4d, 0x17, 0x00);
    rgb_matrix_set_color(116, 0x4d, 0x17, 0x00);
    rgb_matrix_set_color(117, 0x4d, 0x17, 0x00);
    rgb_matrix_set_color(118, 0x4d, 0x17, 0x00);
    rgb_matrix_set_color(119, 0x4d, 0x17, 0x00);
    rgb_matrix_set_color(100, 0x4d, 0x17, 0x00);        
    rgb_matrix_set_color(4,  0xff, 0xcc, 0x00); //F4

    return rgb_matrix_check_finished_leds(led_max);
}

static bool layer15(effect_params_t* params) {
    RGB_MATRIX_USE_LIMITS(led_min, led_max);

    rgb_matrix_set_color_all(0x12, 0x0e, 0x00);
    rgb_matrix_set_color(101, 0x4d, 0x17, 0x00);
    rgb_matrix_set_color(102, 0x4d, 0x17, 0x00);
    rgb_matrix_set_color(103, 0x4d, 0x17, 0x00);
    rgb_matrix_set_color(104, 0x4d, 0x17, 0x00);
    rgb_matrix_set_color(105, 0x4d, 0x17, 0x00);
    rgb_matrix_set_color(106, 0x4d, 0x17, 0x00);
    rgb_matrix_set_color(107, 0x4d, 0x17, 0x00);
    rgb_matrix_set_color(108, 0x4d, 0x17, 0x00);
    rgb_matrix_set_color(109, 0x4d, 0x17, 0x00);
    rgb_matrix_set_color(110, 0x4d, 0x17, 0x00);
    rgb_matrix_set_color(111, 0x4d, 0x17, 0x00);
    rgb_matrix_set_color(112, 0x4d, 0x17, 0x00);
    rgb_matrix_set_color(113, 0x4d, 0x17, 0x00);
    rgb_matrix_set_color(114, 0x4d, 0x17, 0x00);
    rgb_matrix_set_color(115, 0x4d, 0x17, 0x00);
    rgb_matrix_set_color(116, 0x4d, 0x17, 0x00);
    rgb_matrix_set_color(117, 0x4d, 0x17, 0x00);
    rgb_matrix_set_color(118, 0x4d, 0x17, 0x00);
    rgb_matrix_set_color(119, 0x4d, 0x17, 0x00);
    rgb_matrix_set_color(100, 0x4d, 0x17, 0x00);        

    return rgb_matrix_check_finished_leds(led_max);
}


#endif  // RGB_MATRIX_CUSTOM_EFFECT_IMPLS