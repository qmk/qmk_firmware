#include "tv44.h"
#include "action_layer.h"
#include "eeconfig.h"

extern keymap_config_t keymap_config;

// Each layer gets a name for readability, which is then used in the keymap matrix below.
// The underscores don't mean anything - you can have a layer called STUFF or any other name.
// Layer names don't all need to be of the same length, obviously, and you can also skip them
// entirely and just use numbers.

#define _L0 0
#define _L1 1
#define _L2 2
#define _L3 3

// Macro name shortcuts


// Fillers to make layering more clear
#define _______ KC_TRNS


const uint16_t PROGMEM keymaps[][MATRIX_ROWS][MATRIX_COLS] = {

/* LAYER 0
 *
 * ,------+------+------+------+------+------+------+------+------+------+------+----------.
 * | Tab  |   Q  |   W  |   E  |   R  |   T  |   Y  |   U  |   I  |   O  |   P  |     Bksp |
 * |------`------`------`------`------`------`------`------`------`------`------`----------|
 * | L1/Esc |   A  |   S  |   D  |   F  |   G  |   H  |   J  |   K  |   L  |   ;  |   L1/' |
 * |--------`------`------`------`------`------`------`------`------`------`------`--------|
 * | Shift    |   Z  |   X  |   C  |   V  |   B  |   N  |   M  |   ,  |   .  |   /  |Sft/\ |
 * |----------`------`------`------`------`------'------`------`------`------`------`------|
 * | Ctrl   |   GUI  |  Alt  |     Enter      |    Space     |   L2  |    L5   |  Ctrl/Del |
 *  `-------+--------+-------+------^^^-------+-----^^^------+-------+---------+-----------'
 */

  [_L0] = KEYMAP( /* LAYER 0 */
/*,--------+-------+--------+--------+--------+--------+--------+--------+--------+--------+--------+-----------------.*/
    KC_TAB,   KC_Q,    KC_W,    KC_E,    KC_R,    KC_T,    KC_Y,    KC_U,    KC_I,    KC_O,    KC_P,       KC_BSPC    ,
/*|--------`-------`--------`--------`--------`--------`--------`--------`--------`--------`--------`-----------------|*/
    LT(1,KC_ESC),KC_A,  KC_S,    KC_D,    KC_F,    KC_G,    KC_H,    KC_J,    KC_K,    KC_L, KC_SCLN,   LT(1,KC_QUOT) ,
/*|----------`-------`--------`--------`--------`--------`--------`--------`--------`--------`--------`---------------|*/
    KC_LSFT    ,   KC_Z,   KC_X,    KC_C,    KC_V,    KC_B,    KC_N,    KC_M, KC_COMM,  KC_DOT, KC_SLSH,SFT_T(KC_BSLS),
/*|------------`-------`--------`--------`--------`--------`--------`--------`--------`--------`--------`-------------|*/
    KC_LCTL, KC_LGUI ,  KC_LALT,     LT(4,KC_ENT)     ,    LT(3,KC_SPC)   ,    MO(2)  ,     MO(5)   ,   CTL_T(KC_DEL)),
/*`--------+---------+---------+---------^^^----------+--------^^^--------+-----------+-------------+-----------------'*/

/* LAYER 1
 *
 * ,------+------+------+------+------+------+------+------+------+------+------+----------.
 * | CAPS | PGUP |  UP  | PGDN | TRNS | HOME |   _  |  P7  |  P8  |  P9  |   =  |     TRNS |
 * |------`------`------`------`------`------`------`------`------`------`------`----------|
 * | TRNS   |  LT  |  DN  |  RT  | DEL  | END  | PMNS |  P4  |  P5  |  P6  | PPLS |   TRNS |
 * |--------`------`------`------`------`------`------`------`------`------`------`--------|
 * | MUTE     | VOLD | VOLU | PREV | PLAY | NEXT | PAST |  P1  |  P2  |  P3  | PSLS | TRNS |
 * |----------`------`------`------`------`------'------`------`------`------`------`------|
 * | TRNS   |  TRNS  |  TRNS |      PENT      |     P0       |  PDOT |   MENU  |      TRNS |
 *  `-------+--------+-------+------^^^-------+-----^^^------+-------+---------+-----------'
 */

  [_L1] = KEYMAP( /* LAYER 1 */
/*,--------+-------+--------+--------+--------+--------+--------+--------+--------+--------+--------+-----------------.*/
    KC_CAPS,KC_PGUP,  KC_UP , KC_PGDN, KC_TRNS, KC_HOME, KC_UNDS,   KC_P7,   KC_P8,   KC_P9,  KC_EQL,       KC_TRNS   ,
/*|--------`-------`--------`--------`--------`--------`--------`--------`--------`--------`--------`-----------------|*/
    KC_TRNS  ,KC_LEFT, KC_DOWN, KC_RGHT,  KC_DEL,  KC_END, KC_PMNS,   KC_P4,   KC_P5,   KC_P6, KC_PPLS,     KC_TRNS   ,
/*|----------`-------`--------`--------`--------`--------`--------`--------`--------`--------`--------`---------------|*/
    KC_MUTE    ,KC_VOLD, KC_VOLU, KC_MPRV, KC_MPLY, KC_MNXT, KC_PAST,   KC_P1,   KC_P2,  KC_P3,  KC_PSLS,   KC_TRNS   ,
/*|------------`-------`--------`--------`--------`--------`--------`--------`--------`--------`--------`-------------|*/
    KC_TRNS, KC_TRNS ,  KC_TRNS,        KC_PENT       ,       KC_P0       ,  KC_PDOT  ,   KC_MENU   ,       KC_TRNS  ),
/*`--------+---------+---------+---------^^^----------+--------^^^--------+-----------+-------------+-----------------'*/

/* LAYER 2
 *
 * ,------+------+------+------+------+------+------+------+------+------+------+----------.
 * | TRNS  | F1  |  F2  |  F3  |  F4  |  F5  |  F6  |  F7  |  F8  |  F9  | F10  |      F11 |
 * |------`------`------`------`------`------`------`------`------`------`------`----------|
 * | `      |   1  |   2  |   3  |   4  |   5  |   6  |   7  |   8  |   9  |   0  |    F12 |
 * |--------`------`------`------`------`------`------`------`------`------`------`--------|
 * | ~        |   !  |   @  |   #  |   $  |   %  |   ^  |   &  |   *  |   (  |   )  | TRNS |
 * |----------`------`------`------`------`------'------`------`------`------`------`------|
 * | TRNS   |  TRNS  |  TRNS |     ENTER      |    SPACE     | TRNS  |   TRNS  |      TRNS |
 *  `-------+--------+-------+------^^^-------+-----^^^------+-------+---------+-----------'
 */

  [_L2] = KEYMAP( /* LAYER 2 */
/*,--------+-------+--------+--------+--------+--------+--------+--------+--------+--------+--------+-----------------.*/
    KC_TRNS,  KC_F1,   KC_F2,   KC_F3,   KC_F4,   KC_F5,   KC_F6,   KC_F7,   KC_F8,   KC_F9,  KC_F10,         KC_F11  ,
/*|--------`-------`--------`--------`--------`--------`--------`--------`--------`--------`--------`-----------------|*/
    KC_GRV   ,   KC_1,    KC_2,    KC_3,    KC_4,    KC_5,    KC_6,    KC_7,    KC_8,    KC_9,    KC_0,       KC_F12  ,
/*|----------`-------`--------`--------`--------`--------`--------`--------`--------`--------`--------`---------------|*/
    KC_TILD    ,KC_EXLM,   KC_AT, KC_HASH,  KC_DLR, KC_PERC, KC_CIRC, KC_AMPR, KC_ASTR, KC_LPRN, KC_RPRN,     KC_TRNS ,
/*|------------`-------`--------`--------`--------`--------`--------`--------`--------`--------`--------`-------------|*/
    KC_TRNS, KC_TRNS ,  KC_TRNS,        KC_ENT        ,       KC_SPC      ,   KC_TRNS ,   KC_TRNS   ,         KC_TRNS),
/*`--------+---------+---------+---------^^^----------+--------^^^--------+-----------+-------------+-----------------'*/
  
/* LAYER 3
 *
 * ,------+------+------+------+------+------+------+------+------+------+------+----------.
 * | Tab  |   Q  |   W  |   E  |   R  |   T  |   Y  | MLCK | M_UP | MRCK |   P  |     Bksp |
 * |------`------`------`------`------`------`------`------`------`------`------`----------|
 * | L1/Esc |   A  |   S  |   D  |   F  |   G  | MWUP | M_LT | M_DN | M_RT |   ;  |   L1/' |
 * |--------`------`------`------`------`------`------`------`------`------`------`--------|
 * | Shift    |   Z  |   X  |   C  |   V  |   B  | MWDN |   M  |   ,  |   .  |   /  |Sft/\ |
 * |----------`------`------`------`------`------'------`------`------`------`------`------|
 * | Ctrl   |   GUI  |  Alt  |     Enter      |    Space     |   L2  |    L5   |  Ctrl/Del |
 *  `-------+--------+-------+------^^^-------+-----^^^------+-------+---------+-----------'
 */

  [_L3] = KEYMAP( /* LAYER 3 */
/*,--------+-------+--------+--------+--------+--------+--------+--------+--------+--------+--------+-----------------.*/
    KC_TAB,   KC_Q,    KC_W,    KC_E,    KC_R,     KC_T,    KC_Y, KC_BTN1, KC_MS_U, KC_BTN2,    KC_P,       KC_BSPC   ,
/*|--------`-------`--------`--------`--------`--------`--------`--------`--------`--------`--------`-----------------|*/
 LT(1,KC_ESC),   KC_A,    KC_S,    KC_D,    KC_F,    KC_G, KC_WH_U, KC_MS_L, KC_MS_D, KC_MS_R, KC_SCLN,  LT(1,KC_QUOT),
/*|----------`-------`--------`--------`--------`--------`--------`--------`--------`--------`--------`---------------|*/
    KC_LSFT    ,   KC_Z,    KC_X,    KC_C,    KC_V,    KC_B, KC_WH_D,    KC_M, KC_COMM,  KC_DOT, KC_SLSH,SFT_T(KC_BSLS),
/*|------------`-------`--------`--------`--------`--------`--------`--------`--------`--------`--------`-------------|*/
    KC_LCTL, KC_LGUI ,  KC_LALT,     LT(4,KC_ENT)     ,    LT(3,KC_SPC)   ,    MO(2)  ,     MO(5)   ,   CTL_T(KC_DEL)),
/*`--------+---------+---------+---------^^^----------+--------^^^--------+-----------+-------------+-----------------'*/

/* LAYER 4
 *
 * ,------+------+------+------+------+------+------+------+------+------+------+----------.
 * | Tab  |   Q  |   W  |   E  |   R  |   T  |   Y  |   U  |   I  |   O  |   P  |     Bksp |
 * |------`------`------`------`------`------`------`------`------`------`------`----------|
 * | L1/Esc |   A  |   S  |   D  |   F  |   G  |   H  |   J  |   K  |   L  |   ;  |   L1/' |
 * |--------`------`------`------`------`------`------`------`------`------`------`--------|
 * | Shift    |   Z  |   X  |   C  |   V  |   B  |   N  |   M  |   ,  |   .  |   /  |Sft/\ |
 * |----------`------`------`------`------`------'------`------`------`------`------`------|
 * | Ctrl   |   GUI  |  Alt  |     Enter      |    Space     |   L2  |    L5   |  Ctrl/Del |
 *  `-------+--------+-------+------^^^-------+-----^^^------+-------+---------+-----------'
 */

  [_L4] = KEYMAP( /* LAYER 4 */
/*,--------+-------+--------+--------+--------+--------+--------+--------+--------+--------+--------+-----------------.*/
    KC_TAB,   KC_Q,    KC_W,    KC_E,    KC_R,    KC_T,    KC_Y,    KC_U,    KC_I,    KC_O,    KC_P,       KC_BSPC    ,
/*|--------`-------`--------`--------`--------`--------`--------`--------`--------`--------`--------`-----------------|*/
    LT(1,KC_ESC),KC_A,  KC_S,    KC_D,    KC_F,    KC_G,    KC_H,    KC_J,    KC_K,    KC_L, KC_SCLN,   LT(1,KC_QUOT) ,
/*|----------`-------`--------`--------`--------`--------`--------`--------`--------`--------`--------`---------------|*/
    KC_LSFT    ,   KC_Z,   KC_X,    KC_C,    KC_V,    KC_B,    KC_N,    KC_M, KC_COMM,  KC_DOT, KC_SLSH,SFT_T(KC_BSLS),
/*|------------`-------`--------`--------`--------`--------`--------`--------`--------`--------`--------`-------------|*/
    KC_LCTL, KC_LGUI ,  KC_LALT,     LT(4,KC_ENT)     ,    LT(3,KC_SPC)   ,    MO(2)  ,     MO(5)   ,   CTL_T(KC_DEL)),
/*`--------+---------+---------+---------^^^----------+--------^^^--------+-----------+-------------+-----------------'*/

/* LAYER 5
 *
 * ,------+------+------+------+------+------+------+------+------+------+------+----------.
 * | Tab  |   Q  |   W  |   E  |   R  |   T  |   Y  |   U  |   I  |   O  |   P  |     Bksp |
 * |------`------`------`------`------`------`------`------`------`------`------`----------|
 * | L1/Esc |   A  |   S  |   D  |   F  |   G  |   H  |   J  |   K  |   L  |   ;  |   L1/' |
 * |--------`------`------`------`------`------`------`------`------`------`------`--------|
 * | Shift    |   Z  |   X  |   C  |   V  |   B  |   N  |   M  |   ,  |   .  |   /  |Sft/\ |
 * |----------`------`------`------`------`------'------`------`------`------`------`------|
 * | Ctrl   |   GUI  |  Alt  |     Enter      |    Space     |   L2  |    L5   |  Ctrl/Del |
 *  `-------+--------+-------+------^^^-------+-----^^^------+-------+---------+-----------'
 */

  [_L5] = KEYMAP( /* LAYER 5 */
/*,--------+-------+--------+--------+--------+--------+--------+--------+--------+--------+--------+-----------------.*/
    KC_TAB,   KC_Q,    KC_W,    KC_E,    KC_R,    KC_T,    KC_Y,    KC_U,    KC_I,    KC_O,    KC_P,       KC_BSPC    ,
/*|--------`-------`--------`--------`--------`--------`--------`--------`--------`--------`--------`-----------------|*/
    LT(1,KC_ESC),KC_A,  KC_S,    KC_D,    KC_F,    KC_G,    KC_H,    KC_J,    KC_K,    KC_L, KC_SCLN,   LT(1,KC_QUOT) ,
/*|----------`-------`--------`--------`--------`--------`--------`--------`--------`--------`--------`---------------|*/
    KC_LSFT    ,   KC_Z,   KC_X,    KC_C,    KC_V,    KC_B,    KC_N,    KC_M, KC_COMM,  KC_DOT, KC_SLSH,SFT_T(KC_BSLS),
/*|------------`-------`--------`--------`--------`--------`--------`--------`--------`--------`--------`-------------|*/
    KC_LCTL, KC_LGUI ,  KC_LALT,     LT(4,KC_ENT)     ,    LT(3,KC_SPC)   ,    MO(2)  ,     MO(5)   ,   CTL_T(KC_DEL)),
/*`--------+---------+---------+---------^^^----------+--------^^^--------+-----------+-------------+-----------------'*/
};

const uint16_t PROGMEM fn_actions[] = {

};

void persistent_default_layer_set(uint16_t default_layer) {
  eeconfig_update_default_layer(default_layer);
  default_layer_set(default_layer);
}

const macro_t *action_get_macro(keyrecord_t *record, uint8_t id, uint8_t opt)
{
      switch(id) {
        case _DV:
          if (record->event.pressed) {
            persistent_default_layer_set(1UL<<_DV);
          }
          break;
        case _QW:
          if (record->event.pressed) {
            persistent_default_layer_set(1UL<<_QW);
          }
          break;
        case _CM:
          if (record->event.pressed) {
            persistent_default_layer_set(1UL<<_CM);
          }
          break;
      }
    return MACRO_NONE;
};
