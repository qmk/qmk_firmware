#include QMK_KEYBOARD_H

#define _QWERTY 0
#define _ARROWS 1
#define _SYMBOLS 2
#define _NUMPAD 3
#define _FUNPAD 4


const uint16_t PROGMEM keymaps[][MATRIX_ROWS][MATRIX_COLS] = {
/*
 * QWERTY
 * ,-----------------------------------------.                    ,-----------------------------------------.
 * |  `   |   1  |   2  |   3  |   4  |   5  |                    |   6  |   7  |   8  |   9  |   0  |  `   |
 * |------+------+------+------+------+------|                    |------+------+------+------+------+------|
 * | ESC  |   Q  |   W  |   E  |   R  |   T  |                    |   Y  |   U  |   I  |   O  |   P  | Bspc |
 * |------+------+------+------+------+------|                    |------+------+------+------+------+------|
 * | Tab  |   A  |   S  |   D  |   F  |   G  |-------.    ,-------|   H  |   J  |   K  |   L  |   ;  |  '   |
 * |------+------+------+------+------+------|       |    |       |------+------+------+------+------+------|
 * |LShift|   Z  |   X  |   C  |   V  |   B  |-------|    |-------|   N  |   M  |   ,  |   .  |   /  |RShift|
 * `-----------------------------------------/       /     \      \-----------------------------------------'
 *            | LGUI | LAlt | LCTR |LOWER | /Enter  /       \Space \  |RAISE | RCTR | RAlt | RGUI |
 *            |      |      |      |      |/       /         \      \ |      |      |      |      |
 *            `----------------------------------'           '------''---------------------------'
 */

[_QWERTY] = LAYOUT( \
  KC_ESC,   KC_1,   KC_2,    KC_3,    KC_0,    DM_PLY1,                                     DM_REC1,    DM_RSTP,    DM_PLY1,    _______,    _______,  TG(_NUMPAD), \
  _______,   KC_Q,   KC_W,    KC_E,    KC_R,    KC_T,                                       KC_Y,    KC_U,    KC_I,    KC_O,    KC_P,  KC_MINUS, \
  OSM(MOD_LSFT),   KC_A,   KC_S,    LT(_FUNPAD, KC_D),    LT(_NUMPAD, KC_F), KC_G,          KC_H,    KC_J,    KC_K,    KC_L, KC_SCLN,  OSM(MOD_RSFT), \
  KC_LALT,  KC_Z,   KC_X,    LGUI_T(KC_C),    KC_V,    KC_B, KC_MUTE,                           _______, KC_N, KC_M, RGUI_T(KC_COMM),  KC_DOT, KC_SLSH,  KC_BSLS, \
                 LSFT(KC_TAB),KC_TAB,LCTL_T(KC_DEL), LT(_ARROWS, KC_TAB), KC_ENT,           LT(_FUNPAD, KC_QUOT),  LT(_SYMBOLS, KC_SPC), RCTL_T(KC_BSPC), KC_BTN2, _______ \
),
/*
 * COLEMAK
 * ,-----------------------------------------.                    ,-----------------------------------------.
 * |  `   |   1  |   2  |   3  |   4  |   5  |                    |   6  |   7  |   8  |   9  |   0  |  `   |
 * |------+------+------+------+------+------|                    |------+------+------+------+------+------|
 * | ESC  |   Q  |   W  |   F  |   P  |   G  |                    |   J  |   L  |   U  |   Y  |   ;  | Bspc |
 * |------+------+------+------+------+------|                    |------+------+------+------+------+------|
 * | TAB  |   A  |   R  |   S  |   T  |   D  |-------.    ,-------|   H  |   N  |   E  |   I  |   O  |  '   |
 * |------+------+------+------+------+------|  MUTE |    |       |------+------+------+------+------+------|
 * |LShift|   Z  |   X  |   C  |   V  |   B  |-------|    |-------|   K  |   M  |   ,  |   .  |   /  |RShift|
 * `-----------------------------------------/       /     \      \-----------------------------------------'
 *            | LGUI | LAlt | LCTR |LOWER | /Enter  /       \Space \  |RAISE | RCTR | RAlt | RGUI |
 *            |      |      |      |      |/       /         \      \ |      |      |      |      |
 *            `----------------------------------'           '------''---------------------------'
 */

[_ARROWS] = LAYOUT( \
  _______,   _______,   _______,    _______,    _______,    _______,                        _______,    _______,    _______,    _______,    _______,  _______, \
  _______,   _______,   _______,    _______,    _______,    _______,                        KC_LABK,    	   KC_HOME,       KC_UP,            KC_END,           KC_LCBR,  _______, \
  _______,   KC_LCTL,   KC_LSFT,   KC_LALT,   KC_LGUI,    _______,                          KC_RABK,    	KC_LEFT,          KC_DOWN,          KC_RIGHT,         KC_RCBR,  _______, \
  _______,  _______,   _______,    _______,    _______,    _______, _______,        _______,_______,    KC_LEFT_PAREN,    KC_RIGHT_PAREN,   KC_LBRACKET,      KC_RBRACKET,  _______, \
                 _______,_______,_______,_______, _______,                          _______,  _______, _______, _______, _______ \
),
/* LOWER
 * ,-----------------------------------------.                    ,-----------------------------------------.
 * |      |  F1  |  F2  |  F3  |  F4  |  F5  |                    |  F6  |  F7  |  F8  |  F9  | F10  | F11  |
 * |------+------+------+------+------+------|                    |------+------+------+------+------+------|
 * |  `   |   1  |   2  |   3  |   4  |   5  |                    |   6  |   7  |   8  |   9  |   0  | F12  |
 * |------+------+------+------+------+------|                    |------+------+------+------+------+------|
 * | Tab  |   !  |   @  |   #  |   $  |   %  |-------.    ,-------|   ^  |   &  |   *  |   (  |   )  |   |  |
 * |------+------+------+------+------+------|  MUTE |    |       |------+------+------+------+------+------|
 * | Shift|  =   |  -   |  +   |   {  |   }  |-------|    |-------|   [  |   ]  |   ;  |   :  |   \  | Shift|
 * `-----------------------------------------/       /     \      \-----------------------------------------'
 *            | LGUI | LAlt | LCTR |LOWER | /Enter  /       \Space \  |RAISE | RCTR | RAlt | RGUI |
 *            |      |      |      |      |/       /         \      \ |      |      |      |      |
 *            `----------------------------------'           '------''---------------------------'
 */
[_SYMBOLS] = LAYOUT( \
  _______,   _______,   _______,   _______,   _______,   _______,                                                   _______,   _______,   _______,   _______,  _______,  _______,\
  KC_TILDE,  KC_GRAVE,  KC_PERCENT, KC_PIPE, KC_AMPR,  KC_EQUAL,               _______,    _______,    _______,    _______,    _______,  _______, \
  KC_CAPSLOCK, KC_EXCLAIM, KC_AT, KC_HASH, KC_DOLLAR, KC_RABK,                _______, _______, _______, _______, _______, _______, \
  _______, KC_CIRC, KC_ASTR, KC_UNDERSCORE, KC_PLUS, KC_MINUS, _______,           _______, _______, _______, _______, _______, _______, _______, \
                       _______, _______, _______, _______, _______,                                             _______, _______, _______, _______, _______\
),
/* RAISE
 * ,----------------------------------------.                    ,-----------------------------------------.
 * |      |      |      |      |      |      |                    |      |      |      |      |      |      |
 * |------+------+------+------+------+------|                    |------+------+------+------+------+------|
 * | Esc  | Ins  | Pscr | Menu |      |      |                    |      | PWrd |  Up  | NWrd | DLine| Bspc |
 * |------+------+------+------+------+------|                    |------+------+------+------+------+------|
 * | Tab  | LAt  | LCtl |LShift|      | Caps |-------.    ,-------|      | Left | Down | Rigth|  Del | Bspc |
 * |------+------+------+------+------+------|  MUTE  |    |       |------+------+------+------+------+------|
 * |Shift | Undo |  Cut | Copy | Paste|      |-------|    |-------|      | LStr |      | LEnd |      | Shift|
 * `-----------------------------------------/       /     \      \-----------------------------------------'
 *            | LGUI | LAlt | LCTR |LOWER | /Enter  /       \Space \  |RAISE | RCTR | RAlt | RGUI |
 *            |      |      |      |      |/       /         \      \ |      |      |      |      |
 *            `----------------------------------'           '------''---------------------------'
 */
[_NUMPAD] = LAYOUT( \
  KC_ESC,  			   KC_1,    	      KC_2,          KC_3,             KC_4,             KC_5,                          _______,  _______  , _______,  _______ ,  _______ ,TG(_NUMPAD), \
  _______,  			KC_TAB,    		KC_Q,    		   KC_W,    		KC_E,    			KC_R,                       _______, KC_7,    		   KC_8,    	      KC_9,    	   SGUI(KC_S), _______, \
  _______, 			   KC_LCTL,    		KC_A,    		   KC_S,    		KC_D,    	      KC_F,                         _______,  KC_4,    		   KC_5,    	      KC_6,  _______, _______, \
  _______, 			   KC_Z,    		KC_X, 	         KC_C, 	  	   KC_V, 			   KC_B,  _______,          _______,  _______, KC_1,    		   KC_2, 		      KC_3,   _______, _______, \
                         _______, _______, KC_ENT, KC_SPC, KC_LCTL,                                                 _______, KC_MINUS, KC_KP_0, _______, _______ \
),
/* ADJUST
 * ,-----------------------------------------.                    ,-----------------------------------------.
 * |      |      |      |      |      |      |                    |      |      |      |      |      |      |
 * |------+------+------+------+------+------|                    |------+------+------+------+------+------|
 * | RESET|      |QWERTY|COLEMAK|      |      |                    |      |      |      |      |      |      |
 * |------+------+------+------+------+------|                    |------+------+------+------+------+------|
 * |      |      |MACWIN|      |      |      |-------.    ,-------|      | VOLDO| MUTE | VOLUP|      |      |
 * |------+------+------+------+------+------|  MUTE |    |       |------+------+------+------+------+------|
 * |      |      |      |      |      |      |-------|    |-------|      | PREV | PLAY | NEXT |      |      |
 * `-----------------------------------------/       /     \      \-----------------------------------------'
 *            | LGUI | LAlt | LCTR |LOWER | /Enter  /       \Space \  |RAISE | RCTR | RAlt | RGUI |
 *            |      |      |      |      |/       /         \      \ |      |      |      |      |
 *            `----------------------------------'           '------''---------------------------'
 */
  [_FUNPAD] = LAYOUT( \
  RESET, _______,  _______,  _______, _______, _______,                     _______, _______, _______, _______, _______, _______, \
  _______, _______,_______,KC_BRID,KC_BRIU,_______,                     _______, KC_F7,            KC_F8,         KC_F9,            KC_F10,           KC_F11, \
  _______, _______,KC_MPRV, KC_MPLY,    KC_MNXT,  _______,                     _______, KC_F4,            KC_F5,         KC_F6, _______, _______, \
  _______, _______, _______, KC_VOLD,    KC_VOLU,  _______, _______,     _______, _______, KC_F1,            KC_F2,         KC_F3, _______, _______, \
                   _______, _______, _______, _______, _______,     _______, _______, _______, _______, _______ \
  )
};

#ifdef OLED_DRIVER_ENABLE

static void render_logo(void) {
    static const char PROGMEM qmk_logo[] = {
        0x80,0x81,0x82,0x83,0x84,0x85,0x86,0x87,0x88,0x89,0x8a,0x8b,0x8c,0x8d,0x8e,0x8f,0x90,0x91,0x92,0x93,0x94,
        0xa0,0xa1,0xa2,0xa3,0xa4,0xa5,0xa6,0xa7,0xa8,0xa9,0xaa,0xab,0xac,0xad,0xae,0xaf,0xb0,0xb1,0xb2,0xb3,0xb4,
        0xc0,0xc1,0xc2,0xc3,0xc4,0xc5,0xc6,0xc7,0xc8,0xc9,0xca,0xcb,0xcc,0xcd,0xce,0xcf,0xd0,0xd1,0xd2,0xd3,0xd4,0
    };

    oled_write_P(qmk_logo, false);
}

oled_rotation_t oled_init_user(oled_rotation_t rotation) {
    if (is_keyboard_master()) {
        return OLED_ROTATION_180;
    }
    return rotation;
}

void oled_task_user(void) {
    if (is_keyboard_master()) {
        render_logo();
    } else {
        render_logo();
    }
}

#endif

bool process_record_user(uint16_t keycode, keyrecord_t *record) {
    switch (keycode) {
        
    }

    return true;
}

#ifdef ENCODER_ENABLE

void encoder_update_user(uint8_t index, bool clockwise) {
    if (index == 0) {
        if (clockwise) {
            tap_code(KC_VOLU);
        } else {
            tap_code(KC_VOLD);
        }
    } else if (index == 1) {
        if (clockwise) {
            tap_code(KC_PGDOWN);
        } else {
            tap_code(KC_PGUP);
        }
    }
}

#endif
