/* Copyright 2022 JannikB5825
 *
 * This program is free software: you can redistribute it and/or modify
 * it under the terms of the GNU General Public License as published by
 * the Free Software Foundation, either version 2 of the License, or
 * (at your option) any later version.
 *
 * This program is distributed in the hope that it will be useful,
 * but WITHOUT ANY WARRANTY; without even the implied warranty of
 * MERCHANTABILITY or FITNESS FOR A PARTICULAR PURPOSE.  See the
 * GNU General Public License for more details.
 *
 * You should have received a copy of the GNU General Public License
 * along with this program.  If not, see <http://www.gnu.org/licenses/>.
 */
#include QMK_KEYBOARD_H

const uint16_t PROGMEM keymaps[][MATRIX_ROWS][MATRIX_COLS] = {

    [0] = LAYOUT(
        KC_ESC,  KC_1,    KC_2,    KC_3,    KC_4,    KC_5,    KC_6,    KC_7,    KC_8,    KC_9,    KC_0,    KC_MINS,          KC_BSPC,
        KC_TAB,  KC_Q,    KC_W,    KC_E,    KC_R,    KC_T,    KC_Z,    KC_U,    KC_I,    KC_O,    KC_P,    KC_RBRC, KC_LBRC, KC_BSLS,
        KC_CAPS, KC_A,    KC_S,    KC_D,    KC_F,    KC_G,    KC_H,    KC_J,    KC_K,    KC_L,    KC_SCLN, KC_QUOT,          KC_ENT,
        KC_LSFT,          KC_Y,    KC_X,    KC_C,    KC_V,    KC_B,    KC_N,    KC_M,    KC_DOT,  KC_COMM, KC_SLSH, KC_UP,   KC_EQL,
        KC_LCTL, KC_LGUI, KC_LALT,                   KC_SPC,  MO(1),   KC_SPC,           KC_RALT, KC_RCTL, KC_LEFT, KC_DOWN, KC_RGHT),

    [1] = LAYOUT(
        KC_ESC,  KC_F1,   KC_F2,   KC_F3,   KC_F4,   KC_F5,   KC_F6,   KC_F7,   KC_F8,   KC_F9,   KC_F10,  KC_F11,           KC_BSPC,
        KC_TAB,  KC_Q,    KC_W,    KC_E,    KC_R,    KC_T,    KC_Z,    KC_U,    KC_I,    KC_O,    KC_P,    KC_RBRC, KC_LBRC, KC_BSLS,
        KC_CAPS, KC_A,    KC_S,    KC_D,    KC_F,    KC_G,    KC_H,    KC_J,    KC_K,    KC_L,    KC_SCLN, KC_QUOT,          KC_ENT,
        KC_LSFT,          KC_Y,    KC_X,    KC_C,    KC_V,    KC_B,    KC_N,    KC_M,    KC_DOT,  KC_COMM, KC_SLSH, KC_UP,   KC_DEL,
        KC_LCTL, KC_LGUI, KC_LALT,                   KC_SPC,  MO(1),   KC_SPC,           KC_RALT, KC_RCTL, KC_LEFT, KC_DOWN, KC_RGHT)


};
#ifdef OLED_ENABLE

oled_rotation_t oled_init_user(oled_rotation_t rotation) {
    return OLED_ROTATION_0;
}
//full credit goes to https://www.reddit.com/user/Pop-X-/ only small feature comforts were added

#define IDLE_FRAMES 5
#define IDLE_SPEED 30 // below this wpm value your animation will idle
#define TAP_FRAMES 2
#define TAP_SPEED 60 // above this wpm value typing animation to triggere

#define ANIM_FRAME_DURATION 200 // how long each frame lasts in ms
#define ANIM_SIZE 636 // number of bytes in array, minimize for adequate firmware size, max is 1024

uint32_t anim_timer = 0;
uint32_t anim_sleep = 0;
uint8_t current_idle_frame = 0;
uint8_t current_tap_frame = 0;

// Images credit j-inc(/James Incandenza) and pixelbenny. Credit to obosob for initial animation approach.
static void render_anim(void) {
    static const char PROGMEM idle[IDLE_FRAMES][ANIM_SIZE] = {
        {
        0,  0,  0,  0,  0,  0,  0,  0,  0,  0,  0,  0,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128,
        0,  0,  0,  0,  0,  0,  0,  0,  0,  0,  0,  0,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  0,
        0,  0,  0,  0,  0,  0,  0,  0,  0,  0,  0,  0,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  0,
         0,  0,  0,  0,  0,  0,  0,  0,  0,  0,  0,  0,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  0,
        32, 16, 16, 16, 16,  8,  8,  8,  8,  4,  4,  4,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  8
        },
        {
        0,  0,  0,  0,  0,  0,  0,  0,  0,  0,  0,  0,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128,
        0,  0,  0,  0,  0,  0,  0,  0,  0,  0,  0,  0,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  0,
        0,  0,  0,  0,  0,  0,  0,  0,  0,  0,  0,  0,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  0,
         0,  0,  0,  0,  0,  0,  0,  0,  0,  0,  0,  0,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  0,
        32, 16, 16, 16, 16,  8,  8,  8,  8,  4,  4,  4,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  8
        },
        {
        0,  0,  0,  0,  0,  0,  0,  0,  0,  0,  0,  0,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128,
        0,  0,  0,  0,  0,  0,  0,  0,  0,  0,  0,  0,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  0,
        0,  0,  0,  0,  0,  0,  0,  0,  0,  0,  0,  0,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  0,
         0,  0,  0,  0,  0,  0,  0,  0,  0,  0,  0,  0,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  0,
        32, 16, 16, 16, 16,  8,  8,  8,  8,  4,  4,  4,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  8
        },
        {
        0,  0,  0,  0,  0,  0,  0,  0,  0,  0,  0,  0,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128,
        0,  0,  0,  0,  0,  0,  0,  0,  0,  0,  0,  0,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  0,
        0,  0,  0,  0,  0,  0,  0,  0,  0,  0,  0,  0,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  0,
         0,  0,  0,  0,  0,  0,  0,  0,  0,  0,  0,  0,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  0,
        32, 16, 16, 16, 16,  8,  8,  8,  8,  4,  4,  4,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  8
        },
        {
        0,  0,  0,  0,  0,  0,  0,  0,  0,  0,  0,  0,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128,
        0,  0,  0,  0,  0,  0,  0,  0,  0,  0,  0,  0,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  0,
        0,  0,  0,  0,  0,  0,  0,  0,  0,  0,  0,  0,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  0,
         0,  0,  0,  0,  0,  0,  0,  0,  0,  0,  0,  0,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  0,
        32, 16, 16, 16, 16,  8,  8,  8,  8,  4,  4,  4,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  8
        }
    };
    static const char PROGMEM prep[][ANIM_SIZE] = {
        {
        0,  0,  0,  0,  0,  0,  0,  0,  0,  0,  0,  0,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128,
        0,  0,  0,  0,  0,  0,  0,  0,  0,  0,  0,  0,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  0,
        0,  0,  0,  0,  0,  0,  0,  0,  0,  0,  0,  0,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  0,
         0,  0,  0,  0,  0,  0,  0,  0,  0,  0,  0,  0,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  0,
        32, 16, 16, 16, 16,  8,  8,  8,  8,  4,  4,  4,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  8
        }
    };
    static const char PROGMEM tap[TAP_FRAMES][ANIM_SIZE] = {
        {
        0,  0,  0,  0,  0,  0,  0,  0,  0,  0,  0,  0,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128,
        0,  0,  0,  0,  0,  0,  0,  0,  0,  0,  0,  0,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  0,
        0,  0,  0,  0,  0,  0,  0,  0,  0,  0,  0,  0,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  0,
         0,  0,  0,  0,  0,  0,  0,  0,  0,  0,  0,  0,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  0,
        32, 16, 16, 16, 16,  8,  8,  8,  8,  4,  4,  4,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  8
        },
        {
        0,  0,  0,  0,  0,  0,  0,  0,  0,  0,  0,  0,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128,
        0,  0,  0,  0,  0,  0,  0,  0,  0,  0,  0,  0,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  0,
        0,  0,  0,  0,  0,  0,  0,  0,  0,  0,  0,  0,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  0,
         0,  0,  0,  0,  0,  0,  0,  0,  0,  0,  0,  0,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  0,
        32, 16, 16, 16, 16,  8,  8,  8,  8,  4,  4,  4,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  8
        },
    };

    //assumes 1 frame prep stage
    void animation_phase(void) {
        if(get_current_wpm() <=IDLE_SPEED){
            current_idle_frame = (current_idle_frame + 1) % IDLE_FRAMES;
            oled_write_raw_P(idle[abs((IDLE_FRAMES-1)-current_idle_frame)], ANIM_SIZE);
         }
         if(get_current_wpm() >IDLE_SPEED && get_current_wpm() <TAP_SPEED){
             oled_write_raw_P(prep[0], ANIM_SIZE);
         }
         if(get_current_wpm() >=TAP_SPEED){
             current_tap_frame = (current_tap_frame + 1) % TAP_FRAMES;
             oled_write_raw_P(tap[abs((TAP_FRAMES-1)-current_tap_frame)], ANIM_SIZE);
         }
    }
    if(get_current_wpm() != 000) {
        oled_on();
        if(timer_elapsed32(anim_timer) > ANIM_FRAME_DURATION) {
            anim_timer = timer_read32();
            animation_phase();
        }
        anim_sleep = timer_read32();
    } else {
        if(timer_elapsed32(anim_sleep) > OLED_TIMEOUT) {
            oled_off();
        } else {
            if(timer_elapsed32(anim_timer) > ANIM_FRAME_DURATION) {
                anim_timer = timer_read32();
                animation_phase();
            }
        }
    }
}


bool oled_task_user(void) {
    render_anim();
    oled_set_cursor(0,6);
    oled_write_P(PSTR("       WPM: "), false);
    oled_write(get_u8_str(get_current_wpm(), '0'), false);
    if(host_keyboard_led_state().caps_lock){
        oled_set_cursor(0,5);
        oled_write_P(PSTR("      CAPS  LOCK"), false);
    }
    else{
        oled_set_cursor(0,5);
        oled_write_P(PSTR("                 "), false);
    }
    return false;
}
#endif
