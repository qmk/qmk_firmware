/*
Copyright 2022 Joe Scotto

This program is free software: you can redistribute it and/or modify
it under the terms of the GNU General Public License as published by
the Free Software Foundation, either version 2 of the License, or
(at your option) any later version.

This program is distributed in the hope that it will be useful,
but WITHOUT ANY WARRANTY; without even the implied warranty of
MERCHANTABILITY or FITNESS FOR A PARTICULAR PURPOSE. See the
GNU General Public License for more details.

You should have received a copy of the GNU General Public License
along with this program.  If not, see <http://www.gnu.org/licenses/>.
*/

#include QMK_KEYBOARD_H

#include <stdio.h>
char wpm_str[10];

// Tap Dance declarations
enum {
    TD_ESC_SPOTLIGHT_EMOJI,
    TD_ESC_WINDOWS_EMOJI
};

void td_esc_spotlight_emoji (tap_dance_state_t *state, void *user_data) {
    if (state->count == 1) {
        tap_code(KC_ESC);
    } else if (state->count == 2) {
        tap_code16(G(KC_SPC));
    } else if (state->count == 3) {
        tap_code16(C(G(KC_SPC)));
    }
}

void td_esc_windows_emoji (tap_dance_state_t *state, void *user_data) {
    if (state->count == 1) {
        tap_code(KC_ESC);
    } else if (state->count == 2) {
        tap_code(KC_LGUI);
    } else if (state->count == 3) {
        tap_code16(G(KC_DOT));
    }
};

 // Tap Dance definitions
tap_dance_action_t tap_dance_actions[] = {
    [TD_ESC_SPOTLIGHT_EMOJI] = ACTION_TAP_DANCE_FN(td_esc_spotlight_emoji),
    [TD_ESC_WINDOWS_EMOJI] = ACTION_TAP_DANCE_FN(td_esc_windows_emoji)
};

uint16_t get_tapping_term(uint16_t keycode, keyrecord_t *record) {
    switch (keycode) {
        case TD(TD_ESC_SPOTLIGHT_EMOJI) :
        case TD(TD_ESC_WINDOWS_EMOJI) :
        case LGUI_T(KC_SPC) :
        case LT(1, KC_TAB) :
        case LT(2, KC_ENT) :
      return 200;
    default:
      return TAPPING_TERM;
  }
};

// Layer Names
enum layer_names {
    _MAC_DEFAULT,
    _MAC_CODE,
    _MAC_NUM,
    _MAC_FUNC,
    _WIN_DEFAULT,
    _WIN_CODE,
    _WIN_NUM,
    _WIN_FUNC
};

const uint16_t PROGMEM keymaps[][MATRIX_ROWS][MATRIX_COLS] = {
    [0] = LAYOUT_ortho_4_3x10_4(
                                                                      KC_LCTL, KC_2,     KC_3,          TD(TD_ESC_SPOTLIGHT_EMOJI),
        KC_TAB, KC_Q,         KC_W, KC_F, KC_P, KC_G,           KC_J, KC_L,    KC_U,     KC_Y,          KC_BSPC,
        KC_ENT, KC_A,         KC_R, KC_S, KC_T, KC_D,           KC_H, KC_N,    KC_E,     KC_I,          KC_O,
                LSFT_T(KC_Z), KC_X, KC_C, KC_V, KC_B,           KC_K, KC_M,    KC_COMMA, KC_DOT,        RSFT_T(KC_SLSH),
                KC_LALT,                        LGUI_T(KC_SPC),                          LT(1, KC_TAB), LT(2, KC_ENT)
    ),
    [1] = LAYOUT_ortho_4_3x10_4(
                                                                                      KC_LCTL, KC_2,    KC_3,    TD(TD_ESC_SPOTLIGHT_EMOJI),
        KC_TAB, KC_UNDS,         KC_MINS, KC_PLUS, KC_EQL,  KC_COLN,        KC_GRV,   KC_MRWD, KC_MPLY, KC_MFFD, KC_DEL,
        KC_ENT, KC_LCBR,         KC_LPRN, KC_RPRN, KC_RCBR, KC_PIPE,        KC_ESC,   KC_LEFT, KC_UP,   KC_DOWN, KC_RGHT,
                LSFT_T(KC_LBRC), KC_QUOT, KC_DQUO, KC_RBRC, KC_SCLN,        KC_TILDE, KC_VOLD, KC_MUTE, KC_VOLU, RSFT_T(KC_BSLS),
                KC_LALT,                                    LGUI_T(KC_SPC),                             KC_TRNS, KC_TRNS
    ),
    [2] = LAYOUT_ortho_4_3x10_4(
                                                                          KC_LCTL, KC_2,    KC_3,    TD(TD_ESC_SPOTLIGHT_EMOJI),
        KC_TAB, KC_EXLM, KC_AT, KC_HASH, KC_DLR, KC_PERC,        KC_CIRC, KC_AMPR, KC_ASTR, KC_CAPS, KC_BSPC,
        KC_ENT, KC_1,    KC_2,  KC_3,    KC_4,   KC_5,           KC_6,    KC_7,    KC_8,    KC_9,    KC_0,
                KC_LSFT, KC_NO, KC_NO,   KC_NO,  MO(3),          KC_NO,   KC_NO,   KC_COMM, KC_DOT,  RSFT_T(KC_SLSH),
                KC_LALT,                         LGUI_T(KC_SPC),                            KC_TRNS, KC_TRNS
    ),
    [3] = LAYOUT_ortho_4_3x10_4(
                                                                         KC_LCTL, KC_2,  KC_3,    TD(TD_ESC_SPOTLIGHT_EMOJI),
        KC_TAB, KC_NO,   KC_NO, KC_NO, KC_NO,   KC_NO,            KC_NO, KC_NO,   KC_NO, KC_NO,   TO(4),
        KC_ENT, KC_F1,   KC_F2, KC_F3, KC_F4,   KC_F5,            KC_F6, KC_F7,   KC_F8, KC_F9,   KC_F10,
                KC_F11,  KC_NO, KC_NO, QK_BOOT, KC_TRNS,          KC_NO, KC_NO,   KC_NO, KC_NO,   KC_F12,
                KC_LALT,                          LGUI_T(KC_SPC),                        KC_TRNS, KC_TRNS
     ),
     [4] = LAYOUT_ortho_4_3x10_4(
                                                              KC_1, KC_2,     KC_3,          TD(TD_ESC_WINDOWS_EMOJI),
        KC_TAB, KC_Q,         KC_W, KC_F, KC_P, KC_G,   KC_J, KC_L, KC_U,     KC_Y,          KC_BSPC,
        KC_ENT, KC_A,         KC_R, KC_S, KC_T, KC_D,   KC_H, KC_N, KC_E,     KC_I,          KC_O,
                LSFT_T(KC_Z), KC_X, KC_C, KC_V, KC_B,   KC_K, KC_M, KC_COMMA, KC_DOT,        RSFT_T(KC_SLSH),
                KC_LCTL,                        KC_SPC,                       LT(5, KC_TAB), LT(6, KC_ENT)
    ),
    [5] = LAYOUT_ortho_4_3x10_4(
                                                                               KC_1,    KC_2,    KC_3,    TD(TD_ESC_WINDOWS_EMOJI),
        KC_TAB, KC_UNDS,         KC_MINS, KC_PLUS, KC_EQL,  KC_COLN, KC_GRV,   KC_MRWD, KC_MPLY, KC_MFFD, KC_DEL,
        KC_ENT, KC_LCBR,         KC_LPRN, KC_RPRN, KC_RCBR, KC_PIPE, KC_ESC,   KC_LEFT, KC_UP,   KC_DOWN, KC_RGHT,
                LSFT_T(KC_LBRC), KC_QUOT, KC_DQUO, KC_RBRC, KC_SCLN, KC_TILDE, KC_VOLD, KC_MUTE, KC_VOLU, RSFT_T(KC_BSLS),
                KC_LCTL,                                    KC_SPC,                              KC_TRNS, KC_TRNS
    ),
    [6] = LAYOUT_ortho_4_3x10_4(
                                                                   KC_1,    KC_2,    KC_3,    TD(TD_ESC_WINDOWS_EMOJI),
        KC_TAB, KC_EXLM, KC_AT, KC_HASH, KC_DLR, KC_PERC, KC_CIRC, KC_AMPR, KC_ASTR, KC_CAPS, KC_BSPC,
        KC_ENT, KC_1,    KC_2,  KC_3,    KC_4,   KC_5,    KC_6,    KC_7,    KC_8,    KC_9,    KC_0,
                KC_LSFT, KC_NO, KC_NO,   KC_NO,  MO(7),   KC_NO,   KC_NO,   KC_COMM, KC_DOT,  RSFT_T(KC_SLSH),
                KC_LCTL,                         KC_SPC,                             KC_TRNS, KC_TRNS
    ),
    [7] = LAYOUT_ortho_4_3x10_4(
                                                                KC_1,  KC_2,  KC_3,    TD(TD_ESC_WINDOWS_EMOJI),
        KC_TAB, KC_NO,   KC_NO, KC_NO, KC_NO,   KC_NO,   KC_NO, KC_NO, KC_NO, KC_NO,   TO(0),
        KC_ENT, KC_F1,   KC_F2, KC_F3, KC_F4,   KC_F5,   KC_F6, KC_F7, KC_F8, KC_F9,   KC_F10,
                KC_F11,  KC_NO, KC_NO, QK_BOOT, KC_TRNS, KC_NO, KC_NO, KC_NO, KC_NO,   KC_F12,
                KC_LCTL,                        KC_SPC,                       KC_TRNS, KC_TRNS
     )
};

// OLED
#ifdef OLED_ENABLE
// WPM responsiveness
#define IDLE_FRAMES              5   // How many idle frames in animation
#define IDLE_SPEED               20  // Speed at which animation idles
#define TAP_FRAMES               2   // How many tapping frames
#define TAP_SPEED                40  // WPM to trigger Bongo
#define ANIMATION_FRAME_DURATION 200 // MS duration of each frame
#define ANIMATION_SIZE           256 // Number of bytes per animation frame

uint32_t anim_timer         = 0;
uint32_t anim_sleep         = 0;
uint8_t  current_idle_frame = 0;
uint8_t current_tap_frame   = 0;

static void render_animation(void) {
    static const char PROGMEM idle[IDLE_FRAMES][ANIMATION_SIZE] = {
        { 
            0x00, 0x00, 0x00, 0x00, 0x00, 0x00, 0x00, 0x00, 0x00, 0x00, 0x00, 0x00, 0x00, 0x00, 0x00, 0x00, 
            0x00, 0x00, 0x00, 0x00, 0x00, 0x80, 0x80, 0x40, 0x40, 0x40, 0x20, 0x20, 0x20, 0x20, 0x20, 0x18, 
            0x04, 0x02, 0x01, 0x02, 0x04, 0x08, 0x10, 0x20, 0x20, 0x40, 0x40, 0x80, 0x80, 0x00, 0x00, 0x00, 
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            0x00, 0x00, 0x00, 0x00, 0x01, 0x01, 0x01, 0x00, 0x00, 0x00, 0x00, 0x00, 0x00, 0x00, 0x00, 0x00
        },
        { 
            0x00, 0x00, 0x00, 0x00, 0x00, 0x00, 0x00, 0x00, 0x00, 0x00, 0x00, 0x00, 0x00, 0x00, 0x00, 0x00, 
            0x00, 0x00, 0x00, 0x00, 0x00, 0x00, 0x00, 0x00, 0x80, 0x80, 0x80, 0x80, 0x40, 0x40, 0x20, 0x10, 
            0x08, 0x04, 0x02, 0x04, 0x08, 0x10, 0x20, 0x40, 0x80, 0x80, 0x00, 0x00, 0x00, 0x00, 0x00, 0x00, 
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            0x00, 0x00, 0x00, 0x00, 0x01, 0x01, 0x01, 0x00, 0x00, 0x00, 0x00, 0x00, 0x00, 0x00, 0x00, 0x00
        },
        { 
            0x00, 0x00, 0x00, 0x00, 0x00, 0x00, 0x00, 0x00, 0x00, 0x00, 0x00, 0x00, 0x00, 0x00, 0x00, 0x00, 
            0x00, 0x00, 0x00, 0x00, 0x00, 0x00, 0x00, 0x00, 0x80, 0x80, 0x80, 0x80, 0x40, 0x40, 0x20, 0x10, 
            0x08, 0x04, 0x02, 0x04, 0x08, 0x10, 0x20, 0x40, 0x80, 0x80, 0x00, 0x00, 0x00, 0x00, 0x00, 0x00, 
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            0x00, 0x00, 0x00, 0x00, 0x01, 0x01, 0x01, 0x00, 0x00, 0x00, 0x00, 0x00, 0x00, 0x00, 0x00, 0x00
        },
        { 
            0x00, 0x00, 0x00, 0x00, 0x00, 0x00, 0x00, 0x00, 0x00, 0x00, 0x00, 0x00, 0x00, 0x00, 0x00, 0x00, 
            0x00, 0x00, 0x00, 0x00, 0x00, 0x00, 0x00, 0x00, 0x80, 0x80, 0x40, 0x40, 0x40, 0x20, 0x10, 0x08, 
            0x04, 0x02, 0x01, 0x02, 0x04, 0x08, 0x10, 0x20, 0x40, 0x80, 0x80, 0x00, 0x00, 0x00, 0x00, 0x00, 
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            0x00, 0x00, 0x00, 0x00, 0x01, 0x01, 0x01, 0x00, 0x00, 0x00, 0x00, 0x00, 0x00, 0x00, 0x00, 0x00
        },
        { 
            0x00, 0x00, 0x00, 0x00, 0x00, 0x00, 0x00, 0x00, 0x00, 0x00, 0x00, 0x00, 0x00, 0x00, 0x00, 0x00, 
            0x00, 0x00, 0x00, 0x00, 0x00, 0x80, 0x80, 0x40, 0x40, 0x40, 0x20, 0x20, 0x20, 0x20, 0x20, 0x18, 
            0x04, 0x02, 0x01, 0x02, 0x04, 0x08, 0x10, 0x20, 0x20, 0x40, 0x40, 0x80, 0x80, 0x00, 0x00, 0x00, 
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            0x00, 0x00, 0x00, 0x00, 0x01, 0x01, 0x01, 0x00, 0x00, 0x00, 0x00, 0x00, 0x00, 0x00, 0x00, 0x00
        }
    };
    static const char PROGMEM prep[][ANIMATION_SIZE] = {
        {
            0x00, 0x00, 0x00, 0x00, 0x00, 0x00, 0x00, 0x00, 0x00, 0x00, 0x00, 0x00, 0x00, 0x00, 0x00, 0x00, 
            0x00, 0x00, 0x00, 0x00, 0x00, 0x00, 0x00, 0x00, 0x80, 0x80, 0x80, 0x40, 0x40, 0x20, 0x20, 0x10, 
            0x08, 0x04, 0x02, 0x04, 0x08, 0x10, 0x10, 0x20, 0x20, 0x40, 0x40, 0x80, 0x80, 0x00, 0x00, 0x00, 
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            0x00, 0x00, 0x00, 0x00, 0x00, 0x00, 0x00, 0x00, 0x00, 0x00, 0x00, 0x00, 0x00, 0x00, 0x00, 0x00
        }
    };
    static const char PROGMEM tap[TAP_FRAMES][ANIMATION_SIZE] = {
        {
            0x00, 0x00, 0x00, 0x00, 0x00, 0x00, 0x00, 0x00, 0x00, 0x00, 0x00, 0x00, 0x00, 0x00, 0x00, 0x00, 
            0x00, 0x00, 0x00, 0x00, 0x00, 0x00, 0x00, 0x00, 0x80, 0x80, 0x80, 0x40, 0x40, 0x20, 0x20, 0x10, 
            0x08, 0x04, 0x02, 0x04, 0x08, 0x10, 0x10, 0x20, 0x20, 0x40, 0x40, 0x80, 0x80, 0x00, 0x00, 0x00, 
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            0x00, 0x00, 0x00, 0x00, 0x00, 0x00, 0x00, 0x00, 0x00, 0x00, 0x00, 0x00, 0x00, 0x00, 0x00, 0x00
        },
        {
            0x00, 0x00, 0x00, 0x00, 0x00, 0x00, 0x00, 0x00, 0x00, 0x00, 0x00, 0x00, 0x00, 0x00, 0x00, 0x00, 
            0x00, 0x00, 0x00, 0x00, 0x00, 0x00, 0x00, 0x00, 0x80, 0x80, 0x80, 0x40, 0x40, 0x20, 0x20, 0x10, 
            0x08, 0x04, 0x02, 0x04, 0x08, 0x10, 0x10, 0x20, 0x20, 0x40, 0x40, 0x80, 0x80, 0x00, 0x00, 0x00, 
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            0xf0, 0xf8, 0xfc, 0x60, 0x01, 0x01, 0x01, 0x3c, 0x78, 0xf8, 0xf0, 0x70, 0x00, 0x00, 0x00, 0x00
        }
    };

    void animation_phase(void) {
        // Set cursor to draw from the bottom up
        oled_set_cursor(128, 0);

        if (get_current_wpm() <= IDLE_SPEED) {
            current_idle_frame = (current_idle_frame + 1) % IDLE_FRAMES;
            oled_write_raw_P(idle[abs((IDLE_FRAMES - 1) - current_idle_frame)], ANIMATION_SIZE);
        }

        // Start prep image
        if (get_current_wpm() > IDLE_SPEED && get_current_wpm() < TAP_SPEED) {
            oled_write_raw_P(prep[0], ANIMATION_SIZE);
        }

        // Start tap animation
        if (get_current_wpm() >= TAP_SPEED) {
            current_tap_frame = (current_tap_frame + 1) % TAP_FRAMES;
            oled_write_raw_P(tap[abs((TAP_FRAMES - 1) - current_tap_frame)], ANIMATION_SIZE);
        }
    }
    if (get_current_wpm() != 000) {
        oled_on();  // Enables OLED on any alpha keypress

        if (timer_elapsed32(anim_timer) > ANIMATION_FRAME_DURATION) {
            anim_timer = timer_read32();
            animation_phase();
        }

        anim_sleep = timer_read32();
    } else {
        if (timer_elapsed32(anim_sleep) > OLED_TIMEOUT) {
            oled_off();
        } else {
            if (timer_elapsed32(anim_timer) > ANIMATION_FRAME_DURATION) {
                anim_timer = timer_read32();
                animation_phase();
            }
        }
    }
}

// Draw to OLED
bool oled_task_user(void) {
    // Caps lock text
    led_t led_state = host_keyboard_led_state();
    oled_set_cursor(0,1);
    oled_write_P(led_state.caps_lock ? PSTR(" Caps Lock "): PSTR(" ScottoCMD "), false);

    //WPM text
    oled_set_cursor(0, 9);
    oled_write(get_u8_str(get_current_wpm(), '0'), false);
    oled_write_P(PSTR(" WPM"), false);
    
    static const char PROGMEM logos[][256] = {
            // Apple
            {
                0x00, 0x00, 0x00, 0x00, 0x00, 0x00, 0x00, 0x00, 0x00, 0x00, 0x00, 0x00, 0x00, 0x00, 0x00, 0x00, 
                0x00, 0x00, 0x00, 0x00, 0x00, 0x00, 0x00, 0x00, 0x00, 0x00, 0x00, 0x00, 0x00, 0x00, 0x00, 0x00, 
                0x70, 0x78, 0x7c, 0x3e, 0x1f, 0x0f, 0x00, 0x00, 0x00, 0x00, 0x00, 0x00, 0x00, 0x00, 0x00, 0x00, 
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                0x00, 0x00, 0x00, 0x00, 0x00, 0x00, 0x00, 0x00, 0x00, 0x00, 0x00, 0x00, 0x00, 0x00, 0x00, 0x00  

            },

            // Windows
            {
                0x00, 0x00, 0x00, 0x00, 0x00, 0x00, 0x00, 0x00, 0x00, 0x00, 0x00, 0x00, 0x00, 0x00, 0x00, 0x00, 
                0x00, 0x00, 0x00, 0x00, 0x00, 0x80, 0xf0, 0xf8, 0xf8, 0xfc, 0xfc, 0xfc, 0xfc, 0xfc, 0xfc, 0xfc, 
                0xf8, 0xf8, 0x00, 0x80, 0xe0, 0xc0, 0xc0, 0x80, 0x80, 0x80, 0x80, 0x80, 0x80, 0x80, 0xc0, 0x40, 
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                0x00, 0x00, 0x00, 0x00, 0x00, 0x00, 0x00, 0x00, 0x00, 0x00, 0x00, 0x00, 0x00, 0x00, 0x00, 0x00

            },

            // Code
            {
                0x00, 0x00, 0x00, 0x00, 0x00, 0x00, 0x00, 0x00, 0x00, 0x00, 0x00, 0x00, 0x00, 0x00, 0x00, 0x00, 
                0x00, 0x00, 0x00, 0x00, 0x00, 0x00, 0x00, 0x00, 0x00, 0x00, 0x00, 0x00, 0x00, 0x00, 0x00, 0x00, 
                0x00, 0x00, 0x00, 0x80, 0x80, 0x00, 0x00, 0x00, 0x00, 0x00, 0x00, 0x00, 0x00, 0x00, 0x00, 0x00, 
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                0x00, 0x00, 0x00, 0x00, 0x00, 0x00, 0x00, 0x00, 0x00, 0x00, 0x00, 0x00, 0x00, 0x00, 0x00, 0x00
            },

            // Number
            {
                0x00, 0x00, 0x00, 0x00, 0x00, 0x00, 0x00, 0x00, 0x00, 0x00, 0x00, 0x00, 0x00, 0x00, 0x00, 0x00, 
                0x00, 0x00, 0x00, 0x00, 0x00, 0x00, 0x00, 0x00, 0x00, 0x00, 0x00, 0xfc, 0xff, 0xff, 0xff, 0x1f, 
                0x00, 0x00, 0x00, 0x00, 0xfc, 0xff, 0xff, 0xff, 0x1f, 0x00, 0x00, 0x00, 0x00, 0x00, 0x00, 0x00, 
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                0x00, 0x00, 0x00, 0x00, 0x00, 0x00, 0x00, 0x00, 0x00, 0x00, 0x00, 0x00, 0x00, 0x00, 0x00, 0x00

            },

            // Function
            {
                0x00, 0x00, 0x00, 0x00, 0x00, 0x00, 0x00, 0x00, 0x00, 0x00, 0x00, 0x00, 0x00, 0x00, 0x00, 0x00, 
                0x00, 0x00, 0x00, 0x00, 0x00, 0x00, 0x00, 0x00, 0x00, 0x00, 0x00, 0x00, 0x00, 0x00, 0xc0, 0xf0, 
                0xf8, 0xfc, 0xfe, 0xfe, 0xff, 0x9f, 0x0f, 0x07, 0x03, 0x00, 0x00, 0x00, 0x00, 0x00, 0x80, 0x80, 
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                0x00, 0x00, 0x00, 0x00, 0x00, 0x00, 0x00, 0x00, 0x00, 0x00, 0x00, 0x00, 0x00, 0x00, 0x00, 0x00 
            },

            // Caps Lock
            {
                0x00, 0x00, 0x00, 0x00, 0x00, 0x00, 0x00, 0x00, 0x00, 0x00, 0x00, 0x00, 0x00, 0x00, 0x00, 0x00, 
                0x00, 0x00, 0x00, 0x00, 0x80, 0x80, 0xc0, 0xc0, 0xe0, 0xe0, 0xe0, 0xe0, 0xe0, 0xe0, 0xe0, 0xe0, 
                0xc0, 0xc0, 0xc0, 0x80, 0x00, 0x00, 0x00, 0x00, 0x00, 0x00, 0x00, 0x00, 0x00, 0x00, 0x00, 0x00, 
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                0x00, 0x00, 0x00, 0x00, 0x00, 0x00, 0x00, 0x00, 0x00, 0x00, 0x00, 0x00, 0x00, 0x00, 0x00, 0x00
            }
        };

    // Layer images 
    oled_set_cursor(32, 0);
    switch (get_highest_layer(layer_state)) {
        case _MAC_DEFAULT :
            oled_write_raw_P(logos[0], sizeof(logos[0]));
            break;
        case _WIN_DEFAULT :
            oled_write_raw_P(logos[1], sizeof(logos[1]));
            break;
        case _MAC_CODE :
        case _WIN_CODE :
            oled_write_raw_P(logos[2], sizeof(logos[2]));
            break;
        case _MAC_NUM :
        case _WIN_NUM :
            oled_write_raw_P(logos[3], sizeof(logos[3]));
            break;
        case _MAC_FUNC :
        case _WIN_FUNC :
            oled_write_raw_P(logos[4], sizeof(logos[4]));
            break;
    }

    // Render Bongo Cat
    render_animation(); 

    return false;
}
#endif
