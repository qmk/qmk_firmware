/* Copyright 2021 kuriatsu
 *
 * This program is free software: you can redistribute it and/or modify
 * it under the terms of the GNU General Public License as published by
 * the Free Software Foundation, either version 2 of the License, or
 * (at your option) any later version.
 *
 * This program is distributed in the hope that it will be useful,
 * but WITHOUT ANY WARRANTY; without even the implied warranty of
 * MERCHANTABILITY or FITNESS FOR A PARTICULAR PURPOSE.  See the
 * GNU General Public License for more details.
 *
 * You should have received a copy of the GNU General Public License
 * along with this program.  If not, see <http://www.gnu.org/licenses/>.
 */
#include QMK_KEYBOARD_H

// Defines names for use in layer keycodes and the keymap
enum layer_names {
    _BASE,
    _FN
};

// Defines the keycodes used by our macros in process_record_user
enum custom_keycodes {
    ENC_MOD = SAFE_RANGE
};



const uint16_t PROGMEM keymaps[][MATRIX_ROWS][MATRIX_COLS] = {
    [_BASE] = LAYOUT(
         KC_1,    KC_2,    KC_3,    KC_4,    KC_5,    KC_6,                          KC_7,    KC_8,    KC_9,    KC_0, KC_MINS,  KC_EQL,
       KC_TAB,    KC_Q,    KC_W,    KC_E,    KC_R,    KC_T,                          KC_Y,    KC_U,    KC_I,    KC_O,    KC_P, KC_LBRC, KC_RBRC,
      KC_LCTL,    KC_A,    KC_S,    KC_D,    KC_F,    KC_G,                          KC_H,    KC_J,    KC_K,    KC_L, KC_SCLN, KC_QUOT,
      KC_LSFT,    KC_Z,    KC_X,    KC_C,    KC_V,    KC_B,              ENC_MOD,    KC_N,    KC_M, KC_COMM,   C_DOT, KC_SLSH,
                         KC_ESC, KC_RGUI, KC_LALT,  KC_SPC, KC_LSFT,     KC_BSPC,  KC_ENT, MO(_FN), KC_BSLS,  KC_GRV
    ),
    [_FN] = LAYOUT(
        KC_F1,   KC_F2,   KC_F3,   KC_F4,   KC_F5,   KC_F6,                         KC_F7,   KC_F8,   KC_F9,  KC_F10,  KC_F11,  KC_F12,
      _______, XXXXXXX, KC_BTN1, KC_MS_U, KC_BTN2, RGB_TOG,                       KC_PGUP, XXXXXXX,   KC_UP, XXXXXXX, KC_PSCR, XXXXXXX, XXXXXXX,
      _______, XXXXXXX, KC_MS_L, KC_MS_D, KC_MS_R, RGB_MOD,                       KC_PGDN, KC_LEFT, KC_DOWN, KC_RGHT, XXXXXXX, XXXXXXX,
      _______, XXXXXXX, XXXXXXX, XXXXXXX, RGB_VAI, RGB_HUI,              _______, KC_BRIU, KC_BRID, XXXXXXX, XXXXXXX, XXXXXXX,
      _______, _______, _______, _______, _______,                       KC_ACL1, KC_ACL2, _______, _______, _______
    )
};

uint8_t mod_state;
uint8_t encoder_mode = 0;

bool process_record_user(uint16_t keycode, keyrecord_t *record) {
    mod_state = get_mods();
    switch (keycode) {

        // make KC_LSHIFT + KC_BSPACE to KC_DEL
        case KC_BSPC:
        {
            static bool delkey_registered;
            if (record->event.pressed) {
                if (mod_state & MOD_MASK_SHIFT) {
                    del_mods(MOD_MASK_SHIFT);
                    register_code(KC_DEL);
                    delkey_registered = true;
                    set_mods(mod_state);
                    return false;
                }
            } else {
                if (delkey_registered) {
                    unregister_code(KC_DEL);
                    delkey_registered = false;
                    return false;
                }
            }
            return true;
        }
        // push encoder and change encoder function
        case ENC_MOD:
        {
            if (record->event.pressed) {
                if (mod_state & MOD_MASK_SHIFT) {
                    encoder_mode = (encoder_mode+1)%4;
                    break;
                } else {
                    encoder_mode = (encoder_mode+3)%4;
                    break;
                }
            } else {
                // when released
            }
        }

    }
    return true;
}

bool should_process_keypress(void) { return true; }

bool encoder_update_user(uint8_t index, bool clockwise) {
    switch (encoder_mode) {
        case 0:
        {
            if (clockwise) {
                tap_code(KC_MS_WH_UP);
            } else {
                tap_code(KC_MS_WH_DOWN);
            }
            break;
        }
        case 1:
        {
            if (clockwise) {
                tap_code(KC_PGUP);
            } else {
                tap_code(KC_PGDOWN);
            }
            break;
        }
        case 2:
        {
            if (clockwise) {
                tap_code(KC_VOLU);
            } else {
                tap_code(KC_VOLD);
            }
            break;
        }
        case 3:
        {
            if (clockwise) {
                tap_code(KC_BRIGHTNESS_UP);
            } else {
                tap_code(KC_BRIGHTNESS_DOWN);
            }
            break;
        }
    }
    return false;
}


#ifdef OLED_ENABLE
static void render_scrl(void) {
    static const char PROGMEM raw_scrl[] = {
        128,192,192,224, 96, 48, 48, 48, 48, 48, 48, 48,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  0,
        7, 15, 28, 24, 24, 24, 12, 12,  0,  0,192,254,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  0,
        0,  0,  0,  0,  0,  0,  0,128,192,252,255,255,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  0,
        96,112,112, 48, 56, 28, 14, 15,  3,  3,  5,  4,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  0,
    };
    oled_write_raw_P(raw_scrl, sizeof(raw_scrl));
}

static void render_pgup(void) {
    static const char PROGMEM raw_pgup[] = {
        128,192,192,224, 96, 48, 48, 48, 48, 48, 48, 48,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  0,
        7, 15, 28, 24, 24, 24, 12, 12,  0,  0,192,254,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  0,
        0,  0,  0,  0,  0,  0,  0,128,192,252,255,255,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  0,
        96,112,112, 48, 56, 28, 14, 15,  3,  3,  5,  4,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  0,
    };
    oled_write_raw_P(raw_pgup, sizeof(raw_pgup));
}

static void render_volume(void) {
    static const char PROGMEM raw_volume[] = {
        128,192,192,224, 96, 48, 48, 48, 48, 48, 48, 48,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  0,
        7, 15, 28, 24, 24, 24, 12, 12,  0,  0,192,254,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  0,
        0,  0,  0,  0,  0,  0,  0,128,192,252,255,255,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  0,
        96,112,112, 48, 56, 28, 14, 15,  3,  3,  5,  4,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  0,
    };
    oled_write_raw_P(raw_volume, sizeof(raw_volume));
}

static void render_brightness(void) {
    static const char PROGMEM raw_brightness[] = {
        128,192,192,224, 96, 48, 48, 48, 48, 48, 48, 48,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  0,
        7, 15, 28, 24, 24, 24, 12, 12,  0,  0,192,254,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  0,
        0,  0,  0,  0,  0,  0,  0,128,192,252,255,255,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  0,
        96,112,112, 48, 56, 28, 14, 15,  3,  3,  5,  4,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  0,
    };
    oled_write_raw_P(raw_brightness, sizeof(raw_brightness));
}

oled_rotation_t oled_init_user(oled_rotation_t rotation) {
    if (is_keyboard_master()) {
        return OLED_ROTATION_180;
    }
    return rotation;
}

bool oled_task_user(void) {
    switch (encoder_mode) {
        case 0:
        {
            render_scrl();
            break;
        }
        case 1:
        {
            render_pgup();
            break;
        }
        case 2:
        {
            render_volume();
            break;
        }
        case 3:
        {
            render_brightness();
            break;
        }
    }
    oled_set_cursor(14, 0);
    oled_write_P(PSTR("WPM:"), false);
    oled_write(get_u8_str(get_current_wpm(), ' '), false);
    return false;
}
#endif
