/* Copyright 2021 Rocco Jiang
 *
 * This program is free software: you can redistribute it and/or modify
 * it under the terms of the GNU General Public License as published by
 * the Free Software Foundation, either version 2 of the License, or
 * (at your option) any later version.
 *
 * This program is distributed in the hope that it will be useful,
 * but WITHOUT ANY WARRANTY; without even the implied warranty of
 * MERCHANTABILITY or FITNESS FOR A PARTICULAR PURPOSE.  See the
 * GNU General Public License for more details.
 *
 * You should have received a copy of the GNU General Public License
 * along with this program.  If not, see <http://www.gnu.org/licenses/>.
 */

#include QMK_KEYBOARD_H
#include <stdio.h>

/*
 * Bongo Cat WPM visualiser.
 * 
 * Credits:
 * @j-inc for initial bongocat code
 * @obosob for initial animation approach
 * @pixelbenny for images
 * @aseiger for initial adaptation to 128x32 display
 * @vectorstorm for initial run length encoding to compress animation size
 * @filterpaper for improvements to RLE
 */

char wpm_str[8];

#define IDLE_FRAMES 5
#define TAP_FRAMES 2

#define IDLE_SPEED 50 // animation idles below this wpm value
#define TAP_SPEED 75 // animation triggers above this wpm value

#define FRAME_DURATION 200 // ms per frame

uint32_t anim_timer = 0;
uint32_t anim_sleep = 0;

/*
 * Bongocat frames are encoded in pairs of 'byte, count'
 * RLE decode will read each pair and render bytes based on count
 */
static void decode_frame(unsigned char const *frame) {
	uint16_t cursor = 0;
	uint8_t size = pgm_read_byte_near(frame);

	oled_set_cursor(0, 0);
	for (uint8_t i = 1; i < size - 1; i += 2) {
		// Loop through pairs of byte and count
		char byte = pgm_read_byte_near(frame + i);
		uint8_t count = pgm_read_byte_near(frame + i + 1);

		for (uint8_t j = 0; j < count; ++j) {
			// Render byte repetition
			oled_write_raw_byte(byte, cursor);
			cursor++;
		}
	}
}

static void render_cat_idle(void) {
    // Run-length encoded idle frames
	static unsigned char const idle0[] PROGMEM = {181,
		0x00,0x33,0x80,0x02,0x00,0x05,0x80,0x01,0x40,0x02,0x20,0x04,0x10,0x04,0x08,0x01,
		0x04,0x01,0x02,0x01,0x01,0x02,0x02,0x01,0x0c,0x01,0x30,0x01,0x40,0x01,0x80,0x01,
		0x00,0x2e,0x80,0x03,0x00,0x31,0x1e,0x01,0xe1,0x01,0x00,0x02,0x01,0x02,0x02,0x02,
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		0x07,0x01,0x00,0x3d};

	static unsigned char const idle1[] PROGMEM = {165,
		0x00,0x3b,0x80,0x02,0x40,0x04,0x20,0x04,0x10,0x01,0x08,0x01,0x04,0x01,0x02,0x02,
		0x04,0x01,0x18,0x01,0x60,0x01,0x80,0x01,0x00,0x2f,0x80,0x03,0x00,0x31,0x3c,0x01,
		0xc2,0x01,0x01,0x02,0x02,0x02,0x04,0x02,0x02,0x01,0x01,0x01,0x00,0x10,0x60,0x02,
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		0x07,0x01,0x00,0x3d};

	static unsigned char const idle2[] PROGMEM = {169,
		0x00,0x3a,0x80,0x01,0x40,0x02,0x20,0x04,0x10,0x05,0x08,0x02,0x04,0x03,0x08,0x01,
		0x30,0x01,0x40,0x01,0x80,0x01,0x00,0x2e,0x80,0x03,0x00,0x31,0x18,0x01,0x64,0x01,
		0x82,0x01,0x02,0x05,0x01,0x01,0x00,0x04,0x80,0x02,0x00,0x09,0x80,0x01,0x00,0x01,
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		0x04,0x02,0x08,0x05,0x07,0x01,0x00,0x3d};

	static unsigned char const idle3[] PROGMEM = {171,
		0x00,0x3a,0x80,0x01,0x40,0x02,0x20,0x04,0x10,0x04,0x08,0x02,0x04,0x01,0x02,0x03,
		0x04,0x01,0x38,0x01,0x40,0x01,0x80,0x01,0x00,0x2e,0x80,0x03,0x00,0x31,0x1c,0x01,
		0xe2,0x01,0x01,0x02,0x02,0x04,0x01,0x01,0x00,0x04,0x80,0x02,0x00,0x09,0x80,0x01,
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		0x02,0x02,0x04,0x02,0x08,0x05,0x07,0x01,0x00,0x3d};

	static unsigned char const *idle_anim[IDLE_FRAMES] = { idle0, idle0, idle1, idle2, idle3 };

	static uint8_t current_frame = 0;
	current_frame = (current_frame < IDLE_FRAMES - 1) ? current_frame + 1 : 0;

	decode_frame(idle_anim[current_frame]);
}

static void render_cat_prep(void) {
	// Run-length encoded prep frame
	static unsigned char const prep[] PROGMEM = {181,
		0x00,0x33,0x80,0x02,0x00,0x05,0x80,0x01,0x40,0x02,0x20,0x04,0x10,0x04,0x08,0x01,
		0x04,0x01,0x02,0x01,0x01,0x02,0x02,0x01,0x0c,0x01,0x30,0x01,0x40,0x01,0x80,0x01,
		0x00,0x2e,0x80,0x03,0x00,0x31,0x1e,0x01,0xe1,0x01,0x00,0x02,0x01,0x02,0x02,0x02,
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		0x01,0x06,0x00,0x47};

	decode_frame(prep);
}

static void render_cat_tap(void) {
	// Run-length encoded tap frames
	static unsigned char const tap0[] PROGMEM = {221,
		0x00,0x33,0x80,0x02,0x00,0x05,0x80,0x01,0x40,0x02,0x20,0x04,0x10,0x04,0x08,0x01,
		0x04,0x01,0x02,0x01,0x01,0x02,0x02,0x01,0x0c,0x01,0x30,0x01,0x40,0x01,0x80,0x01,
		0x00,0x07,0xf8,0x04,0x00,0x05,0x80,0x02,0x00,0x1c,0x80,0x03,0x00,0x31,0x1e,0x01,
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		0x02,0x02,0x01,0x06,0x00,0x24,0x01,0x01,0x03,0x02,0x00,0x20};

	static unsigned char const tap1[] PROGMEM = {181,
		0x00,0x33,0x80,0x02,0x00,0x05,0x80,0x01,0x40,0x02,0x20,0x04,0x10,0x04,0x08,0x01,
		0x04,0x01,0x02,0x01,0x01,0x02,0x02,0x01,0x0c,0x01,0x30,0x01,0x40,0x01,0x80,0x01,
		0x00,0x2e,0x80,0x03,0x00,0x31,0x1e,0x01,0xe1,0x01,0x00,0x02,0x01,0x02,0x02,0x02,
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		0x80,0x01,0x00,0x3c};

	static unsigned char const *tap_anim[TAP_FRAMES] = { tap0, tap1 };

	static unsigned char current_frame = 0;
	current_frame = (current_frame + 1) & 1;

	decode_frame(tap_anim[current_frame]);
}

void render_bongocat(void) {

    void animate_cat(void) {
        if (get_current_wpm() <= IDLE_SPEED) {
            render_cat_idle();
        }
        if (get_current_wpm() > IDLE_SPEED && get_current_wpm() < TAP_SPEED) {
            render_cat_prep();
        }
        if (get_current_wpm() >= TAP_SPEED){
            render_cat_tap();
        }
    }

    if (get_current_wpm() != 0) {
        oled_on(); // not essential but turns on animation OLED with any alpha keypress
        if (timer_elapsed32(anim_timer) > FRAME_DURATION) {
            anim_timer = timer_read32();
            animate_cat();
        }
        anim_sleep = timer_read32();
    } else {
        if (timer_elapsed32(anim_sleep) > OLED_TIMEOUT) {
            oled_off();
        } else {
            if (timer_elapsed32(anim_timer) > FRAME_DURATION) {
                anim_timer = timer_read32();
                animate_cat();
            }
        }
    }
}

/* Init and rendering calls */

// Rotate OLED display to the correct orientation
oled_rotation_t oled_init_user(oled_rotation_t rotation) { return OLED_ROTATION_180; };

void oled_task_user(void) {
	render_bongocat();
    oled_set_cursor(0,0);
    sprintf(wpm_str, "WPM:%03d", get_current_wpm());
    oled_write(wpm_str, false);
}
