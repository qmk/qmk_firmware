// Copyright 2023 QMK
// SPDX-License-Identifier: GPL-2.0-or-later

#include QMK_KEYBOARD_H


enum layer_names {
    _BASE,
    _SPECIAL1,
    _SPECIAL2,
    _STANDBY
};

enum custom_keycodes {
    LYR_MUL = SAFE_RANGE,
    LYR_MUR,
    LYR_MDL,
    LYR_MDR
};

const uint16_t PROGMEM keymaps[][MATRIX_ROWS][MATRIX_COLS] = {
    /*
     * ┌───┬───┬───┬
     * │ 7 │ 8 │ 9 │
     * ├───┼───┼───┼
     * │ 4 │ 5 │ 6 │
     * ├───┼───┼───┼
     * │ 1 │ 2 │ 3 │
     * ├───┼───┼───┼
     * │ 0 │Ent│Lyr│
     * └───┴───┴───┘
     */
    [_BASE] = LAYOUT(
        KC_P7,      KC_P8,      KC_P9,
        KC_P4,      KC_P5,      KC_P6,
        KC_P1,      KC_P2,      KC_P3,
        KC_P0,      KC_PENT,    TO(_SPECIAL1)
    ),
    [_SPECIAL1] = LAYOUT(
        KC_P7,      KC_P8,      KC_P9,
        KC_P4,      KC_P5,      KC_P6,
        KC_P1,      KC_P2,      KC_P3,
        KC_P0,      KC_PENT,    TO(_SPECIAL2)
    ),
    [_SPECIAL2] = LAYOUT(
        LYR_MUL,    KC_MS_U,    LYR_MUR,
        KC_MS_L,    KC_MS_BTN1, KC_MS_R,
        LYR_MDL,    KC_MS_D,    LYR_MDR,
        KC_ACL0,    KC_ACL1,    TO(_STANDBY)
    ),
    [_STANDBY] = LAYOUT(
        KC_NO,      KC_NO,      KC_NO,
        KC_NO,      KC_NO,      KC_NO,
        KC_NO,      KC_NO,      KC_NO,
        KC_NO,      KC_NO,      TO(_BASE)
    )
};

bool process_record_user(uint16_t keycode, keyrecord_t *record) {
    switch (keycode) {
        case LYR_MUL:
            if (record->event.pressed){
                register_code(KC_MS_U);
                register_code(KC_MS_L);
            } else {
                unregister_code(KC_MS_U);
                unregister_code(KC_MS_L);
            }
            break;
        case LYR_MUR:
            if (record->event.pressed){
                register_code(KC_MS_U);
                register_code(KC_MS_R);
            } else {
                unregister_code(KC_MS_U);
                unregister_code(KC_MS_R);
            }
            break;
        case LYR_MDL:
            if (record->event.pressed){
                register_code(KC_MS_D);
                register_code(KC_MS_L);
            } else {
                unregister_code(KC_MS_D);
                unregister_code(KC_MS_L);
            }
            break;
        case LYR_MDR:
            if (record->event.pressed){
                register_code(KC_MS_D);
                register_code(KC_MS_R);
            } else {
                unregister_code(KC_MS_D);
                unregister_code(KC_MS_R);
            }
            break;
    }
    return true;
}




#ifdef OLED_ENABLE

        static void render_logo(void) {
            static const char PROGMEM aks_mls_logo[] = {
                // 'mls_logo_layers_totop', 128x24px
                0x00, 0x00, 0x00, 0x00, 0x00, 0x00, 0x00, 0x00, 0x00, 0x00, 0x00, 0x00, 0xc0, 0x20, 0x10, 0x18,
                0x08, 0xc4, 0xc4, 0x84, 0x02, 0x02, 0x02, 0x83, 0xc1, 0x01, 0x01, 0xc1, 0xc1, 0x01, 0x01, 0x01,
                0x01, 0x01, 0x03, 0x82, 0xc2, 0x42, 0x44, 0x44, 0x84, 0x08, 0x18, 0x10, 0x20, 0xc0, 0x00, 0x00,
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                0x00, 0x00, 0x00, 0x00, 0x00, 0x00, 0x00, 0x00, 0x00, 0x00, 0x00, 0x00, 0x00, 0x00, 0x00, 0x00
            };
            oled_write_raw_P(aks_mls_logo, sizeof(aks_mls_logo));
        }

        bool oled_init(oled_rotation_t(OLED_ROTATION_0));

        bool oled_task_user(void) {
            render_logo();

            oled_set_cursor(0, 3);
            // oled_write(PSTR("Layer: "), false);

            switch (get_highest_layer(layer_state)) {
                case _BASE:
                    // oled_write_ln(PSTR("Base"), false);
                    oled_write_ln(PSTR("Default Actions"), false);
                    oled_advance_page(true);
                    oled_advance_page(true);
                    break;
                case _SPECIAL1:
                    // oled_write_ln(PSTR("Special1"), false);
                    oled_write_ln(PSTR("Special Actions 1"), false);
                    oled_advance_page(true);
                    break;
                case _SPECIAL2:
                    // oled_write_ln(PSTR("Special2"), false);
                    oled_write_ln(PSTR("Mouse Moves"), false);
                    oled_advance_page(true);
                    oled_advance_page(true);
                    break;
                case _STANDBY:
                    oled_write_ln(PSTR("Standby Mode"), false);
                    oled_write_ln(PSTR("Keys do nothing"), false);
                    oled_write_ln(PSTR("Layer key re-engages"),     false);
                break;
                default:
                    oled_write_ln_P(PSTR("Undefined"), false);
                    oled_advance_page(true);
                    oled_advance_page(true);

            }

            return false;
        }

        // bool oled_task_kb(void) {
        //     oled_set_cursor(0,8);
        //     oled_write_ln(PSTR("Key Pressed"), false);
        //     return false;
        // }

#endif
