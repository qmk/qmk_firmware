// Copyright 2025 Ll3ma (@ll3ma)
// SPDX-License-Identifier: GPL-2.0-or-later
#include "quantum.h"

#ifdef OLED_ENABLE
bool oled_task_kb(void) {
    if (!oled_task_user()) {
        return false;
    }

// WPM-responsive animation stuff here
#    define IDLE_FRAMES         5
#    define IDLE_SPEED          0  // below this wpm value your animation will idle

    // #define PREP_FRAMES 1 // uncomment if >1

#    define TAP_FRAMES          2
#    define TAP_SPEED           0  // above this wpm value typing animation to triggere

#    define ANIM_FRAME_DURATION 200  // how long each frame lasts in ms
// #define SLEEP_TIMER 60000 // should sleep after this period of 0 wpm, needs fixing
#    define ANIM_SIZE           512  // number of bytes in array, minimize for adequate firmware size, max is 1024

    uint32_t anim_timer         = 0;
    uint32_t anim_sleep         = 0;
    uint8_t  current_idle_frame = 0;
    // uint8_t current_prep_frame = 0; // uncomment if PREP_FRAMES >1
    uint8_t current_tap_frame = 0;

    // Images credit j-inc(/James Incandenza) and pixelbenny. Credit to obosob for initial animation approach.
   void render_anim(void) {
        static const char PROGMEM idle[IDLE_FRAMES][ANIM_SIZE] = {{
                                                                      0, 0, 0, 0, 0, 0, 0, 0, 0, 0, 0, 0, 0,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 0,
                                                                      0, 0, 0, 0, 0, 0, 0, 0, 0, 0, 0, 0, 0,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 0,
                                                                  },
                                                                  {
                                                                      0, 0, 0, 0, 0, 0, 0, 0, 0, 0, 0, 0, 0,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 0,
                                                                      0, 0, 0, 0, 0, 0, 0, 0, 0, 0, 0, 0, 0,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 0,
                                                                  },
                                                                  {
                                                                      0, 0, 0, 0, 0, 0, 0, 0, 0, 0, 0, 0, 0,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 0,
                                                                      0, 0, 0, 0, 0, 0, 0, 0, 0, 0, 0, 0, 0,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 0,
                                                                  },
                                                                  {
                                                                      0, 0, 0, 0, 0, 0, 0, 0, 0, 0, 0, 0, 0,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 0,
                                                                      0, 0, 0, 0, 0, 0, 0, 0, 0, 0, 0, 0, 0,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 0,
                                                                  },
                                                                  {
                                                                      0, 0, 0, 0, 0, 0, 0, 0, 0, 0, 0, 0, 0,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 0,
                                                                      0, 0, 0, 0, 0, 0, 0, 0, 0, 0, 0, 0, 0,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 0,
                                                                  }};
        static const char PROGMEM prep[][ANIM_SIZE]            = {{
            0, 0, 0, 0, 0, 0, 0, 0, 0, 0, 0, 0,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 0,
            0, 0, 0, 0, 0, 0, 0, 0, 0, 0, 0, 0,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 0,
        }};
        static const char PROGMEM tap[TAP_FRAMES][ANIM_SIZE]   = {
            {
                0, 0, 0, 0, 0, 0, 0, 0, 0, 0, 0, 0,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 0,
                0, 0, 0, 0, 0, 0, 0, 0, 0, 0, 0, 0,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 0,
            },
            {
                0, 0, 0, 0, 0, 0, 0, 0, 0, 0, 0, 0,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 0,
                0, 0, 0, 0, 0, 0, 0, 0, 0, 0, 0, 0,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 0,
            },
        };

        // assumes 1 frame prep stage
        void animation_phase(void) {
            if (get_current_wpm() <= IDLE_SPEED) {
                current_idle_frame = (current_idle_frame + 1) % IDLE_FRAMES;
                oled_write_raw_P(idle[abs((IDLE_FRAMES - 1) - current_idle_frame)], ANIM_SIZE);
            }
            if (get_current_wpm() > IDLE_SPEED && get_current_wpm() < TAP_SPEED) {
                // oled_write_raw_P(prep[abs((PREP_FRAMES-1)-current_prep_frame)], ANIM_SIZE); // uncomment if IDLE_FRAMES >1
                oled_write_raw_P(prep[0], ANIM_SIZE);  // remove if IDLE_FRAMES >1
            }
            if (get_current_wpm() >= TAP_SPEED) {
                current_tap_frame = (current_tap_frame + 1) % TAP_FRAMES;
                oled_write_raw_P(tap[abs((TAP_FRAMES - 1) - current_tap_frame)], ANIM_SIZE);
            }
        }
        if (get_current_wpm() != 000) {
            oled_on();  // not essential but turns on animation OLED with any alpha keypress
            if (timer_elapsed32(anim_timer) > ANIM_FRAME_DURATION) {
                anim_timer = timer_read32();
                animation_phase();
            }
            anim_sleep = timer_read32();
        } else {
            if (timer_elapsed32(anim_sleep) > OLED_TIMEOUT) {
                oled_off();
            } else {
                if (timer_elapsed32(anim_timer) > ANIM_FRAME_DURATION) {
                    anim_timer = timer_read32();
                    animation_phase();
                }
            }
        }
    }

    render_anim();
    oled_set_cursor(0, 0);
    oled_write(get_u8_str(get_current_wpm(), '0'), false);
    return true;
}

oled_rotation_t oled_init_user(oled_rotation_t rotation) { return OLED_ROTATION_180; };
#endif
