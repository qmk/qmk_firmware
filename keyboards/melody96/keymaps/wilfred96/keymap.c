#include QMK_KEYBOARD_H
//
#ifdef RGBLIGHT_ENABLE
#include "rgblight.h"
#endif
//

enum custom_keycodes {
  QWERTY = SAFE_RANGE,
  DYNAMIC_MACRO_RANGE,
};

#include "dynamic_macro.h"

#define _______ KC_TRNS
#define KC_REC DYN_REC_START1
#define KC_DONE DYN_REC_STOP
#define KC_PLAY DYN_MACRO_PLAY1
#define _BL 0
#define _NL 1
#define _FL 2
#define _HL 3
#define FN_CAPS LT(_FL, KC_CAPSLOCK)

const uint16_t PROGMEM keymaps[][MATRIX_ROWS][MATRIX_COLS] = {
	
	
  /* Keymap _BL: Base Layer (Default Layer)
 ____________________________________________________________________________________________________________________________________________________________________________
|        |        |        |        |        |        |        |        |        |        |        |        |        |        |        |        |        |        |        |
| ESC*   |   F1   |   F2   |   F3   |   F4   |   F5   |   F6   |   F7   |   F8   |   F9   |  F10   |  F11   |  F12   | P SCN  |  Mail  |  Home  |  End   | Insert |  DEL   |
|________|________|________|________|________|________|________|________|________|________|________|________|________|________|________|________|________|________|________|
|        |        |        |        |        |        |        |        |        |        |        |        |        |        | BACK   |        |        |        |        |
|  ~`    |   1    |   2    |   3    |   4    |   5    |   6    |   7    |   8    |   9    |   0    |  _ -   | =  +   |   NO   | SPACE  |  FN2   |   /    |  *     |   -    |
|________|________|________|________|________|________|________|________|________|________|________|________|________|________|________|________|________|________|________|
|            |        |        |        |        |        |        |        |        |        |        |  [     |   ]    |             |        |        |        |        |
|    TAB     |   Q    |   W    |   E    |   R    |   T    |   Y    |   U    |   I    |   O    |   P    |  {     |   }    |  |   \      |  INS   |  HOME  |  PGUP  |   -    |
|____________|________|________|________|________|________|________|________|________|________|________|________|________|_____________|________|________|________|________|
|              |        |        |        |        |        |        |        |        |        |   ;    |   '    |                    |        |        |        |        |
|   FN 1       |   A    |   S    |   D    |   F    |   G    |   H    |   J    |   K    |   L    |   :    |   "    |       ENTER        |  DEL   |  END   |  PGDN  |   +    |
|______________|________|________|________|________|________|________|________|________|________|________|________|____________________|________|________|________|________|
|         |        |        |        |        |        |        |        |        |   ,    |    .   |   /    |                |        |        |        |        |        |
|  SHIFT  |  SPACE |   Z    |   X    |   C    |   V    |   B    |   N    |   M    |   <    |    >   |   ?    |       SHIFT    |  DEL   |   1    |   UP   |   3    | ENTER  |
|_________|________|________|________|________|________|________|________|________|________|________|________|________________|________|________|________|________|________|
|          |          |          |                                                        |        |        |        |        |        |        |        |        |        |
| CTRL     |   LGUI   | L ALT    |                      FN 1                              | R ALT  | WIN    |  WIN   |  FN 1  |  RCTRL |  LEFT  |  DOWN  |  RIGHT | ENTER  |
|__________|__________|__________|________________________________________________________|________|________|________|________|________|________|________|________|________|
*/


    [_BL] = LAYOUT(
    KC_ESC,  		  KC_F1,   KC_F2,   KC_F3,   KC_F4,   KC_F5,   KC_F6,   KC_F7,   KC_F8,   KC_F9,   KC_F10,  KC_F11,  KC_F12,  KC_PSCR, KC_MAIL, KC_HOME, KC_END,  KC_INS,  KC_DEL,
    KC_GRV,    		  KC_1,    KC_2,    KC_3,    KC_4,    KC_5,    KC_6,    KC_7,    KC_8,    KC_9,    KC_0,    KC_MINS, KC_EQL,  KC_BSLS, KC_BSPC, TG(_NL), KC_PSLS, KC_PAST, KC_PMNS, 
    KC_TAB,  		  KC_Q,    KC_W,    KC_E,    KC_R,    KC_T,    KC_Y,    KC_U,    KC_I,    KC_O,    KC_P,    KC_LBRC, KC_RBRC, KC_BSLS,          KC_INS,  KC_HOME, KC_PGUP, KC_PMNS, 
    FN_CAPS,		  KC_A,    KC_S,    KC_D,    KC_F,    KC_G,    KC_H,    KC_J,    KC_K,    KC_L,    KC_SCLN, KC_QUOT, 				KC_ENT,     KC_DEL,  KC_END,  KC_PGDN, KC_PPLS, 
    KC_LSFT, KC_SPC,  KC_Z,    KC_X,    KC_C,    KC_V,    KC_B,    KC_N,    KC_M,    KC_COMM, KC_DOT,  KC_SLSH,       			  KC_RSFT, KC_DEL,  KC_P1,   KC_UP,   KC_P3,   KC_PENT, 
    KC_LCTL, 		  KC_LGUI, KC_LALT,                            MO(_FL),                            KC_RALT, KC_RGUI, KC_RGUI, TT(_FL), KC_RCTL, KC_LEFT, KC_DOWN, KC_RGHT, KC_PENT 
	),
	
  /* Keymap _NP: Numpad Layer
____________________________________________________________________________________________________________________________________________________________________________
|        |        |        |        |        |        |        |        |        |        |        |        |        |        |        |        |        |        |        |
| 	     |        |        |        |        |        |        |        |        |        |        |        |        |        |        |        |        |        |        |
|________|________|________|________|________|________|________|________|________|________|________|________|________|________|________|________|________|________|________|
|        |        |        |        |        |        |        |        |        |        |        |        |        |        |        |        |        |        |        |
|        |        |        |        |        |        |        |        |        |        |        |        |        |        |        |        |        |        |        |
|________|________|________|________|________|________|________|________|________|________|________|________|________|________|________|________|________|________|________|
|            |   	  |        |     	|      	 |	      |  	   |   	    |        |	   	  |        |        |        |             |        |        |        |        |
|            |        |        |        |		 |   	  |	       |        |        |        |        |        |        |             |   7    |   8    |   9    |        |
|____________|________|________|________|________|________|________|________|________|________|________|________|________|_____________|________|________|________|________|
|              |        |        |        |        |        |        |        |        |        |        |        |                    |        |        |        |        |
|              |        |        |        |        |        |        |        |        |        |        |        |                    |   4    |   5    |   6    |        |
|______________|________|________|________|________|________|________|________|________|________|________|________|____________________|________|________|________|________|
|         |        |        |        |        |        |        |        |        |        |        |        |                |        |        |        |        |        |
|         |        |        |        |        |        |        |        |        |        |        |        |                |        |   1    |   2    |   3    |        |
|_________|________|________|________|________|________|________|________|________|________|________|________|________________|________|________|________|________|________|
|          |          |          |                                                        |        |        |        |        |        |        |        |        |        |
|          |          |          |                                                        |        |        |        |        |        |   0    |   0    |   .    |        |
|__________|__________|__________|________________________________________________________|________|________|________|________|________|________|________|________|________|
*/

	[_NL] = LAYOUT(
    _______, 		  _______, _______, _______, _______, _______, _______, _______, _______, _______, _______, _______, _______, _______, _______, _______, _______, _______, _______, 
    _______, 		  _______, _______, _______, _______, _______, _______, _______, _______, _______, _______, _______, _______, _______, _______, _______, _______, _______, _______, 
    _______,  		  _______, _______, _______, _______, _______, _______, _______, _______, _______, _______, _______, _______, _______,          KC_7,    KC_8, 	  KC_9,    _______, 
    _______, 		  _______, _______, _______, _______, _______, _______, _______, _______, _______, _______, _______, 				_______,	KC_4, 	 KC_5, 	  KC_6,    _______, 
    _______, _______, _______, _______, _______, _______, _______, _______, _______, _______, _______, _______, 				  _______, _______, KC_1, 	 KC_2, 	  KC_3,    _______, 
    _______, 		  _______, _______,                            _______,                            _______, _______, _______, _______, _______, KC_0,    KC_0,    KC_DOT,  _______ 
	),	
  /* Keymap _FL: Function Layer
  ____________________________________________________________________________________________________________________________________________________________________________
| RESET  |  RGB   |  RGB   |  VALUE | VALUE  |        |        |        |        |        |        |        |        |        |        |        |        |        |        |
| 	     | TOGGLE |  MODE  |INCREASE|DECREASE|        |        |        |        |        |        |        |        |        |        |        |        | SLEEP  | POWER  |
|________|________|________|________|________|________|________|________|________|________|________|________|________|________|________|________|________|________|________|
|        |        |        |        |        |        |        |        |        |        |        |        |        |        |        |        |        |        |        |
|        |  F1    |   F2   |  F3    |   F4   |   F5   |  F6    |   F7   |  F8    |   F9   |   F10  |  F11   |   F12  |        |  DEL   |        |        |        |        |
|________|________|________|________|________|________|________|________|________|________|________|________|________|________|________|________|________|________|________|
|            |   	  |        |     	|      	 |	      |  	   |   	    |        |	   	  |        |        |        |             |        |        |        |        |
|            | VOLDN  |  VOLUP | MUTE   |		 |   	  |	 CALC  | HOME   |	UP   |	END   | PGUP   |        |        |     PSC     |        |        |        |        |
|____________|________|________|________|________|________|________|________|________|________|________|________|________|_____________|________|________|________|________|
|              |        |        |        |        |        |        |        |        |        |        |        |                    |        |        |        |        |
|              | PREV   | PLAY   |  NEXT  |        |        | MYCOMP | LEFT   |  DOWN  | RIGHT  |  PGDN  |        |    INSERT          |        |        |        |        |
|______________|________|________|________|________|________|________|________|________|________|________|________|____________________|________|________|________|________|
|         |        |        |        |        |        |        |        |        |        |        |        |                |        |        |        |        |        |
|         |  SPACE |        |        |        |        |        | MENU   | MACRO  | M_REC  | M_END  |        |                |        |        |        |        |        |
|_________|________|________|________|________|________|________|________|________|________|________|________|________________|________|________|________|________|________|
|          |          |          |                                                        |        |        |        |        |        |        |        |        |        |
|          |          |          |                                                        |        |        |        |        |        |        |        |        |        |
|__________|__________|__________|________________________________________________________|________|________|________|________|________|________|________|________|________|
BL_TOGG, BL_DEC, BL_INC changes the in-switch LEDs

*/
	
	[_FL] = LAYOUT(
    _______,		  KC_F1,   KC_F2,   KC_F3,   KC_F4,   KC_F5,   KC_F6,   KC_F7,   KC_F8,   KC_F9,   KC_F10,  KC_F11,  KC_F12,  _______, _______, _______, _______, KC_SLEP, KC_PWR, 
    _______, 		  _______, _______, _______, _______, _______, _______, _______, _______, _______, _______, _______, _______, _______, KC_DEL,  _______, _______, _______, _______, 
    MO(_HL), 		  KC_MPLY, KC_VOLU, KC_MUTE, _______, _______, KC_CALC, KC_HOME, KC_UP  , KC_END , KC_PGUP, _______, _______, KC_PSCR,          _______, _______, _______, _______, 
    _______, 		  KC_MPRV, KC_VOLD, KC_MNXT, _______, _______, KC_MYCM, KC_LEFT, KC_DOWN, KC_RGHT, KC_PGDN, _______, 				 KC_INS,    _______, _______, _______, _______, 
    _______, _______, _______, _______, _______, _______, _______, KC_APP,  KC_PLAY, KC_REC , KC_DONE, _______, 		 		  _______, KC_ESC,  _______, _______, _______, _______, 
    _______, 		  _______, _______,                            _______,                            _______, _______, _______, _______, _______, _______, _______, _______, _______ 
	),
	
	

/*	 Keymap _HL: TEMPLATE Layer
____________________________________________________________________________________________________________________________________________________________________________
|        |        |        |        |        |        |        |        |        |        |        |        |        |        |        |        |        |        |        |
| 	     |        |        |        |        |        |        |        |        |        |        |        |        |        |        |        |        |        |        |
|________|________|________|________|________|________|________|________|________|________|________|________|________|________|________|________|________|________|________|
|        |        |        |        |        |        |        |        |        |        |        |        |        |        |        |        |        |        |        |
|        |        |        |        |        |        |        |        |        |        |        |        |        |        |        |        |        |        |        |
|________|________|________|________|________|________|________|________|________|________|________|________|________|________|________|________|________|________|________|
|            |   	  |        |     	|      	 |	      |  	   |   	    |        |	   	  |        |        |        |             |        |        |        |        |
|            |        |        |        |		 |   	  |	       |        |        |        |        |        |        |             |        |        |        |        |
|____________|________|________|________|________|________|________|________|________|________|________|________|________|_____________|________|________|________|________|
|              |        |        |        |        |        |        |        |        |        |        |        |                    |        |        |        |        |
|              |        |        |        |        |        |        |        |        |        |        |        |                    |        |        |        |        |
|______________|________|________|________|________|________|________|________|________|________|________|________|____________________|________|________|________|________|
|         |        |        |        |        |        |        |        |        |        |        |        |                |        |        |        |        |        |
|         | SPACE  |        |        |        |        |        |        |        |        |        |        |                |        |        |        |        |        |
|_________|________|________|________|________|________|________|________|________|________|________|________|________________|________|________|________|________|________|
|          |          |          |                                                        |        |        |        |        |        |        |        |        |        |
|          |          |          |                    FN                                  |        |        |        |        |        |        |        |        |        |
|__________|__________|__________|________________________________________________________|________|________|________|________|________|________|________|________|________|

*/
	[_HL] = LAYOUT(
    RESET, 			  _______, _______, _______, _______, _______, _______, _______, _______, _______, _______, _______, _______, _______, _______, _______, _______, _______, _______, 
    _______, 		  _______, _______, _______, _______, _______, _______, _______, _______, _______, _______, _______, _______, _______, _______, _______, _______, _______, _______, 
    _______, 		  _______, _______, _______, _______, _______, _______, _______, _______, _______, _______, _______, _______, _______,          _______, _______, _______, _______, 
    _______, 		  _______, _______, _______, _______, _______, _______, _______, _______, _______, _______, _______,  				_______,	_______, _______, _______, _______, 
    _______, _______, RGB_TOG, RGB_MOD, RGB_VAD, RGB_VAI, RGB_HUI, RGB_HUD, RGB_SAI, RGB_SAD, _______, _______, 		 		_______,   _______, _______, _______, _______, _______, 
    _______, 		  _______, _______,                            _______,                            _______, _______, _______, _______, _______, _______, _______, _______, _______ 
	),

/*	 Keymap _HL: TEMPLATE Layer
____________________________________________________________________________________________________________________________________________________________________________
|        |        |        |        |        |        |        |        |        |        |        |        |        |        |        |        |        |        |        |
| 	     |        |        |        |        |        |        |        |        |        |        |        |        |        |        |        |        |        |        |
|________|________|________|________|________|________|________|________|________|________|________|________|________|________|________|________|________|________|________|
|        |        |        |        |        |        |        |        |        |        |        |        |        |        |        |        |        |        |        |
|        |        |        |        |        |        |        |        |        |        |        |        |        |        |        |        |        |        |        |
|________|________|________|________|________|________|________|________|________|________|________|________|________|________|________|________|________|________|________|
|            |   	  |        |     	|      	 |	      |  	   |   	    |        |	   	  |        |        |        |             |        |        |        |        |
|            |        |        |        |		 |   	  |	       |        |        |        |        |        |        |             |        |        |        |        |
|____________|________|________|________|________|________|________|________|________|________|________|________|________|_____________|________|________|________|________|
|              |        |        |        |        |        |        |        |        |        |        |        |                    |        |        |        |        |
|              |        |        |        |        |        |        |        |        |        |        |        |                    |        |        |        |        |
|______________|________|________|________|________|________|________|________|________|________|________|________|____________________|________|________|________|________|
|         |        |        |        |        |        |        |        |        |        |        |        |                |        |        |        |        |        |
|         | SPACE  |        |        |        |        |        |        |        |        |        |        |                |        |        |        |        |        |
|_________|________|________|________|________|________|________|________|________|________|________|________|________________|________|________|________|________|________|
|          |          |          |                                                        |        |        |        |        |        |        |        |        |        |
|          |          |          |                    FN                                  |        |        |        |        |        |        |        |        |        |
|__________|__________|__________|________________________________________________________|________|________|________|________|________|________|________|________|________|


	[_HL] = LAYOUT(
    _______, 		  _______, _______, _______, _______, _______, _______, _______, _______, _______, _______, _______, _______, _______, _______, _______, _______, _______, _______, 
    _______, 		  _______, _______, _______, _______, _______, _______, _______, _______, _______, _______, _______, _______, _______, _______, _______, _______, _______, _______, 
    _______, 		  _______, _______, _______, _______, _______, _______, _______, _______, _______, _______, _______, _______, _______,          _______, _______, _______, _______, 
    _______, 		  _______, _______, _______, _______, _______, _______, _______, _______, _______, _______, _______,  				_______,	_______, _______, _______, _______, 
    _______, _______, _______, _______, _______, _______, _______, _______, _______, _______, _______, _______, 		 		_______,   _______, _______, _______, _______, _______, 
    _______, 		  _______, _______,                            _______,                            _______, _______, _______, _______, _______, _______, _______, _______, _______ 
	),
*/	
};

const macro_t *action_get_macro(keyrecord_t *record, uint8_t id, uint8_t opt) {
	return MACRO_NONE;
}
/*
void matrix_init_user(void) {
}
*/

//void matrix_scan_user(void) {
//}

bool process_record_user(uint16_t keycode, keyrecord_t *record) {
    if (!process_record_dynamic_macro(keycode, record)) {
        return false;
    }
	return true;
}

//RGB LAYERS BEGIN

// RGB Modes
// 1 = Static
// 2-5 = Breathing
// 6-8 = Rainbow
// 9-14 = Swirl
// 15-20 = Snake
// 21-24 = Nightrider
// 25 = Christmas
// 26-30 = Static Gradient


uint8_t prev = _BL;
uint32_t desired = 4;
uint16_t hue = 30;
uint16_t sat = 255;
uint16_t val = 255;

void get_hsv(void) {
	hue = rgblight_get_hue();
	sat = rgblight_get_sat();
	val = rgblight_get_val();
}

void reset_hsv(void) {
	rgblight_sethsv(hue, sat, val);
}

void matrix_init_user() {
	rgblight_mode(desired);
	rgblight_enable();
	reset_hsv();
}

uint32_t layer_state_set_user(uint32_t state) {
  uint8_t layer = biton32(state);
  if (prev!=_HL) {
	  switch (layer) {
  
       case _BL:
          rgblight_mode_noeeprom(desired);		
          rgblight_sethsv_noeeprom (30, 255, 255);
          break;

		case _FL:
		  rgblight_mode_noeeprom(17);
		  rgblight_sethsv_noeeprom   (30, 255, 255);
		  break;
		   
		case _NL:
		  rgblight_mode_noeeprom(4);
		  rgblight_sethsv_noeeprom   (0, 255, 255);
		  break;
	  
	  }
  } else {
	  desired = rgblight_get_mode();
	  get_hsv();
  }
  prev = layer;
  return state;
}

//RGB LAYERS END


//CAPS LOCK UNDERGLOW BEGIN

void led_set_user(uint8_t usb_led) {
  if (usb_led & (1<<USB_LED_CAPS_LOCK)) {
       rgblight_sethsv_at(0, 255, 255, 0);
	   rgblight_sethsv_at(0, 255, 255, 1);

  } else { 
    if (biton32(layer_state) == _BL) {
	   rgblight_sethsv_at(0, 0, 0, 0);
       rgblight_sethsv_at(0, 0, 0, 1);


    }
  }
}

//CAPS LOCK UNDERGLOW END

