#include QMK_KEYBOARD_H
#include <stdio.h>
char wpm_str[10];
//
// Keymaps
//
enum lyra_layers {
    /* _M_XYZ = Mac Os, _W_XYZ = Win/Linux */
    _QWERTY,
    _FUNCTION

};
enum custom_keycodes{
  KC_QWERTY = SAFE_RANGE,
  KC_FUNCTION
};
const uint16_t PROGMEM keymaps[][MATRIX_ROWS][MATRIX_COLS] = {

    // Layer 0
    [_QWERTY] = LAYOUT(
    KC_ESC,		KC_1,		KC_2,		KC_3,				KC_4,		KC_5,		KC_6,				KC_7,		KC_8,		KC_9,		KC_0,		KC_MINS,		KC_EQL,			KC_BSPC,
    KC_TAB,		KC_LBRC,	KC_Q,		KC_W,				KC_E,		KC_R,		KC_T,				KC_Y,		KC_U,       KC_I,		KC_O,		KC_P,			KC_NUHS,		KC_DEL,			
    KC_CLCK,	KC_RBRC,	KC_A,		KC_S,				KC_D,		KC_F,		KC_G,				KC_H,		KC_J,       KC_K,		KC_L,		KC_SCLN,		KC_QUOT,		KC_ENT,
    KC_LSFT,	KC_NUBS,	KC_Z,		KC_X,       		KC_C,       KC_V,       KC_B,            	KC_N,		KC_M,		KC_COMM,	KC_DOT,		KC_SLSH,		KC_UP,			KC_RSFT,
    KC_LCTL,	KC_LGUI,	KC_LALT,	TT(1),				KC_APP,		KC_PGDN,	KC_SPC,				KC_SPC,		KC_PGUP,	KC_RALT,	KC_RCTL,	KC_LEFT,		KC_DOWN,		KC_RGHT					
    ),

    // Layer 1
    [_FUNCTION] = LAYOUT(
    KC_TRNS,		KC_F1,      KC_F2,      KC_F3,      KC_F4,      KC_F5,		KC_F6,				KC_F7,      KC_F8,      KC_F9,		KC_F10,     KC_F11,			KC_F12,			KC_TRNS,
    KC_TRNS,		KC_TRNS,    KC_TRNS,	KC_TRNS,    KC_TRNS,    KC_TRNS,	KC_TRNS,			KC_TRNS,    KC_TRNS,    KC_TRNS,	KC_TRNS,    KC_TRNS,		KC_TRNS,		KC_TRNS,
    KC_TRNS,		KC_TRNS,    KC_TRNS,    KC_TRNS,    KC_TRNS,    KC_TRNS,	KC_TRNS,			KC_TRNS,	KC_TRNS,	KC_TRNS,	KC_TRNS,	KC_TRNS,		KC_TRNS,		KC_TRNS,
    KC_TRNS,		KC_TRNS,	KC_TRNS,	KC_TRNS,	KC_TRNS,	KC_TRNS,	KC_TRNS,			KC_TRNS,	KC_TRNS,	KC_TRNS,	KC_TRNS,	KC_TRNS,		KC_TRNS,		KC_TRNS,
    KC_TRNS,		KC_TRNS,	KC_TRNS,	KC_TRNS,	KC_TRNS,	KC_VOLD,	KC_TRNS,			KC_TRNS,	KC_VOLU,	KC_TRNS,	KC_TRNS,	KC_TRNS,		KC_TRNS,		KC_TRNS	
    )

};

//
// Keyboard initialization
//
void keyboard_post_init_user(void) {
    // Wait for keyboard startup
    wait_ms(100);
}
#ifdef OLED_DRIVER_ENABLE

// 'lyralogooled', 32x128px

static void render_logo(void) {
static const char PROGMEM QMK_logo[] = {
0x00, 0x00, 0x00, 0x00, 0x00, 0x00, 0x00, 0x00, 0x80, 0xe0, 0x78, 0x18, 0x0c, 0x04, 0x06, 0x02, 
	0x02, 0x82, 0xc0, 0xf0, 0x38, 0x8c, 0xf2, 0x3e, 0x00, 0x00, 0x00, 0x00, 0x00, 0x00, 0x00, 0x00, 
	0x80, 0x80, 0x80, 0x00, 0x00, 0x00, 0x00, 0x00, 0x00, 0x00, 0x00, 0x00, 0x00, 0x00, 0x00, 0x00, 
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	0x00, 0x00, 0x00, 0x00, 0x00, 0x00, 0x00, 0x00, 0x00, 0x00, 0x00, 0x00, 0x00, 0x00, 0x00, 0x00 
  };

  oled_write_raw_P(QMK_logo, sizeof(QMK_logo));
}
static void render_status(void) {
    oled_write_P(PSTR("      "), false);
    sprintf(wpm_str, "%03d", get_current_wpm());
    oled_write(wpm_str, false);
    oled_write_P(PSTR("   WPM"), false);
    oled_write_P(PSTR("\n\n"), false);
    led_t led_usb_state = host_keyboard_led_state();
    oled_write_ln_P(PSTR("CPSLK"), led_usb_state.caps_lock);
	oled_write_P(PSTR("\n\n"), false);
	oled_write_P(PSTR("Lyra\n"), false);
	oled_write_P(PSTR("v1.1\n"), false);
	oled_write_P(PSTR("by\n"), false);
	oled_write_P(PSTR("Dom C"), false);
}

oled_rotation_t oled_init_user(oled_rotation_t rotation) {
    if (is_keyboard_master()) {
        return OLED_ROTATION_270;
    }
    return rotation;
}

void oled_task_user(void) {
    if (is_keyboard_master()) {
        render_status();
    } else {
        render_logo();
    }
}

#endif
bool process_record_user(uint16_t keycode, keyrecord_t *record) {
    switch (keycode) {
        case KC_QWERTY:
            if (record->event.pressed) {
                set_single_persistent_default_layer(_QWERTY);
            }
            return false;
        case _FUNCTION:
            if (record->event.pressed) {
                set_single_persistent_default_layer(_FUNCTION);
            }
            return false;
    }
    return true;
}