// Copyright 2023 QMK
// SPDX-License-Identifier: GPL-2.0-or-later

#include QMK_KEYBOARD_H

#define LAYER_TIME 5000

static bool layer_changed = false;
static uint16_t key_timer;
static bool key_pressed = false;

enum layer_names {
  _FIRST,
  _SECOND,
  _THIRD,
  _FOURTH
};

  // 1st layer on the cycle
#define LAYER_CYCLE_START 0
  // Last layer on the cycle
#define LAYER_CYCLE_END   3

static void render_logo(void) {
  static const char gravitas_logo [] PROGMEM = {
    0x00, 0x00, 0x00, 0x00, 0x00, 0x00, 0x00, 0x00, 0x80, 0x80, 0x80, 0x80, 0x80, 0x80, 0x80, 0x80, 
    0x00, 0x00, 0x00, 0x00, 0x00, 0x00, 0x80, 0x80, 0x80, 0x80, 0x80, 0x80, 0x80, 0x80, 0x80, 0x80, 
    0x80, 0x80, 0x80, 0x00, 0x00, 0x00, 0x00, 0x00, 0x00, 0x00, 0x00, 0x00, 0x00, 0x80, 0x80, 0x80, 
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    0x00, 0x00, 0x01, 0x01, 0x01, 0x01, 0x01, 0x00, 0x00, 0x00, 0x00, 0x00, 0x00, 0x00, 0x00, 0x00
 };
 oled_write_raw_P(gravitas_logo, sizeof(gravitas_logo));
};

#ifdef OLED_ENABLE

oled_rotation_t oled_init_user(oled_rotation_t rotation) { return OLED_ROTATION_180; }

#endif

static void render_layers(void) {
  static const char pop[][525] = {
      {
      // 'Pop1', 128x32px
      0x00, 0x00, 0x00, 0x00, 0x00, 0xc0, 0xf0, 0xf8, 0xf8, 0xfc, 0xfc, 0xfc, 0xfc, 0xfc, 0xfc, 0xfc, 
      0xfc, 0xfc, 0xfc, 0xfc, 0xfc, 0xfc, 0xfc, 0xfc, 0xfc, 0xfc, 0xfc, 0xfc, 0xf8, 0xf8, 0xf0, 0xc0, 
      0x00, 0x00, 0x00, 0x00, 0x00, 0x00, 0x00, 0x00, 0x00, 0x00, 0x00, 0x00, 0x00, 0x00, 0x00, 0x00, 
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      0xfc, 0xfc, 0xfc, 0xfc, 0xfc, 0xfc, 0xfc, 0xfc, 0xfc, 0xf8, 0xf8, 0xf0, 0xc0, 0x00, 0x00, 0x00
      },
      {
      // 'Pop2', 128x32px
      0x00, 0x00, 0x00, 0x00, 0x00, 0x00, 0x00, 0x00, 0x00, 0x00, 0x00, 0x00, 0x00, 0x00, 0x00, 0x00, 
      0x00, 0x00, 0x00, 0x00, 0x00, 0x00, 0x00, 0x00, 0x00, 0x00, 0x00, 0x00, 0x00, 0x00, 0x00, 0x00, 
      0x00, 0x00, 0x00, 0x00, 0xc0, 0xf0, 0xf8, 0xf8, 0xfc, 0xfc, 0xfc, 0xfc, 0xfc, 0xfc, 0xfc, 0xfc, 
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      0xfc, 0xfc, 0xfc, 0xfc, 0xfc, 0xfc, 0xfc, 0xfc, 0xfc, 0xf8, 0xf8, 0xf0, 0xc0, 0x00, 0x00, 0x00
      },
      {
      // 'Pop3', 128x32px
      0x00, 0x00, 0x00, 0x00, 0x00, 0x00, 0x00, 0x00, 0x00, 0x00, 0x00, 0x00, 0x00, 0x00, 0x00, 0x00, 
      0x00, 0x00, 0x00, 0x00, 0x00, 0x00, 0x00, 0x00, 0x00, 0x00, 0x00, 0x00, 0x00, 0x00, 0x00, 0x00, 
      0x00, 0x00, 0x00, 0x00, 0x00, 0x00, 0x00, 0x00, 0x00, 0x00, 0x00, 0x00, 0x00, 0x00, 0x00, 0x00, 
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      0xfc, 0xfc, 0xfc, 0xfc, 0xfc, 0xfc, 0xfc, 0xfc, 0xfc, 0xf8, 0xf8, 0xf0, 0xc0, 0x00, 0x00, 0x00
      },
      {
      // 'Pop4', 128x32px
      0x00, 0x00, 0x00, 0x00, 0x00, 0x00, 0x00, 0x00, 0x00, 0x00, 0x00, 0x00, 0x00, 0x00, 0x00, 0x00, 
      0x00, 0x00, 0x00, 0x00, 0x00, 0x00, 0x00, 0x00, 0x00, 0x00, 0x00, 0x00, 0x00, 0x00, 0x00, 0x00, 
      0x00, 0x00, 0x00, 0x00, 0x00, 0x00, 0x00, 0x00, 0x00, 0x00, 0x00, 0x00, 0x00, 0x00, 0x00, 0x00, 
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      0x3f, 0x3f, 0x3f, 0x3f, 0x3f, 0x3f, 0x3f, 0x3f, 0x3f, 0x1f, 0x1f, 0x0f, 0x03, 0x00, 0x00, 0x00
      }
  };
  oled_write_raw_P(pop[get_highest_layer(layer_state)], sizeof(pop[0]));
};

static void render_button_pressed(void) {
  static const char pressed[] = {
      // 'pressed', 128x32px
      0x00, 0x00, 0x00, 0x00, 0x00, 0x00, 0x00, 0x00, 0x00, 0x00, 0x00, 0x00, 0x00, 0x00, 0x00, 0x00, 
      0x00, 0x00, 0x00, 0x00, 0x00, 0x00, 0x00, 0x00, 0x00, 0x00, 0x00, 0x00, 0x00, 0x00, 0x00, 0x00, 
      0x00, 0x00, 0x00, 0x00, 0x00, 0x00, 0x00, 0x00, 0x00, 0xf0, 0x08, 0x08, 0x08, 0x90, 0x00, 0xf8, 
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      0x00, 0x00, 0x00, 0x00, 0x00, 0x00, 0x00, 0x00, 0x00, 0x00, 0x00, 0x00, 0x00, 0x00, 0x00, 0x00
  };

  static const char not_pressed[] = {
      // 'not_pressed', 128x32px
      0x00, 0x00, 0x00, 0x00, 0x00, 0x00, 0x00, 0x00, 0x00, 0x00, 0x00, 0x00, 0x00, 0x00, 0x00, 0x00, 
      0x00, 0x00, 0x00, 0x00, 0x00, 0x00, 0x00, 0x00, 0x00, 0x00, 0x00, 0x00, 0x00, 0x00, 0x00, 0x00, 
      0x00, 0x00, 0x00, 0x00, 0x00, 0x00, 0x00, 0x00, 0x00, 0x00, 0x00, 0x00, 0x00, 0x00, 0x00, 0x00, 
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      0x00, 0x00, 0x00, 0x00, 0x00, 0x00, 0x00, 0x00, 0x00, 0x00, 0x00, 0x00, 0x00, 0x00, 0x00, 0x00
  };
  if (layer_changed)
    render_layers();
  else if (key_pressed)
      oled_write_raw_P(pressed, sizeof(pressed));
  else
      oled_write_raw_P(not_pressed, sizeof(not_pressed));
};

const uint16_t PROGMEM keymaps[][MATRIX_ROWS][MATRIX_COLS] = {

    [0] = LAYOUT(
        KC_A,   KC_B,   KC_C,  QK_USER,
        KC_D,   KC_E,   KC_F,   
        KC_G,   KC_H,   KC_I  

    ),
    [1] = LAYOUT(
        KC_J,   KC_K,   KC_L,  QK_USER,
        KC_M,   KC_N,   KC_O,   
        KC_P,   KC_Q,   KC_R  

    ),
    [2] = LAYOUT(
        KC_S,   KC_T,   KC_U,  QK_USER,
        KC_V,   KC_W,   KC_X,   
        KC_Y,   KC_Z,   KC_1  

    ),
    [3] = LAYOUT(
        KC_2,   KC_3,   KC_4,  QK_USER,
        KC_5,   KC_6,   KC_7,   
        KC_8,   KC_9,   KC_0  

    )
};

const uint16_t PROGMEM encoder_map[][NUM_ENCODERS][NUM_DIRECTIONS] = {
    [0] =   { ENCODER_CCW_CW(KC_VOLD, KC_VOLU)  },
    [1] =   { ENCODER_CCW_CW(KC_VOLD, KC_VOLU)  },
    [2] =   { ENCODER_CCW_CW(KC_VOLD, KC_VOLU)  },
    [3] =   { ENCODER_CCW_CW(KC_VOLD, KC_VOLU)  }

};

enum keycodes {
  KC_CYCLE_LAYERS = QK_USER,
};
  
  // Add the behaviour of this new keycode
bool process_record_user(uint16_t keycode, keyrecord_t *record) {
  switch (keycode) {
    case KC_CYCLE_LAYERS:
      if (!record->event.pressed) { 
          // We've already handled the keycode (doing nothing), let QMK know so no further code is run unnecessarily
        return false;
      }

      uint8_t current_layer = get_highest_layer(layer_state);
        
        // Check if we are within the range, if not quit
      if (current_layer > LAYER_CYCLE_END || current_layer < LAYER_CYCLE_START) {
        return false;
      }
  
      uint8_t next_layer = current_layer + 1;
      if (next_layer > LAYER_CYCLE_END) {
            next_layer = LAYER_CYCLE_START;
      }
      layer_move(next_layer);
      render_layers();
      key_timer = timer_read();
      layer_changed = true;
      return false;
      // Process other keycodes normally
    default:
      return true;
  }
};

void check_timer(void) {
  if (timer_elapsed(key_timer) > 4000) {
    layer_changed = false;
    render_logo();
  }
};

void housekeeping_task_user(void) {
  if(layer_changed){

    check_timer();
  }
};

bool oled_task_kb(void) {
  if (!oled_task_user()) {
      return false;
  }

  static bool logo_rendered = false;
  if (!logo_rendered) {
      render_logo();
      if (timer_read() > 3000)
          logo_rendered = true;
      }
      else {
        render_button_pressed();
      }
  return false;
};

bool process_record_kb(uint16_t keycode, keyrecord_t *record) {
  key_pressed = record->event.pressed;

  return process_record_user(keycode, record);
};





