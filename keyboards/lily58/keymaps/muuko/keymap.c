/* Copyright 2020 @muuko
 *
 * This program is free software: you can redistribute it and/or modify
 * it under the terms of the GNU General Public License as published by
 * the Free Software Foundation, either version 2 of the License, or
 * (at your option) any later version.
 *
 * This program is distributed in the hope that it will be useful,
 * but WITHOUT ANY WARRANTY; without even the implied warranty of
 * MERCHANTABILITY or FITNESS FOR A PARTICULAR PURPOSE.  See the
 * GNU General Public License for more details.
 *
 * You should have received a copy of the GNU General Public License
 * along with this program.  If not, see <http://www.gnu.org/licenses/>.
 */

#include QMK_KEYBOARD_H
#include <stdio.h>
#include <string.h>

#define IDLE_FRAMES 5
#define IDLE_SPEED 20
#define TAP_FRAMES 2
#define TAP_SPEED 40
#define ANIM_FRAME_DURATION 200
#define ANIM_SIZE 512

char wpm[16];
uint32_t anim_timer = 0;
uint32_t anim_sleep = 0;
uint8_t current_idle_frame = 0;
uint8_t current_tap_frame = 0;

static long int oled_timeout = 300000;

enum combos { ESCAPE_COMBO, DELETE_COMBO };
const uint16_t PROGMEM escape_combo[] = { KC_GRV, KC_1, COMBO_END };
const uint16_t PROGMEM delete_combo[] = { KC_DOT, KC_SLSH, COMBO_END };
combo_t key_combos[] = {
    [ESCAPE_COMBO] = COMBO(escape_combo, KC_ESC),
    [DELETE_COMBO] = COMBO(delete_combo, KC_DEL)
};

const uint16_t PROGMEM keymaps[][MATRIX_ROWS][MATRIX_COLS] = {
    [0] = LAYOUT(
        KC_GRV,  KC_1,    KC_2,          KC_3,   KC_4,   KC_5,                   KC_6,   KC_7,    KC_8,    KC_9,   KC_0,    LCA_T(KC_MINS),
        KC_TAB,  KC_Q,    KC_W,          KC_E,   KC_R,   KC_T,                   KC_Y,   KC_U,    KC_I,    KC_O,   KC_P,    RGUI_T(KC_EQL),
        KC_LCTL, KC_A,    KC_S,          KC_D,   KC_F,   KC_G,                   KC_H,   KC_J,    KC_K,    KC_L,   KC_SCLN, RCTL_T(KC_QUOT),
        KC_LSFT, KC_Z,    KC_X,          KC_C,   KC_V,   KC_B, KC_LBRC, KC_RBRC, KC_N,   KC_M,    KC_COMM, KC_DOT, KC_SLSH, RSFT_T(KC_BSLS),
        KC_LGUI, KC_LALT, LT(1, KC_DEL), KC_SPC,                                 KC_ENT, KC_BSPC, MO(1),   TG(1)
    ),
    [1] = LAYOUT(
        KC_ESC,  KC_F1,   KC_F2,   KC_F3,   KC_F4,   KC_F5,                     KC_F6,   KC_F7,   KC_F8,   KC_F9,  KC_F10,         KC_F11,
        KC_TAB,  KC_MNXT, KC_HOME, KC_UP,   KC_PGUP, KC_VOLU,                   KC_PMNS, KC_P7,   KC_P8,   KC_P9,  KC_PSLS,        LCTL(KC_RGUI),
        KC_LCTL, KC_MPLY, KC_LEFT, KC_DOWN, KC_RGHT, KC_VOLD,                   KC_PPLS, KC_P4,   KC_P5,   KC_P6,  KC_PAST,        RCTL_T(KC_PEQL),
        KC_LSFT, KC_MPRV, KC_END,  KC_DEL,  KC_PGDN, KC_MUTE, KC_LPRN, KC_RPRN, KC_P0,   KC_P1,   KC_P2,   KC_P3,  C_S_T(KC_PDOT), KC_RSFT,
        KC_TRNS, KC_TRNS, KC_TRNS, KC_TRNS,                                     KC_TRNS, KC_TRNS, KC_TRNS, KC_TRNS
    )
};

#ifdef OLED_ENABLE
oled_rotation_t oled_init_user(oled_rotation_t rotation) {
	if (!is_keyboard_master()) return OLED_ROTATION_180;
    else return rotation;
}

static void render_status(void) {
    oled_write_P(PSTR("    layer "), false);

    switch (get_highest_layer(layer_state)) {
        case 0:
            oled_write_P(PSTR("     0"), false);
            break;
        case 1:
            oled_write_P(PSTR("     1"), false);
            break;
        default:
            oled_write_P(PSTR("     ?"), false);
            break;
    }

    oled_write_P(PSTR("\n\n    "), false);
    sprintf(wpm, "%03d", get_current_wpm());
    oled_write(wpm, false);
    oled_write_P(PSTR("      wpm"), false);
}

static void render_anim(void) {
    static const char PROGMEM idle[IDLE_FRAMES][ANIM_SIZE] = {
        {
            0,0,0,0,0,0,0,0,0,0,0,0,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64,
            64,64,32,32,32,32,16,16,16,16,8,8,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7,
            0,0,0,0,0,0,0,0,0,0,0,0,0,0,0,0,0,0,0,0,0,0,0,0,0,0,0,0,0,0,0,0,0,0,0,0,0,0,0,0,0,0,0,0,0,0,0,0,0,0,0,0,0,0,0,0,0,0,0,0,0
        },
        {
            0,0,0,0,0,0,0,0,0,0,0,0,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64,
            64,64,32,32,32,32,16,16,16,16,8,8,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8,
            7,0,0,0,0,0,0,0,0,0,0,0,0,0,0,0,0,0,0,0,0,0,0,0,0,0,0,0,0,0,0,0,0,0,0,0,0,0,0,0,0,0,0,0,0,0,0,0,0,0,0,0,0,0,0,0,0,0,0,0,0,0
        },
        {
            0,0,0,0,0,0,0,0,0,0,0,0,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32,
            32,32,32,16,16,16,16,8,8,8,8,8,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0,
            0,0,0,0,0,0,0,0,0,0,0,0,0,0,0,0,0,0,0,0,0,0,0,0,0,0,0,0,0,0,0,0,0,0,0,0,0,0,0,0,0,0,0,0,0,0,0,0,0,0,0,0,0,0,0,0,0,0
        },
        {
            0,0,0,0,0,0,0,0,0,0,0,0,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64,
            64,64,32,32,32,32,16,16,16,16,8,8,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8,
            7,0,0,0,0,0,0,0,0,0,0,0,0,0,0,0,0,0,0,0,0,0,0,0,0,0,0,0,0,0,0,0,0,0,0,0,0,0,0,0,0,0,0,0,0,0,0,0,0,0,0,0,0,0,0,0,0,0,0,0,0,0
        },
        {
            0,0,0,0,0,0,0,0,0,0,0,0,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64,
            32,32,32,32,16,16,16,16,8,8,8,8,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0,
            0,0,0,0,0,0,0,0,0,0,0,0,0,0,0,0,0,0,0,0,0,0,0,0,0,0,0,0,0,0,0,0,0,0,0,0,0,0,0,0,0,0,0,0,0,0,0,0,0,0,0,0,0,0,0,0,0,0,0
        }
    };
    static const char PROGMEM prep[][ANIM_SIZE] = {
        {
            0,0,0,0,0,0,0,0,0,0,0,0,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64,
            64,64,32,32,32,32,16,16,16,16,8,8,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0,
            0,0,0,0,0,0,0,0,0,0,0,0,0,0,0,0,0,0,0,0,0,0,0,0,0,0,0,0,0,0,0,0,0,0,0,0,0,0,0,0,0,0,0,0,0,0,0,0,0,0,0,0,0,0,0,0,0,0,0,0,0,0
        }
    };
    static const char PROGMEM tap[TAP_FRAMES][ANIM_SIZE] = {
        {
            0,0,0,0,0,0,0,0,0,0,0,0,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159,
            95,95,79,76,32,32,32,32,16,16,16,16,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1,
            1,1,1,0,0,0,0,0,0,0,0,0,0,0,0,0,0,0,0,0,0,0,0,0,0,0,0,0,0,0,0,0,0,0,0,0,0,0,0,1,3,3,0,0,0,0,0,0,0,0,0,0,0,0,0,0,0,0,0,0,0,0,0,0,0,0,0,0,0,0,0,0,0,0
        },
        {
            0,0,0,0,0,0,0,0,0,0,0,0,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32,
            32,32,32,16,16,16,16,8,8,8,8,8,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128,
            0,0,0,0,0,0,0,0,0,0,0,0,0,0,0,0,0,0,0,0,0,0,0,0,0,0,0,0,0,0,0,0,0,0,0,0,0,0,0,0,0,0,0,0,0,0,0,0,0,0,0,0,0,0,0,0,0,0,0,0
        }
    };

    void animation_phase(void) {
        if (get_current_wpm() <= IDLE_SPEED) {
            current_idle_frame = (current_idle_frame + 1) % IDLE_FRAMES;

            oled_write_raw_P(idle[abs((IDLE_FRAMES - 1) - current_idle_frame)], ANIM_SIZE);
        }

        if (get_current_wpm() > IDLE_SPEED && get_current_wpm() < TAP_SPEED) {
            oled_write_raw_P(prep[0], ANIM_SIZE);
        }

        if (get_current_wpm() >= TAP_SPEED) {
            current_tap_frame = (current_tap_frame + 1) % TAP_FRAMES;

            oled_write_raw_P(tap[abs((TAP_FRAMES - 1) - current_tap_frame)], ANIM_SIZE);
        }
    }

    sprintf(wpm, "%03d", get_current_wpm());

    if (strcmp(wpm, "000") != 0) {
        anim_sleep = timer_read32();
    } else {
        if (timer_elapsed32(anim_sleep) > oled_timeout) {
            anim_sleep = 0;
        }
    }

    if (timer_elapsed32(anim_sleep) > oled_timeout) {
        oled_off();
    } else {
        oled_on();

        if (timer_elapsed32(anim_timer) > ANIM_FRAME_DURATION) {
            anim_timer = timer_read32();

            animation_phase();
        }
    }
}

bool oled_task_user(void) {
    if (is_keyboard_master()) {
        render_status();
    } else {
        render_anim();
    }
    return false;
}
#endif
