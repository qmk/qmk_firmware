/* Copyright 2023 Elliot Powell
 *
 * This program is free software: you can redistribute it and/or modify
 * it under the terms of the GNU General Public License as published by
 * the Free Software Foundation, either version 2 of the License, or
 * (at your option) any later version.
 *
 * This program is distributed in the hope that it will be useful,
 * but WITHOUT ANY WARRANTY; without even the implied warranty of
 * MERCHANTABILITY or FITNESS FOR A PARTICULAR PURPOSE.  See the
 * GNU General Public License for more details.
 *
 * You should have received a copy of the GNU General Public License
 * along with this program.  If not, see <http://www.gnu.org/licenses/>.
 */

#include "quantum.h"


#ifdef OLED_ENABLE

oled_rotation_t oled_init_kb(oled_rotation_t rotation) {
    return OLED_ROTATION_270;
    if (!is_keyboard_master()) {
        return OLED_ROTATION_0;  // flips the display 180 degrees if offhand
    }
    return rotation;
}




//char keylog_str_r2g[24] = {};

// const char code_to_name_r2g[60] = {
//     ' ', ' ', ' ', ' ', 'a', 'b', 'c', 'd', 'e', 'f',
//     'g', 'h', 'i', 'j', 'k', 'l', 'm', 'n', 'o', 'p',
//     'q', 'r', 's', 't', 'u', 'v', 'w', 'x', 'y', 'z',
//     '1', '2', '3', '4', '5', '6', '7', '8', '9', '0',
//     'R', 'E', 'B', 'T', '_', '-', '=', '[', ']', '\\',
//     '#', ';', '\'', '`', ',', '.', '/', ' ', ' ', ' '};

// char key_name_r2g = ' ';
// uint16_t last_keycode_r2g;
// uint8_t last_row_r2g;
// uint8_t last_col_r2g;

// void set_keylog_r2g(uint16_t keycode, keyrecord_t *record) {
//     key_name_r2g = ' ';
//     last_keycode_r2g = keycode;
//     if ((keycode >= QK_MOD_TAP && keycode <= QK_MOD_TAP_MAX) ||
//         (keycode >= QK_LAYER_TAP && keycode <= QK_LAYER_TAP_MAX)) { last_keycode_r2g = keycode & 0xFF; }
//     if (keycode < 60) {
//       key_name_r2g = code_to_name_r2g[keycode];
//     }
//     last_row_r2g = record->event.key.row;
//     last_col_r2g = record->event.key.col;
// }

// const char *depad_str(const char *depad_str, char depad_char) {
//     while (*depad_str == depad_char) ++depad_str;
//     return depad_str;
// }

// void oled_render_keylog_r2g(void) {
//     //oled_write(keylog_str_r2g, false);
//     const char *last_row_r2g_str = get_u8_str(last_row_r2g, ' ');
//     oled_write(depad_str(last_row_r2g_str, ' '), false);
//     oled_write_P(PSTR("x"), false);
//     const char *last_col_r2g_str = get_u8_str(last_col_r2g, ' ');
//     oled_write(depad_str(last_col_r2g_str, ' '), false);
//     oled_write_P(PSTR(", k"), false);
//     const char *last_keycode_r2g_str = get_u16_str(last_keycode_r2g, ' ');
//     oled_write(depad_str(last_keycode_r2g_str, ' '), false);
//     oled_write_P(PSTR(":"), false);
//     oled_write_char(key_name_r2g, false);
// }

void render_bootmagic_status_r2g(bool status) {
    /* Show Ctrl-Gui Swap options */
    static const char PROGMEM logo[][2][3] = {
        {{0x97, 0x98, 0}, {0xb7, 0xb8, 0}},
        {{0x95, 0x96, 0}, {0xb5, 0xb6, 0}},
    };
    if (status) {
        oled_write_ln_P(logo[0][0], false);
        oled_write_ln_P(logo[0][1], false);
    } else {
        oled_write_ln_P(logo[1][0], false);
        oled_write_ln_P(logo[1][1], false);
    }
}

void oled_render_logo_r2g(void) {
    static const char PROGMEM mb_logo[] = {
        0x00, 0x00, 0x00, 0x00, 0x00, 0xfe, 0xff, 0xff, 0xff, 0xff, 0xff, 0xff, 0xff, 0xff, 0xff, 0xff,
        0xff, 0xff, 0xff, 0xff, 0xff, 0xff, 0xff, 0xff, 0xff, 0xff, 0xff, 0xff, 0xff, 0xff, 0xff, 0xff,
        0xff, 0xff, 0xff, 0xff, 0xff, 0xff, 0xff, 0xff, 0xff, 0xff, 0xff, 0xff, 0x0f, 0x0f, 0x0f, 0x0f,
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        0x00, 0x00, 0x00, 0x00, 0x00, 0x00, 0x00, 0x00, 0x00, 0x00, 0x00, 0x00, 0x00, 0x00, 0x00, 0x00
    };

    oled_write_raw_P(mb_logo, sizeof(mb_logo));
    //oled_set_cursor(oled_max_chars()/2,oled_max_lines()/2);
    //oled_write_P(PSTR("R2G"), false);
}

void oled_render_layer_img_0(void) {
    static const char PROGMEM kb_layer_img_0[] = {
        // 'Layer_main', 32x128px
        0x00, 0x00, 0x00, 0x00, 0x00, 0x00, 0x00, 0x00, 0x00, 0x00, 0x00, 0x00, 0x00, 0x00, 0x00, 0x00,
        0x00, 0x00, 0x00, 0x00, 0x00, 0x00, 0x00, 0x00, 0x00, 0x00, 0x00, 0x00, 0x00, 0x00, 0x00, 0x00,
        0x00, 0x00, 0x00, 0x00, 0x00, 0x00, 0x00, 0x00, 0x00, 0x00, 0xe0, 0xe0, 0xe0, 0xc0, 0x00, 0x00,
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        0x00, 0x00, 0x00, 0x00, 0x00, 0x00, 0x00, 0x00, 0x00, 0x00, 0x00, 0x00, 0x00, 0x00, 0x00, 0x00
    };

    oled_write_raw_P(kb_layer_img_0, sizeof(kb_layer_img_0));
}

void oled_render_layer_img_1(void) {
    static const char PROGMEM kb_layer_img_1[] = {
        // 'Layer_raised', 32x128px
        0x00, 0x00, 0x00, 0x00, 0x00, 0x00, 0x00, 0x00, 0x00, 0x00, 0x00, 0x00, 0x80, 0x80, 0x80, 0x80,
        0x80, 0x80, 0x80, 0x00, 0x00, 0x00, 0x00, 0x00, 0x00, 0x00, 0x00, 0x00, 0x00, 0x00, 0x00, 0x00,
        0x00, 0x00, 0x00, 0x00, 0x00, 0x00, 0x00, 0x00, 0x00, 0x00, 0x00, 0x00, 0xff, 0xff, 0x40, 0x40,
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        0x00, 0x00, 0x00, 0x00, 0x00, 0x00, 0x00, 0x00, 0x00, 0x00, 0x00, 0x00, 0x00, 0x00, 0x00, 0x00
    };

    oled_write_raw_P(kb_layer_img_1, sizeof(kb_layer_img_1));
}

void oled_render_layer_img_2(void) {
    static const char PROGMEM kb_layer_img_2[] = {
        // 'Layer_10key', 32x128px
        0x00, 0x00, 0x00, 0x00, 0x00, 0x00, 0x00, 0x00, 0x00, 0x00, 0x00, 0x00, 0x00, 0x00, 0x00, 0x80,
        0x80, 0x00, 0x00, 0x00, 0x00, 0x00, 0x00, 0x00, 0x00, 0x00, 0x00, 0x00, 0x00, 0x00, 0x00, 0x00,
        0x00, 0x00, 0x00, 0x00, 0x00, 0x00, 0x00, 0x00, 0x00, 0x00, 0x00, 0x02, 0x06, 0x03, 0x01, 0x01,
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        0x00, 0x00, 0x00, 0x00, 0x00, 0x00, 0x00, 0x00, 0x00, 0x00, 0x00, 0x00, 0x00, 0x00, 0x00, 0x00
    };

    oled_write_raw_P(kb_layer_img_2, sizeof(kb_layer_img_2));
}

void get_kb_led_status_caps_lock(void) {
    bool caps = host_keyboard_led_state().caps_lock;
    oled_write_P(PSTR("CAPS\n"), false);
    switch (caps) {
        case 0:
            oled_write_ln_P(PSTR("Off"), false);
            break;
        case 1:
            oled_write_ln_P(PSTR("On"), false);
            break;
    }

}

void get_kb_led_status_num_lock(void) {
    bool numlck = host_keyboard_led_state().num_lock;
    oled_write_P(PSTR("NUMLK"), false);
    switch (numlck) {
        case 0:
            oled_write_ln_P(PSTR("Off"), false);
            break;
        case 1:
            oled_write_ln_P(PSTR("On"), false);
            break;
    }

}

void oled_render_layer_state_r2g(void) {
    // oled_write_P(PSTR("Layer: "), false);
    switch (get_highest_layer(layer_state)) {
        case 0:
            oled_render_layer_img_0();
            break;
        case 1:
            oled_render_layer_img_1();
            break;
        case 2:
            oled_render_layer_img_2();
            break;
        // case 3:
        //     oled_write_ln_P(PSTR("Adjust"), false);
        //     break;
        // default:
        //     oled_write_ln_P(PSTR("Unknown"), false);
        //     break;
    }
}

bool oled_task_kb(void) {
    if (!oled_task_user()) { return false; }
    if (is_keyboard_master()) {
        oled_render_layer_state_r2g();
        // oled_render_keylog_r2g();
    } else {
        // oled_render_logo_r2g();
        get_kb_led_status_caps_lock();
        oled_write_ln_P(PSTR("\n"), false);
        get_kb_led_status_num_lock();
    }
    return false;
}

// bool process_record_kb(uint16_t keycode, keyrecord_t *record) {
//   if (record->event.pressed) {
//     set_keylog_r2g(keycode, record);
//   }
//   return process_record_user(keycode, record);
// }
#endif // OLED_ENABLE
