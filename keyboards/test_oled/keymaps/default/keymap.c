/* Copyright 2021 marby3
 *
 * This program is free software: you can redistribute it and/or modify
 * it under the terms of the GNU General Public License as published by
 * the Free Software Foundation, either version 2 of the License, or
 * (at your option) any later version.
 *
 * This program is distributed in the hope that it will be useful,
 * but WITHOUT ANY WARRANTY; without even the implied warranty of
 * MERCHANTABILITY or FITNESS FOR A PARTICULAR PURPOSE.  See the
 * GNU General Public License for more details.
 *
 * You should have received a copy of the GNU General Public License
 * along with this program.  If not, see <http://www.gnu.org/licenses/>.
 */
#include QMK_KEYBOARD_H

// Defines names for use in layer keycodes and the keymap
enum layer_names {
    _BASE,
    _FN
};

// Defines the keycodes used by our macros in process_record_user
enum custom_keycodes {
    QMKBEST = SAFE_RANGE,
    QMKURL
};

const uint16_t PROGMEM keymaps[][MATRIX_ROWS][MATRIX_COLS] = {
    /* Base */
    [_BASE] = LAYOUT(
        KC_A,    KC_1,    MO(_FN),
            KC_TAB,   KC_SPC
    ),
    [_FN] = LAYOUT(
        QMKBEST, QMKURL,  _______,
            RESET,    XXXXXXX
    )
};

bool process_record_user(uint16_t keycode, keyrecord_t *record) {
    switch (keycode) {
        case QMKBEST:
            if (record->event.pressed) {
                // when keycode QMKBEST is pressed
                SEND_STRING("QMK is the best thing ever!");
            } else {
                // when keycode QMKBEST is released
            }
            break;
        case QMKURL:
            if (record->event.pressed) {
                // when keycode QMKURL is pressed
                SEND_STRING("https://qmk.fm/\n");
            } else {
                // when keycode QMKURL is released
            }
            break;
    }
    return true;
}

#ifdef OLED_DRIVER_ENABLE

static void render_logo(void) {
    static const char PROGMEM formy46_logo[] = {
// 'canvas_raw', 128x32px
	0x8c, 0x86, 0x86, 0x86, 0x86, 0x86, 0x8c, 0x98, 0x8c, 0x86, 0x86, 0x86, 0x86, 0x86, 0x8c, 0x98,
	0x8c, 0x86, 0x86, 0x86, 0x86, 0x86, 0x8c, 0x98, 0x8c, 0x86, 0x86, 0x86, 0x86, 0x86, 0x8c, 0x98,
	0x00, 0x78, 0x7c, 0xc6, 0xc6, 0xc6, 0xc6, 0xfc, 0xf8, 0xc0, 0xf8, 0xf8, 0xc0, 0xc0, 0xc0, 0xc0,
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	0x00, 0x00, 0x00, 0x00, 0x00, 0x00, 0x00, 0x00, 0x00, 0x00, 0x00, 0x00, 0x00, 0x00, 0x00, 0x00
    };
    oled_write_raw_P(formy46_logo, sizeof(formy46_logo));
}
void oled_task_user(void) {
    if (is_keyboard_master()) {
    // If you want to put your image on the master side, put your function call here:
    render_logo();
    oled_scroll_left();  // Turns on scrolling
    } else {
    // And if you want to put your image on the slave side, put it here instead:
    render_logo();
    }
}
#endif
