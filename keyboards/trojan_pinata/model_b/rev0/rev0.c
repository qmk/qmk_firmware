/* Copyright 2024 Brian H (@Trojan_Pinata)
 *
 * This program is free software: you can redistribute it and/or modify
 * it under the terms of the GNU General Public License as published by
 * the Free Software Foundation, either version 2 of the License, or
 * (at your option) any later version.
 *
 * This program is distributed in the hope that it will be useful,
 * but WITHOUT ANY WARRANTY; without even the implied warranty of
 * MERCHANTABILITY or FITNESS FOR A PARTICULAR PURPOSE.  See the
 * GNU General Public License for more details.
 *
 * You should have received a copy of the GNU General Public License
 * along with this program.  If not, see <http://www.gnu.org/licenses/>.
 */

#include "rev0.h"

// NUM_MODES stays last to indicate the number of different screens possible
enum oled_modes {
    MTNS, INFO, LOGO, MEW, CEL, RAY, NUM_MODES
};

// define the key that switches the display
enum keeb_codes {
    OLED_MOD = QK_KB,
};

// virtual eeprom for storing last layer
typedef union {
    uint32_t raw;
    struct {
        uint8_t display_mode_saved : 3;
    };
} keyboard_config_t;
keyboard_config_t keyboard_config;

void keyboard_pre_init_kb(void) {
    keyboard_config.raw = eeconfig_read_kb();
    keyboard_pre_init_user();
}

void eeconfig_init_kb(void) {
    keyboard_config.raw = 0;
    keyboard_config.display_mode_saved = INFO;
    eeconfig_update_kb(keyboard_config.raw);
    eeconfig_init_user();
}

// oled stuff below
#ifdef OLED_ENABLE

// hold only let me just drop all of my embedded images rq
static const char PROGMEM bootscreen[] = {
    // 'modelb-oled', 128x32px
    0x00, 0x00, 0x00, 0x00, 0x00, 0x00, 0x00, 0x00, 0x00, 0x00, 0xc0, 0xc0, 0xc0, 0xc0, 0xc0, 0x00,
    0x00, 0x00, 0x00, 0x00, 0x00, 0x00, 0x00, 0x00, 0xc0, 0xc0, 0xc0, 0xc0, 0xc0, 0x00, 0x00, 0x00,
    0x00, 0x00, 0x00, 0x00, 0x80, 0x80, 0xc0, 0xc0, 0xc0, 0xc0, 0xc0, 0xc0, 0xc0, 0xc0, 0x80, 0x80,
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    0x01, 0x01, 0x01, 0x01, 0x00, 0x00, 0x00, 0x00, 0x00, 0x00, 0x00, 0x00, 0x00, 0x00, 0x00, 0x00
};

static const char PROGMEM mnts_l0[] = {
    // 'base', 128x32px
    0x00, 0x00, 0x00, 0x80, 0x40, 0x40, 0x40, 0xa0, 0xb0, 0xf0, 0xd0, 0xd0, 0xf8, 0xfc, 0xdc, 0xfe,
    0xff, 0xff, 0xff, 0xdf, 0xde, 0xde, 0x9c, 0xfc, 0xfc, 0xf8, 0xf8, 0xf0, 0xf0, 0x90, 0xa0, 0x40,
    0x40, 0x40, 0x80, 0x80, 0x80, 0x00, 0x00, 0x00, 0x00, 0x00, 0x00, 0x00, 0x00, 0x80, 0x80, 0x80,
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    0x00, 0x00, 0x01, 0x01, 0x03, 0x02, 0x06, 0x06, 0x0c, 0x08, 0x08, 0x10, 0x30, 0x20, 0x20, 0x60
};

static const char PROGMEM mnts_l1[] = {
    // 'alt', 128x32px
    0x00, 0x00, 0x00, 0x80, 0x40, 0x40, 0x40, 0xa0, 0xb0, 0xf0, 0xd0, 0xd0, 0xf8, 0xfc, 0xdc, 0xfe,
    0xff, 0xff, 0xff, 0xdf, 0xde, 0xde, 0x9c, 0xfc, 0xfc, 0xf8, 0xf8, 0xf0, 0xf0, 0x90, 0xa0, 0x40,
    0x40, 0x40, 0x80, 0x80, 0x80, 0x00, 0x00, 0x00, 0x00, 0x00, 0x00, 0x00, 0x00, 0x80, 0x80, 0x80,
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    0x00, 0x00, 0x01, 0x01, 0x03, 0x02, 0x06, 0x06, 0x0c, 0x08, 0x08, 0x10, 0x30, 0x20, 0x20, 0x60
};

static const char PROGMEM mew_disp[] = {
    // 'mewl2', 128x32px
    0x00, 0x00, 0x00, 0x00, 0x00, 0x00, 0x00, 0x00, 0x00, 0x00, 0x00, 0x80, 0x80, 0x40, 0x40, 0x40,
    0x60, 0x50, 0x10, 0xe0, 0x80, 0x00, 0x00, 0x00, 0x00, 0x00, 0x00, 0x00, 0x00, 0xc0, 0x30, 0x08,
    0x04, 0xc4, 0xf2, 0xfa, 0x7e, 0x3e, 0x1c, 0x00, 0x00, 0x00, 0x00, 0x00, 0x00, 0x00, 0x00, 0x00,
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    0x20, 0x41, 0x40, 0x40, 0x24, 0x30, 0x20, 0x20, 0xf0, 0x8f, 0x00, 0x00, 0x00, 0x00, 0x00, 0x00
};

static const char PROGMEM cel_disp[] = {
    // 'celebi1', 128x32px
    0x00, 0x00, 0x00, 0x00, 0x00, 0x00, 0x00, 0x00, 0x00, 0x00, 0x00, 0x00, 0x00, 0x00, 0x00, 0xc0,
    0x20, 0xc0, 0xe0, 0xe0, 0xf0, 0xdc, 0xee, 0xf0, 0xbe, 0xc0, 0xc0, 0x00, 0x00, 0x00, 0x00, 0x00,
    0x00, 0x00, 0x00, 0x00, 0x00, 0x00, 0x00, 0x00, 0x00, 0x00, 0x00, 0x00, 0x00, 0x00, 0x00, 0x00,
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    0x07, 0x0e, 0x3c, 0x39, 0x79, 0x71, 0x71, 0x60, 0xe0, 0xc0, 0x80, 0x00, 0x00, 0x00, 0x00, 0x00
};

static const char PROGMEM rayq_disp[] = {
    // 'rayquaza1', 128x32px
    0x00, 0x00, 0x00, 0x00, 0x00, 0x00, 0x00, 0x01, 0x01, 0x02, 0x02, 0x04, 0x04, 0x08, 0x08, 0x10,
    0x10, 0x20, 0x20, 0x40, 0x40, 0x40, 0x70, 0x70, 0x71, 0x50, 0x60, 0x60, 0x60, 0x40, 0x80, 0x80,
    0xc0, 0x80, 0x00, 0x00, 0x00, 0x00, 0x00, 0x00, 0x00, 0x00, 0x00, 0x00, 0x00, 0x00, 0x00, 0x00,
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    0x00, 0x00, 0x00, 0x00, 0xfc, 0xfc, 0xc0, 0x3f, 0xfc, 0xc0, 0x00, 0x00, 0x00, 0x00, 0x00, 0x00
};

// invert display based on layer
static void inv_display(void) {
    switch (get_highest_layer(layer_state)) {
        case 1:
            oled_invert(true);
            break;
        default:
            oled_invert(false);
            break;
    }
}

// MTNS
static void mountains(void) {
    switch (get_highest_layer(layer_state)) {
        case 0:
            oled_write_raw_P(mnts_l0, sizeof(mnts_l0));
            break;
        case 1:
            oled_write_raw_P(mnts_l1, sizeof(mnts_l1));
            break;
        default:
            oled_write_raw_P(mnts_l0, sizeof(mnts_l0));
            break;
    }
}

// INFO
static void info(void) {
    // get layer the board is on
    oled_write_P(PSTR("LAYER "), false);
    oled_write_P(PSTR(" "), true);
    oled_write_char(get_highest_layer(layer_state) + 0x30, true);
    oled_write_P(PSTR(" "), true);

    // here we do a bit of trickery
    oled_write_P(PSTR(" ENC "), false);
    oled_write_P(PSTR(" VOL "), true);

    // lock key statuses
    led_t led_state = host_keyboard_led_state();
    oled_set_cursor(9, 1);
    oled_write_P(PSTR(" CAP "), led_state.caps_lock);
    oled_set_cursor(14, 1);
    oled_write_P(PSTR(" SCR "), led_state.scroll_lock);

    // write model B here in invert text
    oled_set_cursor(0, 3);
    oled_write_P(PSTR(" MODEL-B "), true);

    // mod masks - if you don't know what these do, don't worry about them
    uint8_t mod_state = get_mods();
    oled_advance_char();
    oled_advance_char();
    oled_write_P(PSTR("S"), mod_state & MOD_MASK_SHIFT);
    oled_advance_char();
    oled_write_P(PSTR("C"), mod_state & MOD_MASK_CTRL);
    oled_advance_char();
    oled_write_P(PSTR("A"), mod_state & MOD_MASK_ALT);
    oled_advance_char();
    oled_write_P(PSTR("G"), mod_state & MOD_MASK_GUI);
    oled_advance_char();
}

// display logo - used on boot and exception state
static void logo(void) {
    oled_write_raw_P(bootscreen, sizeof(bootscreen));
}

// run this whenever the oled needs to update
bool oled_task_kb(void) {
    if (!oled_task_user()) {
        return false;
    }

    switch (keyboard_config.display_mode_saved) {
        case MTNS:
            mountains();
            break;
        case INFO:
            info();
            break;
        case LOGO:
            oled_write_raw_P(bootscreen, sizeof(bootscreen));   // write image to screen
            inv_display();                                      // invert image if necessary - remove if layer differs
            break;
        case MEW:
            oled_write_raw_P(mew_disp, sizeof(mew_disp));
            inv_display();
            break;
        case CEL:
            oled_write_raw_P(cel_disp, sizeof(cel_disp));
            inv_display();
            break;
        case RAY:
            oled_write_raw_P(rayq_disp, sizeof(rayq_disp));
            inv_display();
            break;
        default:
            logo();
    }
    return false;
}

// render this on boot/reset
void oled_render_boot(bool bootloader) {
    oled_clear();
    logo();
    oled_render_dirty(true);
}

// change depending on if OLED_MOD is pressed
bool process_record_kb(uint16_t keycode, keyrecord_t *record) {
    if (!process_record_user(keycode, record)) {
        return false;
    }
    if (keycode == OLED_MOD && record->event.pressed) {
        oled_clear();
        keyboard_config.display_mode_saved++;
        if (keyboard_config.display_mode_saved == NUM_MODES) {
            keyboard_config.display_mode_saved = 0;
        }
        eeconfig_update_kb(keyboard_config.raw);
    }
    return true;
}

#endif
