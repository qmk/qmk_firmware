/* A standard layout for the Dactyl Manuform ard */

#include QMK_KEYBOARD_H

#include "quantum.h"

char wpm_str[10];

#define _MAIN 0
#define _GAME 1
#define _SYMBOL 2
#define _RED 3
#define _GREEN 4
#define _BLUE 5
#define _QWERTY 6

#define GREEN MO(_GREEN)
#define RED MO(_RED)
#define SYMBOL MO(_SYMBOL)
#define BLUE MO(_BLUE)

#define L_ACG(kc) (LGUI(LALT(LCTL(kc))))
#define KC_DITTO (LGUI(LALT(LCTL(KC_GRAVE))))
#define _____________ KC_TRANSPARENT
#define PREV_TRK KC_MEDIA_PREV_TRACK
#define NEXT_TRK KC_MEDIA_NEXT_TRACK
#define PLAY_TRK KC_MEDIA_PLAY_PAUSE
#define AUD_MUTE KC_AUDIO_MUTE
#define AUD_UP KC_AUDIO_VOL_UP
#define AUD_DOWN KC_AUDIO_VOL_DOWN
#define SCR_LOCK KC_SCROLLLOCK

// A Alt
// C Control
// G Gui
// S Shift

#define R_A(kc) (RALT(kc))
#define R_C(kc) (RCTL(kc))
#define R_G(kc) (RGUI(kc))
#define R_S(kc) (RSFT(kc))

#define R_AC(kc) (RALT(RCTL(kc)))
#define R_AG(kc) (RGUI(RALT(kc)))
#define R_AS(kc) (RALT(RSFT(kc)))

#define R_CG(kc) (RGUI(RCTL(kc)))
#define R_CS(kc) (RCTL(RSFT(kc)))

#define R_GS(kc) (RGUI(RSFT(kc)))

#define L_GS(kc) (LGUI(LSFT(kc)))

const uint16_t PROGMEM keymaps[][MATRIX_ROWS][MATRIX_COLS] = {

  [_MAIN] = LAYOUT_alexgirarddev(
     KC_ESCAPE,    KC_1,         KC_2,         KC_3,         KC_4,         KC_5,                                                   KC_6,         KC_7,         KC_8,         KC_9,         KC_0,         KC_GRAVE,
     KC_TAB,       KC_QUOTE,     KC_COMMA,     KC_DOT,       KC_P,         KC_Y,     KC_AUDIO_MUTE,            KC_MEDIA_PLAY_PAUSE,KC_F,         KC_G,         KC_C,         KC_R,         KC_L,         KC_HOME,
     KC_LCTRL,     KC_A,         KC_O,         KC_E,         KC_U,         KC_I,                                                   KC_D,         KC_H,         KC_T,         KC_N,         KC_S,         KC_END,
     KC_LALT,      KC_SLASH,     KC_Q,         KC_J,         KC_K,         KC_X,                                                   KC_B,         KC_M,         KC_W,         KC_V,         KC_Z,         KC_ENTER,
     KC_LGUI,      KC_UP,        KC_DOWN,                                                                                                                                    KC_LEFT,      KC_RIGHT,     KC_APPLICATION,
                                               KC_SPC,       KC_LSHIFT,                                                                          RED,          GREEN,
                                                                           BLUE,         KC_BSPACE,                  KC_DELETE,    SYMBOL,
                                                                           RED,          TO(_GAME),                  TO(_QWERTY),  KC_F12
  ),
   [_GAME] = LAYOUT_alexgirarddev(
     _____________,_____________,_____________,_____________,_____________,_____________,                                          _____________,_____________,_____________,_____________,_____________,_____________,
     _____________,_____________,_____________,_____________,_____________,_____________,_____________,              _____________,_____________,_____________,_____________,_____________,_____________,_____________,
     _____________,_____________,_____________,_____________,_____________,_____________,                                          _____________,_____________,_____________,_____________,_____________,_____________,
     _____________,_____________,_____________,_____________,_____________,_____________,                                          _____________,_____________,_____________,_____________,_____________,_____________,
     _____________,_____________,_____________,                                                                                                                              _____________,_____________,_____________,
                                               _____________,_____________,                                                                      _____________,_____________,
                                                                           KC_LALT,      _____________,              _____________,_____________,
                                                                           KC_LCTRL,     TO(_MAIN),                  _____________,_____________
  ),
  [_SYMBOL] = LAYOUT_alexgirarddev(
     _____________,_____________,_____________,_____________,_____________,_____________,                                          _____________,_____________,_____________,_____________,_____________,_____________,
     _____________,KC_BSLASH,    KC_PIPE,      KC_PLUS,      KC_EQUAL,     KC_GRAVE,_____________,                  _____________,_____________,KC_7,         KC_8,         KC_9,         _____________,_____________,
     _____________,KC_LCBR,      KC_LBRACKET,  KC_LPRN,      KC_SCOLON,    KC_MINUS,                                               _____________,KC_4,         KC_5,         KC_6,         _____________,_____________,
     _____________,KC_RCBR,      KC_RBRACKET,  KC_RPRN,      KC_COLN,      KC_UNDS,                                                _____________,KC_1,         KC_2,         KC_3,         _____________,_____________,
     _____________,_____________,_____________,                                                                                                                              KC_0,         _____________,_____________,
                                               _____________,_____________,                                                                      _____________,_____________,
                                                                           _____________,_____________,             _____________,_____________,
                                                                           _____________,_____________,             _____________,_____________
  ),
  [_RED] = LAYOUT_alexgirarddev(
    LALT(KC_F4),  _____________,_____________,_____________,_____________,_____________,                                          _____________,_____________,_____________,_____________,_____________,LCTL(LALT(KC_DEL)),
    _____________,KC_DITTO,     LCTL(KC_X),   LCTL(KC_C),   LCTL(KC_V),   KC_PSCREEN,   _____________,              _____________,KC_F14,       KC_F15,       KC_F16,       KC_F17,       KC_F18,       KC_F19,
    _____________,KC_UP,        KC_DOWN,      KC_LEFT,      KC_RIGHT,     KC_MS_BTN4,                                             KC_F22,       KC_F23,       KC_F24,       RSFT(KC_F14), RSFT(KC_F15), RSFT(KC_F16),
    _____________,LCTL(KC_Z),   LCTL(KC_Y),   LCTL(KC_A),   _____________,KC_MS_BTN5,                                             RSFT(KC_F17), RSFT(KC_F18), RSFT(KC_F19), RSFT(KC_F20), RSFT(KC_F21), RSFT(KC_F22),
    PREV_TRK,     KC_PGUP,      KC_PGDOWN,                                                                                                                                  RSFT(KC_F23), RSFT(KC_F24), RCTL(KC_F13),
                                              AUD_MUTE,     _____________,                                                                      _____________,_____________,
                                                                          AUD_UP,       AUD_DOWN,                   _____________,_____________,
                                                                          PLAY_TRK,     NEXT_TRK,                   _____________,_____________
  ),
  [_GREEN] = LAYOUT_alexgirarddev(
    RCTL(KC_F16), RCTL(KC_F17), RCTL(KC_F18), RCTL(KC_F19), RCTL(KC_F20), RCTL(KC_F21),                                           RGUI(KC_F19), RGUI(KC_F20), RGUI(KC_F21), RGUI(KC_F22), RGUI(KC_F23), RGUI(KC_F24),
    RCTL(KC_F23), RCTL(KC_F24), RALT(KC_F13), RALT(KC_F14), RALT(KC_F15), RALT(KC_F16),_____________,               _____________,R_CS(KC_F13), R_CS(KC_F14), R_CS(KC_F15), R_CS(KC_F16), R_CS(KC_F17), R_CS(KC_F18),
    RALT(KC_F17), LGUI(KC_UP),  LGUI(KC_DOWN),L_GS(KC_LEFT),L_GS(KC_RIGHT),RALT(KC_F18),                                          R_CS(KC_F19), R_CS(KC_F20), R_CS(KC_F21), R_CS(KC_F22), R_CS(KC_F23), R_CS(KC_F24),
    RALT(KC_F19), RALT(KC_F20), RALT(KC_F21), RALT(KC_F22), RALT(KC_F23), RALT(KC_F24),                                           R_AS(KC_F13), R_AS(KC_F14), R_AS(KC_F15), R_AS(KC_F16), R_AS(KC_F17), R_AS(KC_F18),
    RGUI(KC_F15), R_AC(KC_F13), RGUI(KC_F17),                                                                                                                               R_AS(KC_F19), R_AS(KC_F20), R_AS(KC_F21),
                                              KC_ESCAPE,    _____________,                                                                      _____________,_____________,
                                                                           _____________,_____________,              _____________,_____________,
                                                                           _____________,_____________,              _____________,_____________
  ),
  [_BLUE] = LAYOUT_alexgirarddev(
    R_GS(KC_F13) ,R_GS(KC_F14) ,R_GS(KC_F15) ,R_AC(KC_F14) ,R_GS(KC_F17) ,R_GS(KC_F18) ,                                           _____________,KC_F10       ,KC_F11       ,KC_F12       ,_____________,KC_CAPSLOCK  ,
    _____________,R_GS(KC_F19) ,R_GS(KC_F20) ,R_GS(KC_F21) ,R_GS(KC_F22) ,R_GS(KC_F23) ,_____________,               _____________,_____________,KC_F7        ,KC_F8        ,KC_F9        ,_____________,KC_NUMLOCK   ,
    _____________,R_GS(KC_F24) ,R_CG(KC_F13) ,R_CG(KC_F14) ,R_CG(KC_F15) ,R_AC(KC_F15) ,                                           _____________,KC_F4        ,KC_F5        ,KC_F6        ,_____________,KC_SCROLLLOCK,
    _____________,R_CG(KC_F17) ,R_CG(KC_F18) ,R_CG(KC_F19) ,R_CG(KC_F20) ,R_CG(KC_F21) ,                                           _____________,KC_F1        ,KC_F2        ,KC_F3        ,_____________,_____________,
    _____________,R_CG(KC_F22) ,R_CG(KC_F23) ,                                                                                                                               _____________,_____________,_____________,
                                              _____________,_____________,                                                                      _____________,_____________,
                                                                          _____________,_____________,              _____________,_____________,
                                                                          _____________,_____________,              _____________,_____________
  ),
  [_QWERTY] = LAYOUT_alexgirarddev(
    KC_ESCAPE,    KC_1,         KC_2,         KC_3,         KC_4,         KC_5,                                                   KC_6,         KC_7,         KC_8,         KC_9,         KC_0,         KC_GRAVE,
    KC_TAB,       KC_Q,         KC_W,         KC_E,         KC_R,         KC_T,         _____________,              _____________,KC_Y,         KC_U,         KC_I,         KC_O,         KC_P,         KC_HOME,
    KC_LCTRL,     KC_A,         KC_S,         KC_D,         KC_F,         KC_G,                                                   KC_H,         KC_J,         KC_K,         KC_L,         KC_L,         KC_END,
    KC_LALT,      KC_Z,         KC_X,         KC_C,         KC_V,         KC_B,                                                   KC_N,         KC_M,         KC_W,         KC_W,         KC_W,         KC_ENTER,
    KC_LGUI,      KC_UP,        KC_DOWN,                                                                                                                                    KC_LEFT,      KC_RIGHT,     KC_APPLICATION,
                                              KC_SPC,       KC_LSHIFT,                                                                          RED,          GREEN,
                                                                           BLUE,         KC_BSPACE,                  KC_DELETE,   SYMBOL,
                                                                           RED,          TO(_GAME),                  TO(_MAIN),   _____________
  )
};

bool process_record_user(uint16_t keycode, keyrecord_t *record) { return true; }

#ifdef OLED_ENABLE

// WPM-responsive animation stuff here
#define IDLE_FRAMES 5
#define IDLE_SPEED 40 // below this wpm value your animation will idle

// #define PREP_FRAMES 1 // uncomment if >1

#define TAP_FRAMES 2
#define TAP_SPEED 60 // above this wpm value typing animation to triggere

#define ANIM_FRAME_DURATION 200 // how long each frame lasts in ms
// #define SLEEP_TIMER 60000 // should sleep after this period of 0 wpm, needs fixing
#define ANIM_SIZE 636 // number of bytes in array, minimize for adequate firmware size, max is 1024

uint32_t anim_timer = 0;
uint32_t anim_sleep = 0;
uint8_t current_idle_frame = 0;
// uint8_t current_prep_frame = 0; // uncomment if PREP_FRAMES >1
uint8_t current_tap_frame = 0;
#define _MAIN 0
#define _GAME 1
#define _SYMBOL 2
#define _RED 3
#define _GREEN 4
#define _BLUE 5
#define _QWERTY 6
static void render_status(void) {
    // Host Keyboard Layer Status
    oled_write_P(PSTR("Layer: "), false);
    switch (get_highest_layer(layer_state)) {
        case _MAIN:
            oled_write_P(PSTR("DVORAK"), false);
            break;
        case _GAME:
            oled_write_P(PSTR("GAME"), false);
            break;
        case _SYMBOL:
            oled_write_P(PSTR("SYMBOLS"), false);
            break;
        case _RED:
            oled_write_P(PSTR("RED"), false);
            break;
        default:
            oled_write_P(PSTR("Undefined"), false);
    }

    //Host Keyboard LED Status
    led_t led_state = host_keyboard_led_state();
    oled_write_P(led_state.num_lock ? PSTR("NUM ") : PSTR("       "), false);
    oled_write_P(led_state.caps_lock ? PSTR("CAPS ") : PSTR("       "), false);
    oled_write_P(led_state.scroll_lock ? PSTR("SCRL") : PSTR("       "), false);
}

static void render_anim(void) {
    static const char PROGMEM idle[IDLE_FRAMES][ANIM_SIZE] = {
        {
        0,  0,126,126, 24, 60,102, 66,  0, 12, 28,112,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128,
        0,  0,  0,  0,192, 96, 48, 24, 12,132,198, 98,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  0,
        0,  0,252, 15,  1,  0,248, 14, 31,109,140,148,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  0,
        0,  0, 31,120,192,  0, 15, 56,124,219,152, 20,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  0,
        32, 16, 16, 16, 17, 11, 14, 12, 24, 16, 49, 35,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  8
        },
        {
        0,  0,126,126, 24, 60,102, 66,  0, 12, 28,112,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128,
        0,  0,  0,  0,192, 96, 48, 24, 12,132,198, 98,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  0,
        0,  0,252, 15,  1,  0,248, 14, 31,109,140,148,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  0,
        0,  0, 31,120,192,  0, 15, 56,124,219,152, 20,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  0,
        32, 16, 16, 16, 17, 11, 14, 12, 24, 16, 49, 35,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  8
        },
        {
        0,  0,126,126, 24, 60,102, 66,  0, 12, 28,112,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128,
        0,  0,  0,  0,192, 96, 48, 24, 12,132,198, 98,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  0,
        0,  0,252, 15,  1,  0,248, 14, 31,109,140,148,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  0,
        0,  0, 31,120,192,  0, 15, 56,124,219,152, 20,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  0,
        32, 16, 16, 16, 17, 11, 14, 12, 24, 16, 49, 35,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  8
        },
        {
        0,  0,126,126, 24, 60,102, 66,  0, 12, 28,112,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128,
        0,  0,  0,  0,192, 96, 48, 24, 12,132,198, 98,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  0,
        0,  0,252, 15,  1,  0,248, 14, 31,109,140,148,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  0,
        0,  0, 31,120,192,  0, 15, 56,124,219,152, 20,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  0,
        32, 16, 16, 16, 17, 11, 14, 12, 24, 16, 49, 35,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  8
        },
        {
        0,  0,126,126, 24, 60,102, 66,  0, 12, 28,112,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128,
        0,  0,  0,  0,192, 96, 48, 24, 12,132,198, 98,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  0,
        0,  0,252, 15,  1,  0,248, 14, 31,109,140,148,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  0,
        0,  0, 31,120,192,  0, 15, 56,124,219,152, 20,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  0,
        32, 16, 16, 16, 17, 11, 14, 12, 24, 16, 49, 35,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  8
        }
    };
    static const char PROGMEM prep[][ANIM_SIZE] = {
        {
        0,  0,126,126, 24, 60,102, 66,  0, 12, 28,112,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128,
        0,  0,  0,  0,192, 96, 48, 24, 12,132,198, 98,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  0,
        0,  0,252, 15,  1,  0,248, 14, 31,109,140,148,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  0,
        0,  0, 31,120,192,  0, 15, 56,124,219,152, 20,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  0,
        32, 16, 16, 16, 17, 11, 14, 12, 24, 16, 49, 35,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  8
        }
    };
    static const char PROGMEM tap[TAP_FRAMES][ANIM_SIZE] = {
        {
        0,  0,126,126, 24, 60,102, 66,  0, 12, 28,112,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128,
        0,  0,  0,  0,192, 96, 48, 24, 12,132,198, 98,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  0,
        0,  0,252, 15,  1,  0,248, 14, 31,109,140,148,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  0,
        0,  0, 31,120,192,  0, 15, 56,124,219,152, 20,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  0,
        32, 16, 16, 16, 17, 11, 14, 12, 24, 16, 49, 35,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  8
        },
        {
        0,  0,126,126, 24, 60,102, 66,  0, 12, 28,112,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128,
        0,  0,  0,  0,192, 96, 48, 24, 12,132,198, 98,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  0,
        0,  0,252, 15,  1,  0,248, 14, 31,109,140,148,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  0,
        0,  0, 31,120,192,  0, 15, 56,124,219,152, 20,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  0,
        32, 16, 16, 16, 17, 11, 14, 12, 24, 16, 49, 35,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  8
        },
    };

    //assumes 1 frame prep stage
    void animation_phase(void) {
        if(get_current_wpm() <=IDLE_SPEED){
            current_idle_frame = (current_idle_frame + 1) % IDLE_FRAMES;
            oled_write_raw_P(idle[abs((IDLE_FRAMES-1)-current_idle_frame)], ANIM_SIZE);
         }
         if(get_current_wpm() >IDLE_SPEED && get_current_wpm() <TAP_SPEED){
             // oled_write_raw_P(prep[abs((PREP_FRAMES-1)-current_prep_frame)], ANIM_SIZE); // uncomment if IDLE_FRAMES >1
             oled_write_raw_P(prep[0], ANIM_SIZE);  // remove if IDLE_FRAMES >1
         }
         if(get_current_wpm() >=TAP_SPEED){
             current_tap_frame = (current_tap_frame + 1) % TAP_FRAMES;
             oled_write_raw_P(tap[abs((TAP_FRAMES-1)-current_tap_frame)], ANIM_SIZE);
         }
    }
    if(get_current_wpm() != 000) {
        oled_on(); // not essential but turns on animation OLED with any alpha keypress
        if(timer_elapsed32(anim_timer) > ANIM_FRAME_DURATION) {
            anim_timer = timer_read32();
            animation_phase();
        }
        anim_sleep = timer_read32();
    } else {
        if(timer_elapsed32(anim_sleep) > OLED_TIMEOUT) {
            oled_off();
        } else {
            if(timer_elapsed32(anim_timer) > ANIM_FRAME_DURATION) {
                anim_timer = timer_read32();
                animation_phase();
            }
        }
    }
}


bool oled_task_user(void) {
    if (!is_keyboard_master()) {
        //render_skull();
        //oled_set_cursor(7,6);
        render_status();
     // Renders the current keyboard state (layer, lock, caps, scroll, etc)
    } else {
        render_anim();
        oled_set_cursor(0,6);
        uint8_t n = get_current_wpm();
        wpm_str[3] = '\0';
        wpm_str[2] = '0' + n % 10;
        wpm_str[1] = '0' + (n /= 10) % 10;
        wpm_str[0] = '0' + n / 10 ;
        oled_write_P(PSTR("       WPM: "), false);
        oled_write(wpm_str, false);

    }
    return false;
}
#endif
bool encoder_update_user(uint8_t index, bool clockwise) {
    if (index == 0) { /* First encoder */
        if (clockwise) {
            tap_code_delay(KC_VOLD, 10);
        } else {
            tap_code_delay(KC_VOLU, 10);
        }
    } else if (index == 1) { /* Second encoder */
        if (clockwise) {
            tap_code_delay(KC_DOWN, 10);
        } else {
            tap_code_delay(KC_UP, 10);
        }
    }
    return false;
}
