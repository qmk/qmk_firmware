/* Copyright 2020 MrT1ddl3s
 *
 * This program is free software: you can redistribute it and/or modify
 * it under the terms of the GNU General Public License as published by
 * the Free Software Foundation, either version 2 of the License, or
 * (at your option) any later version.
 *
 * This program is distributed in the hope that it will be useful,
 * but WITHOUT ANY WARRANTY; without even the implied warranty of
 * MERCHANTABILITY or FITNESS FOR A PARTICULAR PURPOSE.  See the
 * GNU General Public License for more details.
 *
 * You should have received a copy of the GNU General Public License
 * along with this program.  If not, see <http://www.gnu.org/licenses/>.
 */

#include QMK_KEYBOARD_H


const uint16_t PROGMEM keymaps[][MATRIX_ROWS][MATRIX_COLS] = {

    [0] = LAYOUT_ortho(
                  KC_EQL, KC_PSLS, KC_PAST, KC_PMNS,
                  KC_P7,  KC_P8,   KC_P9,   KC_PPLS,
                  KC_P4,  KC_P5,   KC_P6,   KC_PPLS,
         KC_MPLY, KC_P1,  KC_P2,   KC_P3,   KC_PENT,
         KC_MUTE, MO(1),  KC_P0,   KC_PDOT, KC_PENT
				 ),
				 
	[1] = LAYOUT_ortho(
                  KC_ESC,  KC_TRNS, KC_TRNS,  KC_TRNS,
                  KC_HOME, KC_TRNS, KC_PGUP,  KC_TRNS,
                  KC_END , KC_UP,   KC_PGDN,  KC_TRNS,
         KC_TRNS, KC_LEFT, KC_DOWN, KC_RIGHT, KC_SPC,
         KC_TRNS, KC_TRNS, KC_BSPC, KC_DEL,   KC_TRNS
				 )			 
};

/* assign keycodes to the encoder rotation */
void encoder_update_user(uint8_t index, bool clockwise) {

			if (index == 1) { /* Bottom encoder */
				if (clockwise) {
					tap_code(KC_VOLU);
				} else {
					tap_code(KC_VOLD);
				}
			}
			if (index == 0) { /* Top encoder */
				if (clockwise) {
					tap_code(KC_MNXT);
				} else {
					tap_code(KC_MPRV);
				}
			}
}
#ifdef OLED_DRIVER_ENABLE
/* rotate screen for proper orentation*/
oled_rotation_t oled_init_user(oled_rotation_t rotation) { return OLED_ROTATION_270; }

/* byte map for the goblin logo, knob goblin text, and level text */
static void render_logo(void) {
    static const char PROGMEM my_logo[] = {
		0x00, 0xe0, 0x40, 0x80, 0x80, 0x00, 0x00, 0x80, 0x80, 0xc0, 0x60, 0x20, 0x10, 0x08, 0x08, 0x08, 
		0x08, 0x08, 0x08, 0x10, 0x20, 0x60, 0xc0, 0x80, 0x80, 0x00, 0x00, 0x80, 0x80, 0x40, 0xe0, 0x00, 
		0x00, 0x03, 0x06, 0x3c, 0x49, 0x91, 0x21, 0x00, 0x40, 0x80, 0x80, 0x80, 0x80, 0x00, 0x60, 0x00, 
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		0x01, 0x00, 0x00, 0x03, 0x02, 0x02, 0x02, 0x00, 0x03, 0x02, 0x02, 0x02, 0x00, 0x00, 0x00, 0x00
		
    };
    oled_write_raw_P(my_logo, sizeof(my_logo));
}

/* text display for layer indication */
void oled_task_user(void) {
	
	render_logo();
	oled_set_cursor(0,11);
	oled_advance_char();
	switch (get_highest_layer(layer_state)) {
		case 0:
			oled_write_P(PSTR("ONE\n"), false);
			break;
		case 1:
			oled_write_P(PSTR("TWO\n"), false);
			break;
	}

}
#endif

