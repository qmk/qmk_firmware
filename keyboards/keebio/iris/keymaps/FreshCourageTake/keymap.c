#include QMK_KEYBOARD_H

#define _QWERTY 0
#define _ARROWS 1
#define _SYMBOLS 2
#define _NUMPAD 3
#define _FUNPAD 4


const uint16_t PROGMEM keymaps[][MATRIX_ROWS][MATRIX_COLS] = {

  [_QWERTY] = LAYOUT(
  //┌────────────────┬────────────────┬────────────────┬────────────────┬────────────────┬────────────────┐                          				 ┌────────────────┬────────────────┬────────────────┬────────────────┬────────────────┬────────────────┐
     KC_ESC,  			   KC_1,    	      KC_2,          KC_3,             KC_0,             KC_5,                               				      DM_REC1,            DM_RSTP,    	 DM_PLY1,         _______,          _______,          TG(_NUMPAD),
  //├────────────────┼────────────────┼────────────────┼────────────────┼────────────────┼────────────────┤                          				 ├────────────────┼────────────────┼────────────────┼────────────────┼────────────────┼────────────────┤
     _______,  			KC_Q,    		   KC_W,    		KC_E,    			KC_R,    		KC_T,                               						   KC_Y,    		   KC_U,    		KC_I,    			KC_O,    			KC_P, 			   KC_MINUS,
  //├────────────────┼────────────────┼────────────────┼────────────────┼────────────────┼────────────────┤											       ├────────────────┼────────────────┼────────────────┼────────────────┼────────────────┼────────────────┤
     OSM(MOD_LSFT), 	   KC_A,    		KC_S,    		   LT(_FUNPAD, KC_D),    	LT(_NUMPAD, KC_F),   KC_G,                               			KC_H,    		   KC_J,          KC_K, 				KC_L,  			   KC_SCLN,  	   OSM(MOD_RSFT),
  //├────────────────┼────────────────┼────────────────┼────────────────┼────────────────┼────────────────┼────────────────┐ 		┌────────────────┼────────────────┼────────────────┼────────────────┼────────────────┼────────────────┼────────────────┤
     KC_LALT, 			   KC_Z, 		   KC_X, 	         LGUI_T(KC_C), 	  	KC_V, 			KC_B, 		      KC_MPLY,   					_______,  	   KC_N, 			   KC_M, 			RGUI_T(KC_COMM),  KC_DOT,           KC_SLSH,          KC_BSLS,
  //└────────────────┴────────────────┴────────────────┴────────────────┴────────────────┴────────────────┴────────────────┘ 		└────────────────┴────────────────┴────────────────┴────────────────┴────────────────┴────────────────┴────────────────┘
                                    								   KC_DEL,     LCTL_T(KC_TAB),  LT(_ARROWS, KC_ENT),              LT(_SYMBOLS, KC_SPC), RCTL_T(KC_BSPC), LT(_FUNPAD, KC_QUOT)
                                									// 	└────────────────┴────────────────┴────────────────┘        └────────────────┴────────────────┴────────────────┘
  ),

  [_ARROWS] = LAYOUT(
  //┌────────────────┬────────────────┬────────────────┬────────────────┬────────────────┬────────────────┐                          				  ┌────────────────┬────────────────┬────────────────┬────────────────┬────────────────┬────────────────┐
     _______,  			_______,    	   _______,    		_______,    	_______,    		_______,                               					   _______,    	   _______,    	_______,    	   _______,    		_______,    		_______,
  //├────────────────┼────────────────┼────────────────┼────────────────┼────────────────┼────────────────┤                          				  ├────────────────┼────────────────┼────────────────┼────────────────┼────────────────┼────────────────┤
     _______,  			_______,    	_______,    _______,    	_______,    	_______,                               					               KC_LABK,    	   KC_HOME,       KC_UP,            KC_END,           KC_LCBR,          _______,
  //├────────────────┼────────────────┼────────────────┼────────────────┼────────────────┼────────────────┤											        ├────────────────┼────────────────┼────────────────┼────────────────┼────────────────┼────────────────┤
     _______, 			   KC_LCTL,    		KC_LSFT,    	KC_LALT,    	   KC_LGUI,    	   _______,                               						KC_RABK,    	KC_LEFT,          KC_DOWN,          KC_RIGHT,         KC_RCBR,       _______,
  //├────────────────┼────────────────┼────────────────┼────────────────┼────────────────┼────────────────┼────────────────┐ 		┌────────────────┼────────────────┼────────────────┼────────────────┼────────────────┼────────────────┼────────────────┤
     _______, 			   _______, 		   _______, 		_______, 	      _______, 		   _______, 		_______,   					_______,  		   _______,    	KC_LEFT_PAREN,    KC_RIGHT_PAREN,   KC_LBRACKET,      KC_RBRACKET,   _______,
  //└────────────────┴────────────────┴────────────────┴────────────────┴────────────────┴────────────────┴────────────────┘ 		└────────────────┴────────────────┴────────────────┴────────────────┴────────────────┴────────────────┴────────────────┘
                                    									 _______, 			_______,   		_______,                    _______,  			_______,   		_______
                                									// 	└────────────────┴────────────────┴────────────────┘        └────────────────┴────────────────┴────────────────┘
  ),

  [_SYMBOLS] = LAYOUT(
  //┌────────────────┬────────────────┬────────────────┬────────────────┬────────────────┬────────────────┐                          				  ┌────────────────┬────────────────┬────────────────┬────────────────┬────────────────┬────────────────┐
     _______,  			_______,    	_______,    		_______,    	_______,    	_______,                               						   _______,    	   _______,    		_______,    	_______,    	_______,    	_______,
  //├────────────────┼────────────────┼────────────────┼────────────────┼────────────────┼────────────────┤                          				  ├────────────────┼────────────────┼────────────────┼────────────────┼────────────────┼────────────────┤
     KC_TILDE,  			KC_GRAVE,    	KC_PERCENT,    		KC_PIPE,    	KC_AMPR,    	KC_EQUAL,                               					   _______,    		_______,    	_______,    	_______,    	_______,    	_______,
  //├────────────────┼────────────────┼────────────────┼────────────────┼────────────────┼────────────────┤											        ├────────────────┼────────────────┼────────────────┼────────────────┼────────────────┼────────────────┤
     KC_CAPSLOCK,  		KC_EXCLAIM,    		KC_AT,    		KC_HASH,    	KC_DOLLAR,    	KC_RABK,                               						_______,    	   _______,    	_______,    		_______,    	_______, 		_______,
  //├────────────────┼────────────────┼────────────────┼────────────────┼────────────────┼────────────────┼────────────────┐ 		┌────────────────┼────────────────┼────────────────┼────────────────┼────────────────┼────────────────┼────────────────┤
     _______, 			   KC_CIRC,    		KC_ASTR,       KC_UNDERSCORE,    KC_PLUS,    		KC_MINUS, 		_______,   					 _______,  		_______, 		   _______,    	   _______, 			_______, 		_______, 		_______,
  //└────────────────┴────────────────┴────────────────┴────────────────┴────────────────┴────────────────┴────────────────┘ 		└────────────────┴────────────────┴────────────────┴────────────────┴────────────────┴────────────────┴────────────────┘
                                    									 _______, 			_______,   		_______,                            _______,  			_______,   		_______
                                									// 	└────────────────┴────────────────┴────────────────┘        └────────────────┴────────────────┴────────────────┘
  ),


  [_NUMPAD] = LAYOUT(
  //┌────────────────┬────────────────┬────────────────┬────────────────┬────────────────┬────────────────┐                          				  ┌────────────────┬────────────────┬────────────────┬────────────────┬────────────────┬────────────────┐
     KC_ESC,  			   KC_1,    	      KC_2,          KC_3,             KC_4,             KC_5,                               						   _______,    	   _______,    	   _______,    		_______,    	_______,     TG(_NUMPAD),
  //├────────────────┼────────────────┼────────────────┼────────────────┼────────────────┼────────────────┤                          				  ├────────────────┼────────────────┼────────────────┼────────────────┼────────────────┼────────────────┤
     _______,  			KC_TAB,    		KC_Q,    		   KC_W,    		KC_E,    			KC_R,                               			            _______,    	   KC_7,    		   KC_8,    	      KC_9,    	   SGUI(KC_S), 		   _______,
  //├────────────────┼────────────────┼────────────────┼────────────────┼────────────────┼────────────────┤											        ├────────────────┼────────────────┼────────────────┼────────────────┼────────────────┼────────────────┤
     _______, 			   KC_LCTL,    		KC_A,    		   KC_S,    		KC_D,    	      KC_F,                               			            _______,    	   KC_4,    		   KC_5,    	      KC_6, 		   _______, 		   _______,
  //├────────────────┼────────────────┼────────────────┼────────────────┼────────────────┼────────────────┼────────────────┐ 		┌────────────────┼────────────────┼────────────────┼────────────────┼────────────────┼────────────────┼────────────────┤
     _______, 			   KC_Z,    		KC_X, 	         KC_C, 	  	   KC_V, 			   KC_B, 		   _______,   					_______,  		   _______, 	   KC_1,    		   KC_2, 		      KC_3,    _______, 		   _______,
  //└────────────────┴────────────────┴────────────────┴────────────────┴────────────────┴────────────────┴────────────────┘ 		└────────────────┴────────────────┴────────────────┴────────────────┴────────────────┴────────────────┴────────────────┘
                                    									 KC_ENT, 			KC_LCTL,   		KC_SPC,                               KC_MINUS,  		   KC_KP_0,   		_______
                                									// 	└────────────────┴────────────────┴────────────────┘                 └────────────────┴────────────────┴────────────────┘
  ),

  [_FUNPAD] = LAYOUT(
  //┌────────────────┬────────────────┬────────────────┬────────────────┬────────────────┬────────────────┐                          				  ┌────────────────┬────────────────┬────────────────┬────────────────┬────────────────┬────────────────┐
     RESET,  			   _______,    	_______,    	   _______,    		_______,    	_______,                               						_______,    	   _______,    	   _______,       _______,    	   _______,    		_______,
  //├────────────────┼────────────────┼────────────────┼────────────────┼────────────────┼────────────────┤                          				  ├────────────────┼────────────────┼────────────────┼────────────────┼────────────────┼────────────────┤
     _______,  			_______,    	_______,    	   KC_BRID,    		KC_BRIU,    	_______,                               						_______,    	   KC_F7,            KC_F8,         KC_F9,            KC_F10,           KC_F11,
  //├────────────────┼────────────────┼────────────────┼────────────────┼────────────────┼────────────────┤											        ├────────────────┼────────────────┼────────────────┼────────────────┼────────────────┼────────────────┤
     _______, 			   _______,    	KC_MPRV,          KC_MPLY,          KC_MNXT,    	_______,                               						_______,    	   KC_F4,            KC_F5,         KC_F6,    	      _______, 		_______,
  //├────────────────┼────────────────┼────────────────┼────────────────┼────────────────┼────────────────┼────────────────┐ 		┌────────────────┼────────────────┼────────────────┼────────────────┼────────────────┼────────────────┼────────────────┤
     _______, 			   _______,    	_______, 		   KC_VOLD, 	  		KC_VOLU, 		_______, 		_______,   					   _______,  		_______, 		   KC_F1,            KC_F2,         KC_F3,    	      _______, 		_______,
  //└────────────────┴────────────────┴────────────────┴────────────────┴────────────────┴────────────────┴────────────────┘ 		└────────────────┴────────────────┴────────────────┴────────────────┴────────────────┴────────────────┴────────────────┘
                                    									 _______, 			_______,   		_______,                               _______,  			_______,   		_______
                                									// 	└────────────────┴────────────────┴────────────────┘                 └────────────────┴────────────────┴────────────────┘
  )
};

bool process_record_user(uint16_t keycode, keyrecord_t *record) {
   // switch(keycode) {
   //    case SOME_MACRO:
   //       if (record->event.pressed) {
   //          // when keycode QMKBEST is pressed
   //          SEND_STRING("Macro time.");
   //       } else {
   //          // when keycode QMKBEST is released
   //       }

   //       break;
   // }

  return true;
}

void encoder_update_user(uint8_t index, bool clockwise) {
    if (index == 0) {
        if (clockwise) {
            tap_code(KC_VOLU);
        } else {
            tap_code(KC_VOLD);
        }
    }
    else if (index == 1) {
        if (clockwise) {
            tap_code(KC_PGDN);
        } else {
            tap_code(KC_PGUP);
        }
    }
}