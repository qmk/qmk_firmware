#include QMK_KEYBOARD_H

enum layer_names {
    _MAIN,
    _FUN,
    _NUM,
    _MEDIA,
    _NAV,
    _MOUSE
};

const uint16_t PROGMEM keymaps[][MATRIX_ROWS][MATRIX_COLS] = {

  [_MAIN] = LAYOUT(
  //┌────────┬────────┬────────┬────────┬────────┬────────┐                          ┌────────┬────────┬────────┬────────┬────────┬────────┐
     KC_SCRL, C(KC_B), C(KC_I), C(KC_U),C(KC_LBRC),C(KC_RBRC),                    C(A(KC_0)),C(A(KC_1)),C(A(KC_2)),C(A(KC_3)),C(A(KC_4)),KC_BSPC,
  //├────────┼────────┼────────┼────────┼────────┼────────┤                          ├────────┼────────┼────────┼────────┼────────┼────────┤
     KC_MINS,   KC_Q,   KC_W,    KC_F,    KC_P,    KC_B,                               KC_J,    KC_L,    KC_U,    KC_Y,    KC_QUOT, KC_EQL,
  //├────────┼────────┼────────┼────────┼────────┼────────┤                          ├────────┼────────┼────────┼────────┼────────┼────────┤
     
   KC_NUM,MT(MOD_LGUI,KC_A),MT(MOD_LALT,KC_R),MT(MOD_LCTL,KC_S),MT(MOD_LSFT,KC_T),KC_G,KC_M,MT(MOD_RSFT,KC_N),MT(MOD_RCTL,KC_E),MT(MOD_RALT,KC_I),MT(MOD_RGUI,KC_O),KC_SCLN,
  //├────────┼────────┼────────┼────────┼────────┼────────┼────────┐        ┌────────┼────────┼────────┼────────┼────────┼────────┼────────┤
     KC_LSPO,  KC_Z,    KC_X,     KC_C,    KC_D,    KC_V, C(A(KC_V)),       C(A(KC_C)), KC_K,    KC_H,   KC_COMM, KC_DOT, KC_SLSH,  KC_RCPC,
  //└────────┴────────┴────────┴───┬────┴───┬────┴───┬────┴───┬────┘        └───┬────┴───┬────┴───┬────┴───┬────┴────────┴────────┴────────┘
                          LT(_MEDIA,KC_MUTE),LT(_NUM,KC_BSPC),LT(_FUN,KC_DEL), MT(MOD_RCTL,KC_ESC),MT(MOD_RSFT,KC_SPC),LT(_NAV,KC_ENT)
                                // └────────┴────────┴────────┘                 └────────┴────────┴────────┘
  ),

  [_FUN] = LAYOUT(
  //┌────────┬────────┬────────┬────────┬────────┬────────┐                          ┌────────┬────────┬────────┬────────┬────────┬────────┐
     _______, _______,  _______, _______, _______, _______,                           _______, _______,  _______, _______, _______, _______,
  //├────────┼────────┼────────┼────────┼────────┼────────┤                          ├────────┼────────┼────────┼────────┼────────┼────────┤
     _______, _______,  _______, _______, _______, _______,                           _______,  KC_F1,   KC_F2,   KC_F3,   KC_F4,   _______,
  //├────────┼────────┼────────┼────────┼────────┼────────┤                          ├────────┼────────┼────────┼────────┼────────┼────────┤
     _______, KC_LGUI, KC_LALT, KC_LCTL,  KC_LSFT, _______,                           _______,  KC_F5  , KC_F6,   KC_F7,   KC_F8,   _______,
  //├────────┼────────┼────────┼────────┼────────┼────────┼────────┐        ┌────────┼────────┼────────┼────────┼────────┼────────┼────────┤
     _______, _______,  _______, _______, _______, _______,  _______,        KC_PSCR, _______,  KC_F9,   KC_F10,  KC_F11,  KC_F12,  _______,
  //└────────┴────────┴────────┴───┬────┴───┬────┴───┬────┴───┬────┘        └───┬────┴───┬────┴───┬────┴───┬────┴────────┴────────┴────────┘
                                    _______, _______, _______,                   _______, _______, _______ 
                                // └────────┴────────┴────────┘                 └────────┴────────┴────────┘
  ),

  [_NUM] = LAYOUT(
  //┌────────┬────────┬────────┬────────┬────────┬────────┐                          ┌────────┬────────┬────────┬────────┬────────┬────────┐
     _______, _______,  _______, _______, _______, KC_PSCR,                            KC_CALC, _______, _______, _______, _______, _______,
  //├────────┼────────┼────────┼────────┼────────┼────────┤                          ├────────┼────────┼────────┼────────┼────────┼────────┤
C(A(KC_4)),C(A(KC_3)),C(A(KC_2)),C(A(KC_1)),C(A(KC_0)), _______,                       KC_LBRC,  KC_7,    KC_8,    KC_9,  KC_MINS, _______,
  //├────────┼────────┼────────┼────────┼────────┼────────┤                          ├────────┼────────┼────────┼────────┼────────┼────────┤
     _______, KC_LGUI, KC_LALT, KC_LCTL, KC_LSFT, _______,                             KC_RBRC,  KC_4,    KC_5,    KC_6,  S(KC_8),  KC_EQL,
  //├────────┼────────┼────────┼────────┼────────┼────────┼────────┐        ┌────────┼────────┼────────┼────────┼────────┼────────┼────────┤
     _______, _______,  _______, _______, _______, _______, _______,          KC_CALC, KC_PPLS,  KC_1,    KC_2,    KC_3,  KC_SLSH,  KC_EQL,
  //└────────┴────────┴────────┴───┬────┴───┬────┴───┬────┴───┬────┘        └───┬────┴───┬────┴───┬────┴───┬────┴────────┴────────┴────────┘
                                    _______, _______, _______,                  S(KC_EQL),  KC_0,   KC_DOT
                                // └────────┴────────┴────────┘                 └────────┴────────┴────────┘
  ), 

  [_MEDIA] = LAYOUT(
  //┌────────┬────────┬────────┬────────┬────────┬────────┐                          ┌────────┬────────┬────────┬────────┬────────┬────────┐
     QK_BOOT , _______, _______, _______, _______, _______,                            _______, _______, _______, _______, _______, _______,
  //├────────┼────────┼────────┼────────┼────────┼────────┤                          ├────────┼────────┼────────┼────────┼────────┼────────┤
     _______, _______, _______, _______, _______, _______,                             RGB_TOG, _______, _______, _______, _______, _______,
  //├────────┼────────┼────────┼────────┼────────┼────────┤                          ├────────┼────────┼────────┼────────┼────────┼────────┤
     _______, KC_LGUI, KC_LALT, KC_LCTL, KC_LSFT, _______,                            RGB_MOD,  RGB_HUI, RGB_SAI, RGB_VAI, RGB_SPI, _______,
  //├────────┼────────┼────────┼────────┼────────┼────────┼────────┐        ┌────────┼────────┼────────┼────────┼────────┼────────┼──────
     _______, _______, _______, _______, _______, _______, _______,          KC_MUTE, RGB_RMOD, RGB_HUD, RGB_SAD, RGB_VAD, RGB_SPD, _______,
  //└────────┴────────┴────────┴───┬────┴───┬────┴───┬────┴───┬────┘        └───┬────┴───┬────┴───┬────┴───┬────┴────────┴────────┴────────┘
                                    _______, _______, _______,                   KC_MPRV, KC_MPLY, KC_MNXT
                                // └────────┴────────┴────────┘                 └────────┴────────┴────────┘
  ),

    [_NAV] = LAYOUT(
  //┌────────┬────────┬────────┬────────┬────────┬────────┐                          ┌────────┬────────┬────────┬────────┬────────┬────────┐
     _______, _______,  _______, _______, _______, _______,                           _______, _______,  _______, _______, _______, _______,
  //├────────┼────────┼────────┼────────┼────────┼────────┤                          ├────────┼────────┼────────┼────────┼────────┼────────┤
     _______, KC_PGUP,  KC_HOME,  KC_UP,  KC_END, KC_INS,                            _______, _______, _______, _______, _______, _______,
  //├────────┼────────┼────────┼────────┼────────┼────────┤                          ├────────┼────────┼────────┼────────┼────────┼────────┤
     _______, KC_PGDN, KC_LEFT, KC_DOWN, KC_RGHT,  KC_CAPS,                            _______, KC_RSFT, KC_RCTL, KC_RALT, KC_RGUI, _______,
  //├────────┼────────┼────────┼────────┼────────┼────────┼────────┐        ┌────────┼────────┼────────┼────────┼────────┼────────┼────────┤
     _______, _______,  KC_PGUP, KC_PGDN, _______, _______, KC_HOME,          _______, _______, _______, _______, _______, _______, _______,
  //└────────┴────────┴────────┴───┬────┴───┬────┴───┬────┴───┬────┘        └───┬────┴───┬────┴───┬────┴───┬────┴────────┴────────┴────────┘
                                    _______, _______, _______,                   _______, _______, _______ 
                                // └────────┴────────┴────────┘                 └────────┴────────┴────────┘
  ),

  [_MOUSE] = LAYOUT(
  //┌────────┬────────┬────────┬────────┬────────┬────────┐                          ┌────────┬────────┬────────┬────────┬────────┬────────┐
     _______, _______,  _______, _______, _______, _______,                           _______, _______,  _______, _______, _______, _______,
  //├────────┼────────┼────────┼────────┼────────┼────────┤                          ├────────┼────────┼────────┼────────┼────────┼────────┤
     _______, _______,  _______, KC_MS_U, _______, _______,                           _______, _______,  _______, _______, _______, _______,
  //├────────┼────────┼────────┼────────┼────────┼────────┤                          ├────────┼────────┼────────┼────────┼────────┼────────┤
     _______,  KC_MS_L, KC_MS_L, KC_MS_D, KC_MS_R, _______,                            _______, KC_RSFT, KC_RCTL, KC_RALT, KC_RGUI, _______,
  //├────────┼────────┼────────┼────────┼────────┼────────┼────────┐        ┌────────┼────────┼────────┼────────┼────────┼────────┼────────┤
_______,KC_MS_WH_LEFT,KC_MS_WH_UP,KC_MS_WH_DOWN,KC_MS_WH_RIGHT,_______,_______,_______, _______, _______,  _______, _______, _______, _______,
  //└────────┴────────┴────────┴───┬────┴───┬────┴───┬────┴───┬────┘        └───┬────┴───┬────┴───┬────┴───┬────┴────────┴────────┴────────┘
                                KC_MS_BTN2,KC_MS_BTN1,KC_MS_BTN3,                _______, _______, _______ 
                                // └────────┴────────┴────────┘                 └────────┴────────┴────────┘
  )

};

//encoders
bool encoder_update_user(uint8_t index, bool clockwise) {
    uint8_t layer = get_highest_layer(layer_state | default_layer_state);

    switch (index) {
        case 0:
            // Left encoder
            if (layer == _NAV) {
                tap_code(clockwise ? KC_PGDN: KC_PGUP);
            } else if (layer == _MOUSE) {
                tap_code(clockwise ? KC_MS_WH_DOWN: KC_MS_WH_UP);
            } else {
                tap_code(clockwise ? KC_DOWN : KC_UP);
            }
            break;

        case 1:
            // Right encoder
          
            if (layer == _MEDIA) {
                tap_code_delay(clockwise ? KC_VOLU: KC_VOLD, 10);
            }
            else if (layer == _FUN) {
                tap_code16(clockwise ? LCTL(KC_TAB): LCTL(LSFT(KC_TAB)));
            } else {
                tap_code(clockwise ? KC_RIGHT : KC_LEFT);
            }
            break;
    }
    return false;
}

//nano to iris communcation
bool led_update_user(led_t state) {
    if (state.scroll_lock != layer_state_is(_MOUSE)) {
        layer_invert(_MOUSE);
    }
    return true;
}

//layer lighting
/*
void rgb_matrix_indicators_advanced_user(uint8_t led_min, uint8_t led_max) {

    //uint8_t hue = rgblight_get_hue();
    uint8_t sat = rgblight_get_sat();
    uint8_t val = rgblight_get_val();
    //for (uint8_t i = led_min; i <= led_max; i++) {
        switch(get_highest_layer(layer_state|default_layer_state)) {
            case _FUN:
                //rgb_matrix_set_color_all(RGB_BLUE);
                //rgb_matrix_set_color(i, RGB_BLUE);
                rgblight_sethsv(169, sat, val);
                break;
            case _NAV:
                //rgb_matrix_set_color(i, RGB_YELLOW);
                rgblight_sethsv(43, sat, val);
                break;
            case _NUM:
                //rgb_matrix_set_color(i, RGB_GREEN);
                rgblight_sethsv(85, sat, val);
                break;
            case _MEDIA:
                //rgb_matrix_set_color(i, RGB_RED);
                rgblight_sethsv(0, sat, val);
                break;
            case _MOUSE:
                //rgb_matrix_set_color(i, RGB_PURPLE);
                rgblight_sethsv(180, sat, val);
                break;                            
            default:
                //rgb_matrix_set_color(i, RGB_WHITE);
                //rgblight_sethsv(0, sat, val);
                break;
        }
    }
*/
