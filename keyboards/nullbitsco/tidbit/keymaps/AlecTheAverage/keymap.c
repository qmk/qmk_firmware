/* Copyright 2020 Jay Greco
 *
 * This program is free software: you can redistribute it and/or modify
 * it under the terms of the GNU General Public License as published by
 * the Free Software Foundation, either version 2 of the License, or
 * (at your option) any later version.
 *
 * This program is distributed in the hope that it will be useful,
 * but WITHOUT ANY WARRANTY; without even the implied warranty of
 * MERCHANTABILITY or FITNESS FOR A PARTICULAR PURPOSE.  See the
 * GNU General Public License for more details.
 *
 * You should have received a copy of the GNU General Public License
 * along with this program.  If not, see <http://www.gnu.org/licenses/>.
 */
#include QMK_KEYBOARD_H

#define _MA 0
#define _FN 1
int COUNTER = 1;
char COUNTER_STR[10];
enum custom_keycodes {
    KC_CUST = SAFE_RANGE,
};
void keyboard_post_init_user(void) {
  // Customise these values to desired behaviour
  debug_enable=false;
  debug_matrix=false;
  //debug_keyboard=true;
  //debug_mouse=true;
}



const uint16_t PROGMEM keymaps[][MATRIX_ROWS][MATRIX_COLS] = {
    [_MA] = LAYOUT(
           KC_F16,   KC_MENU,         KC_GESC, \
  KC_KP_7, KC_KP_8,  KC_KP_9,        KC_RSFT, \
  KC_KP_4, KC_KP_5,  KC_KP_6,        KC_UP, \
  KC_KP_1, KC_KP_2,  KC_KP_3,        KC_DOWN, \
  KC_RCTRL,   KC_KP_0,  KC_RALT,      KC_F19 \

    ),
    [_FN] = LAYOUT(
           KC_NO, RGB_TOG, KC_NO,
    KC_NO, KC_NO, RGB_MOD, KC_NO,
    KC_NO, KC_NO, RGB_HUI, KC_NO,
    KC_NO, KC_NO, RGB_SAI, KC_NO,
    KC_NO,  KC_NO, RGB_VAI, TO(_MA)

    ),
};

//This method sourced from ollien#9348
void change_RGB(bool clockwise) {
    bool shift = get_mods() & MOD_MASK_SHIFT;
    bool alt = get_mods() & MOD_MASK_ALT;
    bool ctrl = get_mods() & MOD_MASK_CTRL;

    if (clockwise) {
        if (alt) {
            rgblight_increase_hue();
        } else if (ctrl) {
            rgblight_increase_val();
        } else if (shift) {
            rgblight_increase_sat();
        } else {
            rgblight_step();
        }

  } else {
      if (alt) {
            rgblight_decrease_hue();
        } else if (ctrl) {
            rgblight_decrease_val();
        } else if (shift) {
            rgblight_decrease_sat();
        } else {
            rgblight_step_reverse();
        }
    }
}

void change_tab(bool clockwise) {
     if (clockwise){
        // on keydown
            register_code(KC_LALT);
            register_code(KC_LGUI);
            register_code(KC_LEFT);
        // on keyup
            unregister_code(KC_LALT);
            unregister_code(KC_LGUI);
            unregister_code(KC_LEFT);
    } else {
        // on keydown
            register_code(KC_LALT);
            register_code(KC_LGUI);
            register_code(KC_RIGHT);
        // on keyup
            unregister_code(KC_LALT);
            unregister_code(KC_LGUI);
            unregister_code(KC_RIGHT);
            }
}

bool encoder_update_kb(uint8_t index, bool clockwise) {

    switch(COUNTER){
        case 1:
        if (clockwise) {
            tap_code(KC_VOLD);
        } else {
            tap_code(KC_VOLU);
        }
        break;
        //return false;

        case 2:
        if (clockwise) {
            tap_code(KC_MPRV);
        } else {
            tap_code(KC_MNXT);
        }
        break;
        //return false;

        case 3:

            change_RGB(clockwise);

        break;
        //return false;

        case 4:
        if (clockwise) {
            tap_code(KC_BRID);
        } else{
            tap_code(KC_BRIU);
        }
        break;
        //return false;

        case 5:

            change_tab(clockwise);

        break;
        //return false;
    }

    return false;
}
#ifdef OLED_DRIVER_ENABLE
 oled_rotation_t oled_init_user(oled_rotation_t rotation) { return OLED_ROTATION_0; }

    static const char PROGMEM volume_icon[] = {
    // 'Volume', 128x32px
	0x00, 0x00, 0x00, 0x00, 0x00, 0x00, 0x00, 0x00, 0x00, 0x00, 0x80, 0xc0, 0xe0, 0x00, 0x00, 0x00,
	0x00, 0x00, 0x00, 0x20, 0x70, 0xc0, 0x80, 0x02, 0x0e, 0x3c, 0xf0, 0xc0, 0x00, 0x00, 0x00, 0x00,
	0x00, 0x00, 0x00, 0x00, 0x00, 0x00, 0x00, 0x00, 0x00, 0x00, 0x00, 0x00, 0x00, 0x00, 0x00, 0x00,
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	0x00, 0x00, 0x00, 0x00, 0x00, 0x00, 0x00, 0x00, 0x00, 0x00, 0x00, 0x00, 0x00, 0x00, 0x00, 0x00
    };

    static const char PROGMEM LED_icon[] = {
    //  'LED Icon - RGB Control' , 128x32px
	0x00, 0x00, 0x00, 0x00, 0x00, 0x00, 0x20, 0x40, 0x80, 0x00, 0x00, 0x00, 0x00, 0x00, 0x80, 0x80,
	0xce, 0xce, 0x80, 0x80, 0x00, 0x00, 0x00, 0x00, 0x00, 0x80, 0x40, 0x20, 0x00, 0x00, 0x00, 0x00,
	0x00, 0x00, 0x00, 0x00, 0x00, 0x00, 0x00, 0x00, 0x00, 0x00, 0x00, 0x00, 0x00, 0x00, 0x00, 0x00,
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	0x00, 0x00, 0x00, 0x00, 0x00, 0x00, 0x00, 0x00, 0x00, 0x00, 0x00, 0x00, 0x00, 0x00, 0x00, 0x00
    };

    static const char PROGMEM music_note[] = {
    // 'Music-note' - Music Control, 128x32px
    0x00, 0x00, 0x00, 0x00, 0x00, 0x00, 0x00, 0x00, 0x00, 0x00, 0x00, 0x00, 0xc0, 0xc0, 0xc0, 0xc0,
	0xe0, 0xe0, 0xe0, 0xf0, 0xf0, 0xf0, 0x70, 0x78, 0x78, 0x78, 0x38, 0x3c, 0x3c, 0x3e, 0xfe, 0xfe,
	0x00, 0x00, 0x00, 0x00, 0x00, 0x00, 0x00, 0x00, 0x00, 0x00, 0x00, 0x00, 0x00, 0x00, 0x00, 0x00,
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	0x00, 0x00, 0x00, 0x00, 0x00, 0x00, 0x00, 0x00, 0x00, 0x00, 0x00, 0x00, 0x00, 0x00, 0x00, 0x00

    };
    static const char PROGMEM light_icon[] = {
        //"Sun Icon" - Light Control , 128x32
    0x00, 0x00, 0x00, 0x00, 0x00, 0x00, 0x60, 0xe0, 0xc0, 0x80, 0x00, 0x00, 0x00, 0x00, 0x00, 0x00,
	0xfe, 0xfe, 0x00, 0x00, 0x00, 0x00, 0x00, 0x00, 0x80, 0xc0, 0xe0, 0x60, 0x00, 0x00, 0x00, 0x00,
	0x00, 0x00, 0x00, 0x00, 0x00, 0x00, 0x00, 0x00, 0x00, 0x00, 0x00, 0x00, 0x00, 0x00, 0x00, 0x00,
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	0x00, 0x00, 0x00, 0x00, 0x00, 0x00, 0x00, 0x00, 0x00, 0x00, 0x00, 0x00, 0x00, 0x00, 0x00, 0x00
        };
    static const char PROGMEM tab_icon[] = {
    //"Tab Icon", Tab Control 128x32
    0x00, 0x00, 0xf0, 0xf8, 0x38, 0x98, 0xd8, 0xc8, 0xc8, 0x48, 0x48, 0x48, 0x48, 0x48, 0x48, 0x48,
	0x48, 0x48, 0x48, 0x48, 0x48, 0x48, 0x48, 0x48, 0x40, 0x40, 0x40, 0x00, 0x00, 0x00, 0x00, 0x00,
	0x00, 0x00, 0x00, 0x00, 0x00, 0x00, 0x00, 0x00, 0x00, 0x00, 0x00, 0x00, 0x00, 0x00, 0x00, 0x00,
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	0x00, 0x00, 0x00, 0x00, 0x00, 0x00, 0x00, 0x00, 0x00, 0x00, 0x00, 0x00, 0x00, 0x00, 0x00, 0x00
    };

  void oled_task_user(void) {
 }

bool process_record_user(uint16_t keycode, keyrecord_t *record) {
    // Send keystrokes to host keyboard, if connected (see readme)
     if (keycode == KC_F16 && record->event.pressed) {
                    if(COUNTER > 4){
                        COUNTER = 1;
                     }
                    else{
                        COUNTER = COUNTER+1;
                    }
     }
        switch(COUNTER){
            case 1:
            oled_write_raw_P(volume_icon,sizeof(volume_icon));
            break;

            case 2:
            oled_write_raw_P(music_note,sizeof(music_note));
            break;

            case 3:
            oled_write_raw_P(LED_icon,sizeof(LED_icon));
            break;

            case 4:
            oled_write_raw_P(light_icon,sizeof(light_icon));
            break;

            case 5:
            oled_write_raw_P(tab_icon,sizeof(tab_icon));
            break;
        }

     if (keycode == KC_F15 && record->event.pressed  && COUNTER == 2) {
            tap_code(KC_MPLY);
            }

       return false;
    }

#endif



