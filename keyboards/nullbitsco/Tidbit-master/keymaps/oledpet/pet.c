/* Copyright 2021 Chris Tanaka <https://github.com/christanaka>
 *
 * This program is free software: you can redistribute it and/or modify
 * it under the terms of the GNU General Public License as published by
 * the Free Software Foundation, either version 2 of the License, or
 * (at your option) any later version.
 *
 * This program is distributed in the hope that it will be useful,
 * but WITHOUT ANY WARRANTY; without even the implied warranty of
 * MERCHANTABILITY or FITNESS FOR A PARTICULAR PURPOSE.  See the
 * GNU General Public License for more details.
 *
 * You should have received a copy of the GNU General Public License
 * along with this program.  If not, see <http://www.gnu.org/licenses/>.
 */

#include "pet.h"
#include QMK_KEYBOARD_H

#define _MIN_WALK_SPEED      10
#define _MIN_RUN_SPEED       40
#define _ANIM_FRAMES         2
#define _ANIM_FRAME_DURATION 200
#define _ANIM_BYTES          96   // Number of bytes in array (max is 1024)

static uint32_t anim_timer = 0;
static uint32_t anim_sleep = 0;

static uint8_t frame = 0;

static int wpm = 0;
static led_t led_usb_state;

bool is_sneak = false;
bool is_jump = false;
bool is_jump_shown = true;

static const char PROGMEM sit[_ANIM_FRAMES][_ANIM_BYTES] = {
  /* 'sit1', 32x22px */
  { 0x00, 0x00, 0x00, 0x00, 0x00, 0x00, 0x00, 0x00, 0x00, 0x00, 0x00, 0x00, 0x00,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 0x00, },
  /* 'sit2', 32x22px */
  { 0x00, 0x00, 0x00, 0x00, 0x00, 0x00, 0x00, 0x00, 0x00, 0x00, 0x00, 0x00, 0x00,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 0x00, }
};

static const char PROGMEM walk[_ANIM_FRAMES][_ANIM_BYTES] = {
  /* 'walk1', 32x22px */
  { 0x00, 0x00, 0x00, 0x00, 0x00, 0x80, 0x40, 0x20, 0x10, 0x90, 0x90, 0x90, 0xa0,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 0x00, },
  /* 'walk2', 32x22px */
  { 0x00, 0x00, 0x00, 0x00, 0x00, 0x00, 0x80, 0x40, 0x20, 0x20, 0x20, 0x40, 0x80,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 0x00, }
};

static const char PROGMEM run[_ANIM_FRAMES][_ANIM_BYTES] = {
  /* 'run1', 32x22px */
  { 0x00, 0x00, 0x00, 0x00, 0xe0, 0x10, 0x08, 0x08, 0xc8, 0xb0, 0x80, 0x80, 0x80,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 0x00, },
  /* 'run2', 32x22px */
  { 0x00, 0x00, 0x00, 0xe0, 0x10, 0x10, 0xf0, 0x00, 0x00, 0x00, 0x00, 0x00, 0x00,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 0x00, }
};

static const char PROGMEM bark[_ANIM_FRAMES][_ANIM_BYTES] = {
  /* 'bark1', 32x22px */
  { 0x00, 0xc0, 0x20, 0x10, 0xd0, 0x30, 0x00, 0x00, 0x00, 0x00, 0x00, 0x00, 0x00,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 0x00, },
  /* 'bark2', 32x22px */
  { 0x00, 0xe0, 0x10, 0x10, 0xf0, 0x00, 0x00, 0x00, 0x00, 0x00, 0x00, 0x00, 0x00,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 0x00, }
};

static const char PROGMEM sneak[_ANIM_FRAMES][_ANIM_BYTES] = {
  /* 'sneak1', 32x22px */
  { 0x00, 0x00, 0x00, 0x00, 0x00, 0x00, 0x80, 0x40, 0x40, 0x40, 0x40, 0x80, 0x00,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 0x00, },
  /* 'sneak2', 32x22px */
  { 0x00, 0x00, 0x00, 0x00, 0x00, 0x00, 0x80, 0x40, 0x40, 0x40, 0x80, 0x00, 0x00,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 0x00, }
};

static void animate(uint8_t x, uint8_t y) {
  // Jump
  if (is_jump || !is_jump_shown) {
    oled_set_cursor(x, y + 2);
    oled_write("     ", false);

    oled_set_cursor(x, y - 1);

    is_jump_shown = true;
  } else {
    oled_set_cursor(x, y - 1);
    oled_write("     ", false);

    oled_set_cursor(x, y);
  }

  // Update frame
  frame = (frame + 1) % _ANIM_FRAMES;

  // Draw frame
  if (led_usb_state.caps_lock) {
    oled_write_raw_P(bark[abs(1 - frame)], _ANIM_BYTES);
  } else if (is_sneak) {
    oled_write_raw_P(sneak[abs(1 - frame)], _ANIM_BYTES);
  } else if (wpm <= _MIN_WALK_SPEED) {
    oled_write_raw_P(sit[abs(1 - frame)], _ANIM_BYTES);
  } else if (wpm <= _MIN_RUN_SPEED) {
    oled_write_raw_P(walk[abs(1 - frame)], _ANIM_BYTES);
  } else {
    oled_write_raw_P(run[abs(1 - frame)], _ANIM_BYTES);
  }
}

void pet_render(uint8_t x, uint8_t y) {
  wpm   = get_current_wpm();
  led_usb_state = host_keyboard_led_state();

  if (timer_elapsed32(anim_timer) > _ANIM_FRAME_DURATION) {
    anim_timer = timer_read32();
    animate(x, y);
  }

  // This fixes the screen on and off bug?
  if (wpm > 0) {
    oled_on();
    anim_sleep = timer_read32();
  } else if (timer_elapsed32(anim_sleep) > OLED_TIMEOUT) {
    oled_off();
  }
}

void pet_process_record(uint16_t keycode, keyrecord_t *record) {
  switch (keycode) {
    case KC_LCTL:
    case KC_RCTL:
      if (record->event.pressed) {
        is_sneak = true;
      } else {
        is_sneak = false;
      }
      break;
    case KC_SPC:
      if (record->event.pressed) {
        is_jump  = true;
        is_jump_shown = false;
      } else {
        is_jump = false;
      }
      break;
  }
}
