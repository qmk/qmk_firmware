# copy to ../../../alt/rgb_matrix_kb.inc


// !!! DO NOT ADD #pragma once !!! //

// Step 1.
// Declare custom effects using the RGB_MATRIX_EFFECT macro
// (note the lack of semicolon after the macro!)
RGB_MATRIX_EFFECT(RGB_CUSTOM_ZONFIRE)
RGB_MATRIX_EFFECT(RGB_CUSTOM_ZONFIRE_2)
RGB_MATRIX_EFFECT(RGB_CUSTOM_ZONFIRE_WHITE)
//RGB_MATRIX_EFFECT(my_cool_effect2)

 
// qmk_firmware # util/docker_build.sh massdrop/alt:default
  

// Step 2.
// Define effects inside the `RGB_MATRIX_CUSTOM_EFFECT_IMPLS` ifdef block



#ifdef RGB_MATRIX_CUSTOM_EFFECT_IMPLS

// e.g: A simple effect, self-contained within a single method
static bool RGB_CUSTOM_ZONFIRE(effect_params_t* params) {
  RGB_MATRIX_USE_LIMITS(led_min, led_max);
  for (uint8_t i = led_min; i < led_max; i++) {
    

        rgb_matrix_set_color(0, 0xFF, 0x00, 0xFF); //row 1 
		rgb_matrix_set_color(1, 0xFF, 0x00, 0xFF);
		rgb_matrix_set_color(2, 0xFF, 0x00, 0xFF);
		rgb_matrix_set_color(3, 0xFF, 0x00, 0xFF);
		rgb_matrix_set_color(4, 0xFF, 0x00, 0xFF);

		rgb_matrix_set_color(5, 0xFF, 0x00, 0xFF);
		rgb_matrix_set_color(6, 0xFF, 0x00, 0xFF);
		rgb_matrix_set_color(7, 0xFF, 0x00, 0xFF);
		rgb_matrix_set_color(8, 0xFF, 0x00, 0xFF);
		
		rgb_matrix_set_color(9, 0xFF, 0x00, 0xFF);
		rgb_matrix_set_color(10, 0xFF, 0x00, 0xFF);
		rgb_matrix_set_color(11, 0xFF, 0x00, 0xFF);
		rgb_matrix_set_color(12, 0xFF, 0x00, 0xFF);
		rgb_matrix_set_color(13, 0xFF, 0x00, 0xFF);
		rgb_matrix_set_color(14, 0xFF, 0x00, 0xFF);


		rgb_matrix_set_color(15, 0xFF, 0x00, 0xFF); //row 2
		rgb_matrix_set_color(16, 0x00, 0xFF, 0xFF); 
		rgb_matrix_set_color(17, 0x00, 0xFF, 0xFF);
		rgb_matrix_set_color(18, 0x00, 0xFF, 0xFF);
		rgb_matrix_set_color(19, 0x00, 0xFF, 0xFF);
		rgb_matrix_set_color(20, 0x00, 0xFF, 0xFF);
		rgb_matrix_set_color(21, 0x00, 0xFF, 0xFF);
		rgb_matrix_set_color(22, 0x00, 0xFF, 0xFF);
		rgb_matrix_set_color(23, 0x00, 0xFF, 0xFF);
		rgb_matrix_set_color(24, 0x00, 0xFF, 0xFF);
		rgb_matrix_set_color(25, 0x00, 0xFF, 0xFF);
		rgb_matrix_set_color(26, 0x00, 0xFF, 0xFF);
		rgb_matrix_set_color(27, 0x00, 0xFF, 0xFF);
		rgb_matrix_set_color(28, 0xFF, 0x00, 0xFF);
		rgb_matrix_set_color(29, 0xFF, 0x00, 0xFF);
		
		rgb_matrix_set_color(30, 0xFF, 0x00, 0xFF);//row 3
		rgb_matrix_set_color(31, 0x00, 0xFF, 0xFF);
		rgb_matrix_set_color(32, 0x00, 0xFF, 0xFF);
		rgb_matrix_set_color(33, 0x00, 0xFF, 0xFF);
		rgb_matrix_set_color(34, 0x00, 0xFF, 0xFF);
		rgb_matrix_set_color(35, 0x00, 0xFF, 0xFF);
		rgb_matrix_set_color(36, 0x00, 0xFF, 0xFF);
		rgb_matrix_set_color(37, 0x00, 0xFF, 0xFF);
		rgb_matrix_set_color(38, 0x00, 0xFF, 0xFF);
		rgb_matrix_set_color(39, 0x00, 0xFF, 0xFF);
		rgb_matrix_set_color(40, 0x00, 0xFF, 0xFF);
		rgb_matrix_set_color(41, 0x00, 0xFF, 0xFF);
		rgb_matrix_set_color(42, 0xFF, 0x00, 0xFF);
		rgb_matrix_set_color(43, 0xFF, 0x00, 0xFF);

		rgb_matrix_set_color(44, 0xFF, 0x00, 0xFF);//row 4
		rgb_matrix_set_color(45, 0x00, 0xFF, 0xFF);
		rgb_matrix_set_color(46, 0x00, 0xFF, 0xFF);
		rgb_matrix_set_color(47, 0x00, 0xFF, 0xFF);
		rgb_matrix_set_color(48, 0x00, 0xFF, 0xFF);
		rgb_matrix_set_color(49, 0x00, 0xFF, 0xFF);
		rgb_matrix_set_color(50, 0x00, 0xFF, 0xFF);
		rgb_matrix_set_color(51, 0x00, 0xFF, 0xFF);
		rgb_matrix_set_color(52, 0x00, 0xFF, 0xFF);
		rgb_matrix_set_color(53, 0x00, 0xFF, 0xFF);
		rgb_matrix_set_color(54, 0x00, 0xFF, 0xFF);
		rgb_matrix_set_color(55, 0xFF, 0x00, 0xFF);
		//rgb_matrix_set_color(56, 0x00, 0xFF, 0x00);
		rgb_matrix_set_color(57, 0xFF, 0x00, 0xFF);

		rgb_matrix_set_color(58, 0xFF, 0x00, 0xFF);//row 5
		rgb_matrix_set_color(59, 0xFF, 0x00, 0xFF);
		rgb_matrix_set_color(60, 0xFF, 0x00, 0xFF);
		rgb_matrix_set_color(61, 0xFF, 0x00, 0xFF);
		rgb_matrix_set_color(62, 0xFF, 0x00, 0xFF);
		rgb_matrix_set_color(63, 0xFF, 0x00, 0xFF);
		
		//arrow keys
		rgb_matrix_set_color(56, 0xFF, 0x00, 0xFF);
		rgb_matrix_set_color(64, 0xFF, 0x00, 0xFF);
		rgb_matrix_set_color(65, 0xFF, 0x00, 0xFF);
		rgb_matrix_set_color(66, 0xFF, 0x00, 0xFF);
		//arrow keys
		
		//edge corners
		rgb_matrix_set_color(100, 0x00, 0xFF, 0x00);
		rgb_matrix_set_color(86, 0x00, 0xFF, 0x00);
		rgb_matrix_set_color(67, 0x00, 0xFF, 0x00);
		rgb_matrix_set_color(81, 0x00, 0xFF, 0x00);
		//edge corners
		

		
		//front edge
		rgb_matrix_set_color(68, 0x00, 0xFF, 0x00);
		rgb_matrix_set_color(69, 0x00, 0xFF, 0x00);
		rgb_matrix_set_color(70, 0x00, 0xFF, 0x00);
		rgb_matrix_set_color(71, 0x00, 0xFF, 0x00);
		rgb_matrix_set_color(72, 0x00, 0xFF, 0x00);
		rgb_matrix_set_color(73, 0x00, 0xFF, 0x00);
		rgb_matrix_set_color(74, 0x00, 0xFF, 0x00);
		rgb_matrix_set_color(75, 0x00, 0xFF, 0x00);
		rgb_matrix_set_color(76, 0x00, 0xFF, 0x00);
		rgb_matrix_set_color(77, 0x00, 0xFF, 0x00);
		rgb_matrix_set_color(78, 0x00, 0xFF, 0x00);
		rgb_matrix_set_color(79, 0x00, 0xFF, 0x00);
		rgb_matrix_set_color(80, 0x00, 0xFF, 0x00);
		//front edge
		
		//left edge
		rgb_matrix_set_color(101, 0x00, 0xFF, 0x00);
		rgb_matrix_set_color(102, 0x00, 0xFF, 0x00);
		rgb_matrix_set_color(103, 0x00, 0xFF, 0x00);
		rgb_matrix_set_color(104, 0x00, 0xFF, 0x00);
		//left edge
		
		//right edge
		rgb_matrix_set_color(85, 0x00, 0xFF, 0x00);
		rgb_matrix_set_color(84, 0x00, 0xFF, 0x00);
		rgb_matrix_set_color(83, 0x00, 0xFF, 0x00);
		rgb_matrix_set_color(82, 0x00, 0xFF, 0x00);
		//right edge
		
		//back edge
		rgb_matrix_set_color(87, 0x00, 0xFF, 0x00);
		rgb_matrix_set_color(88, 0x00, 0xFF, 0x00);
		rgb_matrix_set_color(89, 0x00, 0xFF, 0x00);
		rgb_matrix_set_color(90, 0x00, 0xFF, 0x00);
		rgb_matrix_set_color(91, 0x00, 0xFF, 0x00);
		rgb_matrix_set_color(92, 0x00, 0xFF, 0x00);
		rgb_matrix_set_color(93, 0x00, 0xFF, 0x00);
		rgb_matrix_set_color(94, 0x00, 0xFF, 0x00);
		rgb_matrix_set_color(95, 0x00, 0xFF, 0x00);
		rgb_matrix_set_color(96, 0x00, 0xFF, 0x00);
		rgb_matrix_set_color(97, 0x00, 0xFF, 0x00);
		rgb_matrix_set_color(98, 0x00, 0xFF, 0x00);
		rgb_matrix_set_color(99, 0x00, 0xFF, 0x00);
		//back edge

        //rgb_matrix_set_color(i, 0xff, 0xff, 0x00);
  }
  return led_max < DRIVER_LED_TOTAL;
}





static bool RGB_CUSTOM_ZONFIRE_2(effect_params_t* params) {
  RGB_MATRIX_USE_LIMITS(led_min, led_max);
  for (uint8_t i = led_min; i < led_max; i++) {
    

        rgb_matrix_set_color(0, 0xFF, 0x00, 0xFF);
		rgb_matrix_set_color(1, 0xFF, 0x00, 0xFF);
		rgb_matrix_set_color(2, 0xFF, 0x00, 0xFF);
		rgb_matrix_set_color(3, 0xFF, 0x00, 0xFF);
		rgb_matrix_set_color(4, 0xFF, 0x00, 0xFF);

		rgb_matrix_set_color(5, 0xFF, 0x00, 0xFF);
		rgb_matrix_set_color(6, 0xFF, 0x00, 0xFF);
		rgb_matrix_set_color(7, 0xFF, 0x00, 0xFF);
		rgb_matrix_set_color(8, 0xFF, 0x00, 0xFF);
		
		rgb_matrix_set_color(9, 0xFF, 0x00, 0xFF);
		rgb_matrix_set_color(10, 0xFF, 0x00, 0xFF);
		rgb_matrix_set_color(11, 0xFF, 0x00, 0xFF);
		rgb_matrix_set_color(12, 0xFF, 0x00, 0xFF);
		rgb_matrix_set_color(13, 0xFF, 0x00, 0xFF);
		rgb_matrix_set_color(14, 0xFF, 0x00, 0xFF);


		rgb_matrix_set_color(15, 0xBF, 0x40, 0xFF);
		rgb_matrix_set_color(16, 0xBF, 0x40, 0xFF);
		rgb_matrix_set_color(17, 0xBF, 0x40, 0xFF);
		rgb_matrix_set_color(18, 0xBF, 0x40, 0xFF);
		rgb_matrix_set_color(19, 0xBF, 0x40, 0xFF);
		rgb_matrix_set_color(20, 0xBF, 0x40, 0xFF);
		rgb_matrix_set_color(21, 0xBF, 0x40, 0xFF);
		rgb_matrix_set_color(22, 0xBF, 0x40, 0xFF);
		rgb_matrix_set_color(23, 0xBF, 0x40, 0xFF);
		rgb_matrix_set_color(24, 0xBF, 0x40, 0xFF);
		rgb_matrix_set_color(25, 0xBF, 0x40, 0xFF);
		rgb_matrix_set_color(26, 0xBF, 0x40, 0xFF);
		rgb_matrix_set_color(27, 0xBF, 0x40, 0xFF);
		rgb_matrix_set_color(28, 0xBF, 0x40, 0xFF);
		rgb_matrix_set_color(29, 0xBF, 0x40, 0xFF);
		
		rgb_matrix_set_color(30, 0x80, 0x80, 0xFF);
		rgb_matrix_set_color(31, 0x80, 0x80, 0xFF);
		rgb_matrix_set_color(32, 0x80, 0x80, 0xFF);
		rgb_matrix_set_color(33, 0x80, 0x80, 0xFF);
		rgb_matrix_set_color(34, 0x80, 0x80, 0xFF);
		rgb_matrix_set_color(35, 0x80, 0x80, 0xFF);
		rgb_matrix_set_color(36, 0x80, 0x80, 0xFF);
		rgb_matrix_set_color(37, 0x80, 0x80, 0xFF);
		rgb_matrix_set_color(38, 0x80, 0x80, 0xFF);
		rgb_matrix_set_color(39, 0x80, 0x80, 0xFF);
		rgb_matrix_set_color(40, 0x80, 0x80, 0xFF);
		rgb_matrix_set_color(41, 0x80, 0x80, 0xFF);
		rgb_matrix_set_color(42, 0x80, 0x80, 0xFF);
		rgb_matrix_set_color(43, 0x80, 0x80, 0xFF);

		rgb_matrix_set_color(44, 0x40, 0xBF, 0xFF);
		rgb_matrix_set_color(45, 0x40, 0xBF, 0xFF);
		rgb_matrix_set_color(46, 0x40, 0xBF, 0xFF);
		rgb_matrix_set_color(47, 0x40, 0xBF, 0xFF);
		rgb_matrix_set_color(48, 0x40, 0xBF, 0xFF);
		rgb_matrix_set_color(49, 0x40, 0xBF, 0xFF);
		rgb_matrix_set_color(50, 0x40, 0xBF, 0xFF);
		rgb_matrix_set_color(51, 0x40, 0xBF, 0xFF);
		rgb_matrix_set_color(52, 0x40, 0xBF, 0xFF);
		rgb_matrix_set_color(53, 0x40, 0xBF, 0xFF);
		rgb_matrix_set_color(54, 0x40, 0xBF, 0xFF);
		rgb_matrix_set_color(55, 0x40, 0xBF, 0xFF);
		rgb_matrix_set_color(56, 0x40, 0xBF, 0xFF);

		rgb_matrix_set_color(57, 0x00, 0xFF, 0xFF);
		rgb_matrix_set_color(58, 0x00, 0xFF, 0xFF);
		rgb_matrix_set_color(59, 0x00, 0xFF, 0xFF);
		rgb_matrix_set_color(60, 0x00, 0xFF, 0xFF);
		rgb_matrix_set_color(61, 0x00, 0xFF, 0xFF);
		rgb_matrix_set_color(62, 0x00, 0xFF, 0xFF);
		rgb_matrix_set_color(63, 0x00, 0xFF, 0xFF);
		
		//arrow keys
		//rgb_matrix_set_color(56, 0x00, 0xFF, 0xFF);
		rgb_matrix_set_color(64, 0x00, 0xFF, 0xFF);
		rgb_matrix_set_color(65, 0x00, 0xFF, 0xFF);
		rgb_matrix_set_color(66, 0x00, 0xFF, 0xFF);
		//arrow keys
		
		//edge corners
		rgb_matrix_set_color(100, 0xFF, 0x00, 0xFF);//left
		rgb_matrix_set_color(86, 0xFF, 0x00, 0xFF);//right

		rgb_matrix_set_color(67, 0x00, 0xFF, 0xFF);//left
		rgb_matrix_set_color(81, 0x00, 0xFF, 0xFF);//right
		//edge corners
		

		
		//front edge
		rgb_matrix_set_color(68, 0x00, 0xFF, 0xFF);//LEFT
		rgb_matrix_set_color(69, 0x00, 0xFF, 0xFF);
		rgb_matrix_set_color(70, 0x00, 0xFF, 0xFF);
		rgb_matrix_set_color(71, 0x00, 0xFF, 0xFF);
		rgb_matrix_set_color(72, 0x00, 0xFF, 0xFF);
		rgb_matrix_set_color(73, 0x00, 0xFF, 0xFF);
		rgb_matrix_set_color(74, 0x00, 0xFF, 0xFF);
		rgb_matrix_set_color(75, 0x00, 0xFF, 0xFF);
		rgb_matrix_set_color(76, 0x00, 0xFF, 0xFF);
		rgb_matrix_set_color(77, 0x00, 0xFF, 0xFF);
		rgb_matrix_set_color(78, 0x00, 0xFF, 0xFF);
		rgb_matrix_set_color(79, 0x00, 0xFF, 0xFF);
		rgb_matrix_set_color(80, 0x00, 0xFF, 0xFF);//RIGHT
		//front edge
		
		//left edge
		rgb_matrix_set_color(101, 0xCC, 0x33, 0xFF);//TOP
		rgb_matrix_set_color(102, 0x99, 0x66, 0xFF);
		rgb_matrix_set_color(103, 0x66, 0x99, 0xFF);
		rgb_matrix_set_color(104, 0x33, 0xCC, 0xFF);//BOTTOM
		//left edge
		
		//right edge
		rgb_matrix_set_color(85, 0xCC, 0x33, 0xFF);//TOP
		rgb_matrix_set_color(84, 0x99, 0x66, 0xFF);
		rgb_matrix_set_color(83, 0x66, 0x99, 0xFF);
		rgb_matrix_set_color(82, 0xCC, 0xCC, 0xFF);//BOTTOM
		//right edge
		
		//back edge
		rgb_matrix_set_color(87, 0xFF, 0x00, 0xFF);//RIGHT
		rgb_matrix_set_color(88, 0xFF, 0x00, 0xFF);
		rgb_matrix_set_color(89, 0xFF, 0x00, 0xFF);
		rgb_matrix_set_color(90, 0xFF, 0x00, 0xFF);
		rgb_matrix_set_color(91, 0xFF, 0x00, 0xFF);
		rgb_matrix_set_color(92, 0xFF, 0x00, 0xFF);
		rgb_matrix_set_color(93, 0xFF, 0x00, 0xFF);
		rgb_matrix_set_color(94, 0xFF, 0x00, 0xFF);
		rgb_matrix_set_color(95, 0xFF, 0x00, 0xFF);
		rgb_matrix_set_color(96, 0xFF, 0x00, 0xFF);
		rgb_matrix_set_color(97, 0xFF, 0x00, 0xFF);
		rgb_matrix_set_color(98, 0xFF, 0x00, 0xFF);
		rgb_matrix_set_color(99, 0xFF, 0x00, 0xFF);//LEFT
		//back edge

        //rgb_matrix_set_color(i, 0xff, 0xff, 0x00);
  }
  return led_max < DRIVER_LED_TOTAL;
}


static bool RGB_CUSTOM_ZONFIRE_WHITE(effect_params_t* params) {
  RGB_MATRIX_USE_LIMITS(led_min, led_max);
  for (uint8_t i = led_min; i < led_max; i++) {
    
	  rgb_matrix_set_color_all(255, 255, 255);
        
  }
  return led_max < DRIVER_LED_TOTAL;
}

/*
// e.g: A more complex effect, relying on external methods and state, with
// dedicated init and run methods
static uint8_t some_global_state;
static void my_cool_effect2_complex_init(effect_params_t* params) {
  some_global_state = 1;
}
static bool my_cool_effect2_complex_run(effect_params_t* params) {
  RGB_MATRIX_USE_LIMITS(led_min, led_max);
  for (uint8_t i = led_min; i < led_max; i++) {
    rgb_matrix_set_color(i, 0xff, some_global_state++, 0xff);
  }

  return led_max < DRIVER_LED_TOTAL;
}
static bool my_cool_effect2(effect_params_t* params) {
  if (params->init) my_cool_effect2_complex_init(params);
  return my_cool_effect2_complex_run(params);
}*/
#endif // RGB_MATRIX_CUSTOM_EFFECT_IMPLS