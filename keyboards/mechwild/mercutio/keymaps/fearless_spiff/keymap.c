/* Copyright 2021 Kyle McCreery
 * Copyright 2021 Jonavin Eng
 * Copyright 2022 Fearless Spiff
 *
 * This program is free software: you can redistribute it and/or modify
 * it under the terms of the GNU General Public License as published by
 * the Free Software Foundation, either version 2 of the License, or
 * (at your option) any later version.
 *
 * This program is distributed in the hope that it will be useful,
 * but WITHOUT ANY WARRANTY; without even the implied warranty of
 * MERCHANTABILITY or FITNESS FOR A PARTICULAR PURPOSE.  See the
 * GNU General Public License for more details.
 *
 * You should have received a copy of the GNU General Public License
 * along with this program.  If not, see <http://www.gnu.org/licenses/>.
 */

#include QMK_KEYBOARD_H
#include "keymap_german.h"

// OLED setup for bongocat
#define IDLE_FRAMES 5
#define IDLE_SPEED 30
#define TAP_FRAMES 2
#define TAP_SPEED 40
#define ANIM_FRAME_DURATION 200
#define ANIM_SIZE 512

#define LABEL_LENGTH 8

#define KC_CAD	        LALT(LCTL(KC_DEL))
#define KC_TEAMS_CAM	C(S(KC_O))
#define KC_TEAMS_MUTE	C(S(KC_M))

enum layers {
  QWERT,
  FN_1,
  FN_2,
  FN_MOUSE
};

enum custom_user_keycodes {
  KC_ENC = SAFE_RANGE
};

static long int oled_timeout = 1800000; //  30 minutes
bool gui_on = true;
char wpm_str[10];
uint32_t anim_timer = 0;
uint32_t anim_sleep = 0;
uint8_t current_idle_frame = 0;
uint8_t current_tap_frame = 0;

// Tap Dance declarations
enum {
    TD_TAB_ESC,
};

// Tap Dance definitions
qk_tap_dance_action_t tap_dance_actions[] = {
    // Tap once for Tab, twice for Esc
    [TD_TAB_ESC] = ACTION_TAP_DANCE_DOUBLE(KC_TAB, KC_ESC),
};

typedef struct {
    char label_top[LABEL_LENGTH];
    char label_mid[LABEL_LENGTH];
    char label_bottom[LABEL_LENGTH];
    uint16_t keycode;
} encoder_key;

static const encoder_key PROGMEM encoder_keys[] = {
    // list of key codes that will be scrolled through by encoder and description
    // Be aware that it only works when using one char less than defined. In this case 7 max. No idea why?
    {"Teams", "Toggle", "Mic", KC_TEAMS_MUTE},
    {"Teams", "Toggle", "Cam", KC_TEAMS_CAM},
    {"Ctrl", "Alt", "Del", KC_CAD},
    {"Caps", "Lock", "", KC_CAPSLOCK},
    {"Pause", "", "", KC_PAUSE},
    {"PrtScr", "", "", KC_PSCR},
    {"Insert", "", "", KC_INS},
    {"Play", "", "", KC_MEDIA_PLAY_PAUSE}
};

#define NUMBER_OF_ENCODER_KEYS sizeof(encoder_keys)/sizeof(encoder_keys[0])

static uint8_t selected_encoder_key_id = 0;
static encoder_key selected_encoder_key;

static void set_selected_encoder_key(uint8_t idx) {
    // make a copy from PROGMEM
    memcpy_P (&selected_encoder_key, &encoder_keys[idx], sizeof selected_encoder_key);
}

bool process_record_user(uint16_t keycode, keyrecord_t *record) {
    switch (keycode) {
        case KC_ENC:
            if (record->event.pressed) {
                tap_code16(selected_encoder_key.keycode);
            }
        break;
    }
    return true;
}


const uint16_t PROGMEM keymaps[][MATRIX_ROWS][MATRIX_COLS] = {
    [QWERT] = LAYOUT_all(
                                                                                                                      KC_ENC,
          TD(TD_TAB_ESC),   KC_Q,    KC_W,    KC_E,    KC_R,    KC_T,    DE_Z,    KC_U,    KC_I,    KC_O,    KC_P,    KC_BSPC,
          MO(FN_1), KC_A,   KC_S,    KC_D,    KC_F,    KC_G,    KC_H,    KC_J,    KC_K,    KC_L,    DE_PLUS,          KC_ENT,
          KC_LSFT, DE_LABK, DE_Y,    KC_X,    KC_C,    KC_V,    KC_B,    KC_N,    KC_M,    KC_COMM, KC_DOT,           KC_RSFT,
          KC_LCTL, KC_LGUI, KC_LALT,   LT(FN_2,KC_SPC),   LT(FN_2,KC_SPC),     LT(FN_2,KC_SPC),      KC_RALT, DE_MINS,          KC_RCTL ),

    [FN_1] = LAYOUT_all(
                                                                                                                       KC_MUTE,
    	  KC_GESC,          _______, _______, _______, DE_LCBR, DE_RCBR, _______, DE_UDIA, KC_UP,    DE_ODIA, DE_QUES, KC_DEL,
    	  _______,          DE_ADIA, DE_SS,   _______, DE_LPRN, DE_RPRN, _______, KC_LEFT, KC_DOWN, KC_RIGHT, DE_HASH, _______,
    	  _______, _______, DE_CIRC, DE_ACUT, _______, DE_LBRC, DE_RBRC, KC_HOME, KC_END,  DE_QUOT,  DE_DQUO,          DE_EQL,
    	  _______,   _______, _______,    MO(FN_MOUSE),   MO(FN_MOUSE),       MO(FN_MOUSE),          DE_BSLS, DE_SLSH,         DE_TILD ),

    [FN_2] = LAYOUT_all(
                                                                                                                      _______,
    	  KC_F1,            KC_F2,   KC_F3,   KC_F4,   KC_F5,   KC_F6,   KC_F7,   KC_F8,   KC_F9,   KC_F10,  KC_F11,  KC_BSPC,
    	  KC_1,             KC_2,    KC_3,    KC_4,    KC_5,    KC_6,    KC_7,    KC_8,    KC_9,    KC_0,    _______, _______,
    	  _______, _______, _______, _______, _______, _______, _______, _______, _______, KC_COMM, KC_DOT,           _______,
    	  _______, _______, _______,          _______, _______,          _______,          _______, _______,          _______ ),

    [FN_MOUSE] = LAYOUT_all(
                                                                                                                      _______,
          _______,          _______, _______, _______, _______, _______, _______, KC_BTN1, KC_MS_U, KC_BTN2, KC_BTN3, _______,
          _______,          _______, _______, _______, KC_ACL0, _______, KC_WH_U, KC_MS_L, KC_MS_D, KC_MS_R, KC_WH_D, _______,
          _______, _______, _______, _______, _______, _______, _______, _______, _______,  _______,  _______,          _______,
          _______,   _______, _______,        _______,   _______,        _______,          _______, _______,         _______ )
};

#ifdef ENCODER_ENABLE
    bool encoder_update_user(uint8_t index, bool clockwise) {
        if (clockwise) {
            if (IS_LAYER_ON(QWERT) && selected_encoder_key_id  < NUMBER_OF_ENCODER_KEYS-1) {
               selected_encoder_key_id ++;
               set_selected_encoder_key(selected_encoder_key_id);
            }
            if (IS_LAYER_ON(FN_1)) {
                tap_code16(KC_PGDOWN);
            }
            if (IS_LAYER_ON(FN_2)) {
                tap_code(KC_VOLU);
            }
        } else {
            if (IS_LAYER_ON(QWERT) && selected_encoder_key_id  > 0) {
                selected_encoder_key_id --;
                set_selected_encoder_key(selected_encoder_key_id);
            }
            if (IS_LAYER_ON(FN_1)) {
                tap_code16(KC_PGUP);
            }
            if (IS_LAYER_ON(FN_2)) {
                tap_code(KC_VOLD);
            }
        }
        return false;
    }
#endif

#ifdef OLED_ENABLE
    oled_rotation_t oled_init_user(oled_rotation_t rotation) {
        set_selected_encoder_key(selected_encoder_key_id);

        return OLED_ROTATION_180;  // flips the display 180 degrees
    }

    static void render_anim(void) {

        // Idle animation
        static const char PROGMEM idle[IDLE_FRAMES][ANIM_SIZE] = {

            {
                0,0,0,0,0,0,0,0,0,0,0,0,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64,
                64,64,32,32,32,32,16,16,16,16,8,8,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7,
                0,0,0,0,0,0,0,0,0,0,0,0,0,0,0,0,0,0,0,0,0,0,0,0,0,0,0,0,0,0,0,0,0,0,0,0,0,0,0,0,0,0,0,0,0,0,0,0,0,0,0,0,0,0,0,0,0,0,0,0,0
            },

            {
                0,0,0,0,0,0,0,0,0,0,0,0,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64,
                64,64,32,32,32,32,16,16,16,16,8,8,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8,
                7,0,0,0,0,0,0,0,0,0,0,0,0,0,0,0,0,0,0,0,0,0,0,0,0,0,0,0,0,0,0,0,0,0,0,0,0,0,0,0,0,0,0,0,0,0,0,0,0,0,0,0,0,0,0,0,0,0,0,0,0,0
            },

            {
                0,0,0,0,0,0,0,0,0,0,0,0,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32,
                32,32,32,16,16,16,16,8,8,8,8,8,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0,
                0,0,0,0,0,0,0,0,0,0,0,0,0,0,0,0,0,0,0,0,0,0,0,0,0,0,0,0,0,0,0,0,0,0,0,0,0,0,0,0,0,0,0,0,0,0,0,0,0,0,0,0,0,0,0,0,0,0
            },

            {
                0,0,0,0,0,0,0,0,0,0, 0,0,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64,
                64,64,32,32,32,32,16,16,16,16,8,8,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8,
                7,0,0,0,0,0,0,0,0,0,0,0,0,0,0,0,0,0,0,0,0,0,0,0,0,0,0,0,0,0,0,0,0,0,0,0,0,0,0,0,0,0,0,0,0,0,0,0,0,0,0,0,0,0,0,0,0,0,0,0,0,0
            },

            {
                0,0,0,0,0,0,0,0,0,0,0,0,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64,
                32,32,32,32,16,16,16,16,8,8,8,8,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0,
                0,0,0,0,0,0,0,0,0,0,0,0,0,0,0,0,0,0,0,0,0,0,0,0,0,0,0,0,0,0,0,0,0,0,0,0,0,0,0,0,0,0,0,0,0,0,0,0,0,0,0,0,0,0,0,0,0,0,0
            }

        };

        // Prep animation
        static const char PROGMEM prep[][ANIM_SIZE] = {

            {
                0,0,0,0,0,0,0,0,0,0,0,0,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64,
                64,64,32,32,32,32,16,16,16,16,8,8,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0,
                0,0,0,0,0,0,0,0,0,0,0,0,0,0,0,0,0,0,0,0,0,0,0,0,0,0,0,0,0,0,0,0,0,0,0,0,0,0,0,0,0,0,0,0,0,0,0,0,0,0,0,0,0,0,0,0,0,0,0,0,0,0
            }

        };

        // Typing animation
        static const char PROGMEM tap[TAP_FRAMES][ANIM_SIZE] = {

            {
                0,0,0,0,0,0,0,0,0,0,0,0,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159,
                95,95,79,76,32,32,32,32,16,16,16,16,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1,
                1,1,1,0,0,0,0,0,0,0,0,0,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0
            },

            {
                0,0,0,0,0,0,0,0,0,0,0,0,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32,
                32,32,32,16,16,16,16,8,8,8,8,8,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128,
                0,0,0,0,0,0,0,0,0,0,0,0,0,0,0,0,0,0,0,0,0,0,0,0,0,0,0,0,0,0,0,0,0,0,0,0,0,0,0,0,0,0,0,0,0,0,0,0,0,0,0,0,0,0,0,0,0,0,0,0
            }

        };

        void animation_phase(void) {
            if (get_current_wpm() <= IDLE_SPEED) {
                current_idle_frame = (current_idle_frame + 1) % IDLE_FRAMES;
                oled_write_raw_P(idle[abs((IDLE_FRAMES-1)-current_idle_frame)], ANIM_SIZE);
            }

            if (get_current_wpm() > IDLE_SPEED && get_current_wpm() < TAP_SPEED) {
                oled_write_raw_P(prep[0], ANIM_SIZE);
            }

            if (get_current_wpm() >= TAP_SPEED) {
                current_tap_frame = (current_tap_frame + 1) % TAP_FRAMES;
                oled_write_raw_P(tap[abs((TAP_FRAMES-1)-current_tap_frame)], ANIM_SIZE);
            }
        }

        if (get_current_wpm() != 000) {
            oled_on();

            if (timer_elapsed32(anim_timer) > ANIM_FRAME_DURATION) {
                anim_timer = timer_read32();
                animation_phase();
            }

            anim_sleep = timer_read32();
        } else {
            if (timer_elapsed32(anim_sleep) > oled_timeout) {
                oled_off();
            } else {
                if (timer_elapsed32(anim_timer) > ANIM_FRAME_DURATION) {
                    anim_timer = timer_read32();
                    animation_phase();
                }
            }
        }
    }

    bool oled_task_user(void) {

            render_anim();

            oled_set_cursor(0,0);
            oled_write(selected_encoder_key.label_top, false);

            oled_set_cursor(0,1);
            oled_write(selected_encoder_key.label_mid, false);

            oled_set_cursor(0,2);
            oled_write(selected_encoder_key.label_bottom, false);

    /* hide wpm display for now
            oled_set_cursor(13,3);
            oled_write_P(PSTR("WPM: "), false);
            oled_write(get_u8_str(get_current_wpm(), ' '), false);
    */

      return false;
    }

    void suspend_power_down_user(void) {
          oled_off();
    }
#endif
