#include QMK_KEYBOARD_H
char wpm_str[10];

enum layers{
  _BASE,
  _FN,
  _NUM
};

const uint16_t PROGMEM keymaps[][MATRIX_ROWS][MATRIX_COLS] = {
  [_BASE] = LAYOUT(
           KC_ESC,    KC_Q,    KC_W,    KC_E, KC_R,   KC_T,   KC_Y,   KC_U, KC_I,    KC_O,    KC_P,     KC_LBRC, KC_RBRC, KC_BSPC,       KC_DEL,  KC_MUTE,
           KC_TAB,    KC_A,    KC_S,    KC_D, KC_F,   KC_G,   KC_H,   KC_J, KC_K,    KC_L,    KC_SCLN,  KC_QUOT, KC_BSLS, KC_ENT,
           KC_LSHIFT, KC_Z,    KC_X,    KC_C, KC_V,   KC_B,   KC_N,   KC_M, KC_COMM, KC_DOT,  KC_SLSH,  KC_RSFT,                         KC_UP,
           KC_LCTRL,  KC_LGUI, KC_LALT,       KC_SPC, KC_SPC, KC_SPC,       KC_RALT, MO(_FN), KC_RCTRL,                         KC_LEFT, KC_DOWN, KC_RIGHT
    ),
  [_FN] = LAYOUT(
           KC_GRV,  KC_1,    KC_2,    KC_3,    KC_4,    KC_5,    KC_6,    KC_7,    KC_8,      KC_9,    KC_0,    KC_MINS, KC_EQL, KC_DEL,          KC_PGDN, KC_PGUP,
           KC_CAPS, KC_F1,   KC_F2,   KC_F3,   KC_F4,   KC_F5,   KC_F6,   KC_F7,   KC_F8,     KC_F9,   KC_F10,  KC_F11,  KC_F12, KC_TRNS,
           KC_TRNS, KC_TRNS, KC_TRNS, KC_TRNS, KC_TRNS, KC_TRNS, KC_TRNS, KC_TRNS, KC_TRNS,   KC_TRNS, KC_TRNS, KC_TRNS,                          KC_TRNS,
           RESET,   KC_TRNS, KC_TRNS,          KC_TRNS, KC_TRNS, KC_TRNS,          MO(_NUM),  KC_TRNS, KC_TRNS,                          KC_TRNS, KC_TRNS, KC_TRNS
    ),
  [_NUM] = LAYOUT(
           KC_TRNS, KC_TRNS, KC_TRNS, KC_TRNS, KC_TRNS, KC_TRNS, KC_TRNS, KC_TRNS, KC_TRNS, KC_TRNS, KC_TRNS, KC_TRNS, KC_TRNS, KC_TRNS,         KC_TRNS, KC_TRNS,
           KC_TRNS, KC_TRNS, KC_TRNS, KC_TRNS, KC_TRNS, KC_TRNS, KC_TRNS, KC_TRNS, KC_TRNS, KC_TRNS, KC_TRNS, KC_TRNS, KC_TRNS, KC_TRNS,
           KC_TRNS, KC_TRNS, KC_TRNS, KC_TRNS, KC_TRNS, KC_TRNS, KC_TRNS, KC_TRNS, KC_TRNS, KC_TRNS, KC_TRNS, KC_TRNS,                           KC_1,
           RESET,   KC_TRNS, KC_TRNS,          KC_TRNS, KC_TRNS, KC_TRNS,          KC_TRNS, KC_TRNS, KC_TRNS,                             KC_2,  KC_3,    KC_4
    )
};

bool encoder_update_user(uint8_t index, bool clockwise) {
    if (index == 0) { /* First encoder */
        if (clockwise) {
            tap_code_delay(KC_VOLU, 10);
        } else {
            tap_code_delay(KC_VOLD, 10);
        }
    }
    return false;

}


#ifdef OLED_ENABLE
// WPM-responsive animation stuff here
#    define IDLE_FRAMES 5
#    define IDLE_SPEED 20  // below this wpm value your animation will idle

// #define PREP_FRAMES 1 // uncomment if >1

#    define TAP_FRAMES 2
#    define TAP_SPEED 40  // above this wpm value typing animation to trigger

#    define ANIM_FRAME_DURATION 200  // how long each frame lasts in ms
// #define SLEEP_TIMER 60000 // should sleep after this period of 0 wpm, needs fixing
#    define ANIM_SIZE 636  // number of bytes in array, minimize for adequate firmware size, max is 1024

uint32_t anim_timer         = 0;
uint32_t anim_sleep         = 0;
uint8_t  current_idle_frame = 0;
// uint8_t current_prep_frame = 0; // uncomment if PREP_FRAMES >1
uint8_t current_tap_frame = 0;

// Code containing pixel art, contains:
// 5 idle frames, 1 prep frame, and 2 tap frames

// To make your own pixel art:
// save a png/jpeg of an 128x32 image (resource: https://www.pixilart.com/draw )
// follow this guide up to and including "CONVERT YOUR IMAGE" https://docs.splitkb.com/hc/en-us/articles/360013811280-How-do-I-convert-an-image-for-use-on-an-OLED-display-
// replace numbers in brackets with your own
// if you start getting errors when compiling make sure you didn't accedentally delete a bracket
static void render_anim(void) {
    static const char PROGMEM idle[IDLE_FRAMES][ANIM_SIZE] = {
        {
        0,  0,126,126, 24, 60,102, 66,  0, 12, 28,112,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128,
        0,  0,  0,  0,192, 96, 48, 24, 12,132,198, 98,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  0,
        0,  0,252, 15,  1,  0,248, 14, 31,109,140,148,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  0,
        0,  0, 31,120,192,  0, 15, 56,124,219,152, 20,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  0,
        32, 16, 16, 16, 17, 11, 14, 12, 24, 16, 49, 35,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  8
        },
        {
        0,  0,126,126, 24, 60,102, 66,  0, 12, 28,112,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128,
        0,  0,  0,  0,192, 96, 48, 24, 12,132,198, 98,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  0,
        0,  0,252, 15,  1,  0,248, 14, 31,109,140,148,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  0,
        0,  0, 31,120,192,  0, 15, 56,124,219,152, 20,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  0,
        32, 16, 16, 16, 17, 11, 14, 12, 24, 16, 49, 35,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  8
        },
        {
        0,  0,126,126, 24, 60,102, 66,  0, 12, 28,112,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128,
        0,  0,  0,  0,192, 96, 48, 24, 12,132,198, 98,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  0,
        0,  0,252, 15,  1,  0,248, 14, 31,109,140,148,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  0,
        0,  0, 31,120,192,  0, 15, 56,124,219,152, 20,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  0,
        32, 16, 16, 16, 17, 11, 14, 12, 24, 16, 49, 35,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  8
        },
        {
        0,  0,126,126, 24, 60,102, 66,  0, 12, 28,112,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128,
        0,  0,  0,  0,192, 96, 48, 24, 12,132,198, 98,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  0,
        0,  0,252, 15,  1,  0,248, 14, 31,109,140,148,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  0,
        0,  0, 31,120,192,  0, 15, 56,124,219,152, 20,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  0,
        32, 16, 16, 16, 17, 11, 14, 12, 24, 16, 49, 35,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  8
        },
        {
        0,  0,126,126, 24, 60,102, 66,  0, 12, 28,112,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128,
        0,  0,  0,  0,192, 96, 48, 24, 12,132,198, 98,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  0,
        0,  0,252, 15,  1,  0,248, 14, 31,109,140,148,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  0,
        0,  0, 31,120,192,  0, 15, 56,124,219,152, 20,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  0,
        32, 16, 16, 16, 17, 11, 14, 12, 24, 16, 49, 35,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  8
        }
    };
    static const char PROGMEM prep[][ANIM_SIZE] = {
        {
        0,  0,126,126, 24, 60,102, 66,  0, 12, 28,112,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128,
        0,  0,  0,  0,192, 96, 48, 24, 12,132,198, 98,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  0,
        0,  0,252, 15,  1,  0,248, 14, 31,109,140,148,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  0,
        0,  0, 31,120,192,  0, 15, 56,124,219,152, 20,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  0,
        32, 16, 16, 16, 17, 11, 14, 12, 24, 16, 49, 35,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  8
        }
    };
    static const char PROGMEM tap[TAP_FRAMES][ANIM_SIZE] = {
        {
        0,  0,126,126, 24, 60,102, 66,  0, 12, 28,112,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128,
        0,  0,  0,  0,192, 96, 48, 24, 12,132,198, 98,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  0,
        0,  0,252, 15,  1,  0,248, 14, 31,109,140,148,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  0,
        0,  0, 31,120,192,  0, 15, 56,124,219,152, 20,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  0,
        32, 16, 16, 16, 17, 11, 14, 12, 24, 16, 49, 35,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  8
        },
        {
        0,  0,126,126, 24, 60,102, 66,  0, 12, 28,112,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128,
        0,  0,  0,  0,192, 96, 48, 24, 12,132,198, 98,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  0,
        0,  0,252, 15,  1,  0,248, 14, 31,109,140,148,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  0,
        0,  0, 31,120,192,  0, 15, 56,124,219,152, 20,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  0,
        32, 16, 16, 16, 17, 11, 14, 12, 24, 16, 49, 35,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  8
        },
    };

    // assumes 1 frame prep stage
    void animation_phase(void) {
        if (get_current_wpm() <= IDLE_SPEED) {
            current_idle_frame = (current_idle_frame + 1) % IDLE_FRAMES;
            oled_write_raw_P(idle[abs((IDLE_FRAMES - 1) - current_idle_frame)], ANIM_SIZE);
        }
        if (get_current_wpm() > IDLE_SPEED && get_current_wpm() < TAP_SPEED) {
            // oled_write_raw_P(prep[abs((PREP_FRAMES-1)-current_prep_frame)], ANIM_SIZE); // uncomment if IDLE_FRAMES >1
            oled_write_raw_P(prep[0], ANIM_SIZE);  // remove if IDLE_FRAMES >1
        }
        if (get_current_wpm() >= TAP_SPEED) {
            current_tap_frame = (current_tap_frame + 1) % TAP_FRAMES;
            oled_write_raw_P(tap[abs((TAP_FRAMES - 1) - current_tap_frame)], ANIM_SIZE);
        }
    }
    if (get_current_wpm() != 000) {
        oled_on();  // not essential but turns on animation OLED with any alpha keypress
        if (timer_elapsed32(anim_timer) > ANIM_FRAME_DURATION) {
            anim_timer = timer_read32();
            animation_phase();
        }
        anim_sleep = timer_read32();
    } else {
        if (timer_elapsed32(anim_sleep) > OLED_TIMEOUT) {
            oled_off();
        } else {
            if (timer_elapsed32(anim_timer) > ANIM_FRAME_DURATION) {
                anim_timer = timer_read32();
                animation_phase();
            }
        }
    }
}

// Used to draw on to the oled screen
bool oled_task_user(void) {
    render_anim();  // renders pixelart

    oled_set_cursor(0, 0);                            // sets cursor to (row, column) using charactar spacing (5 rows on 128x32 screen, anything more will overflow back to the top)
    sprintf(wpm_str, "WPM:%03d", get_current_wpm());  // edit the string to change wwhat shows up, edit %03d to change how many digits show up
    oled_write(wpm_str, false);                       // writes wpm on top left corner of string

    led_t led_state = host_keyboard_led_state();  // caps lock stuff, prints CAPS on new line if caps led is on
    oled_set_cursor(0, 1);
    oled_write_P(led_state.caps_lock ? PSTR("CAPS") : PSTR("       "), false);

    return false;
}
#endif
