#include QMK_KEYBOARD_H
#include "debug.h"
#include "action_layer.h"
#include "version.h"


#include "keymap_german.h"

#include "keymap_nordic.h"



enum custom_keycodes {
  PLACEHOLDER = SAFE_RANGE, // can always be here
  EPRM,
  VRSN,
  RGB_SLD,
  RGB_0000FF,
  RGB_008000,
  RGB_FFA500,
  RGB_800080,
  RGB_FF0000
};

const uint16_t PROGMEM keymaps[][MATRIX_ROWS][MATRIX_COLS] = {

  [0] = KEYMAP(KC_ESCAPE,KC_1,KC_2,KC_3,KC_4,KC_5,TO(7),KC_TAB,KC_Q,KC_W,KC_E,KC_R,KC_T,ALL_T(KC_NO),KC_LCTL,KC_A,KC_S,KC_D,KC_F,KC_G,KC_LSHIFT,KC_Z,KC_X,KC_C,KC_V,KC_B,LT(1,KC_NO),LT(4,KC_GRAVE),LT(2,KC_NONUS_BSLASH),KC_LCTL,KC_LGUI,KC_LALT,LT(2,KC_GRAVE),MEH_T(KC_NO),LT(4,KC_DELETE),KC_SPACE,LT(3,KC_ENTER),LT(5,KC_BSPACE),TO(1),KC_6,KC_7,KC_8,KC_9,KC_0,KC_BSPACE,ALL_T(KC_NO),KC_Y,KC_U,KC_I,KC_O,KC_P,KC_BSLASH,KC_H,KC_J,KC_K,KC_L,KC_SCOLON,KC_QUOTE,LT(1,KC_NO),KC_N,KC_M,KC_COMMA,KC_DOT,KC_SLASH,KC_RSHIFT,ALGR_T(KC_MINUS),RGUI_T(KC_EQUAL),KC_LBRACKET,KC_RBRACKET,RCTL_T(KC_APPLICATION),KC_LEFT,KC_RIGHT,KC_UP,KC_DOWN,LT(2,KC_SPACE),LT(3,KC_ENTER)),

  [1] = KEYMAP(KC_MINUS,KC_0,KC_9,KC_8,KC_7,KC_6,TO(0),KC_BSLASH,KC_P,KC_O,KC_I,KC_U,KC_Y,KC_APPLICATION,KC_QUOTE,KC_SCOLON,KC_L,KC_K,KC_J,KC_H,KC_RSHIFT,KC_SLASH,KC_DOT,KC_COMMA,KC_M,KC_N,KC_TRANSPARENT,KC_LBRACKET,KC_RBRACKET,RCTL_T(KC_NO),RGUI_T(KC_NO),ALGR_T(KC_NO),KC_LCBR,KC_RCBR,KC_EQUAL,KC_TRANSPARENT,KC_TRANSPARENT,KC_MINUS,TO(2),KC_5,KC_4,KC_3,KC_2,KC_1,KC_GRAVE,KC_ESCAPE,KC_T,KC_R,KC_E,KC_W,KC_Q,KC_TAB,KC_G,KC_F,KC_D,KC_S,KC_A,KC_LCTL,KC_TRANSPARENT,KC_B,KC_V,KC_C,KC_X,KC_Z,KC_LSHIFT,ALGR_T(KC_MINUS),RGUI_T(KC_EQUAL),KC_TRANSPARENT,KC_TRANSPARENT,RCTL_T(KC_APPLICATION),KC_TRANSPARENT,KC_TRANSPARENT,KC_TRANSPARENT,KC_TRANSPARENT,KC_TRANSPARENT,KC_TRANSPARENT),

  [2] = KEYMAP(KC_TRANSPARENT,KC_F1,KC_F2,KC_F3,KC_F4,KC_F5,TO(1),KC_TRANSPARENT,KC_F11,KC_F12,KC_F13,KC_F14,KC_F15,KC_TRANSPARENT,KC_CAPSLOCK,KC_F16,KC_F17,KC_F18,KC_F19,KC_F20,KC_TRANSPARENT,KC_F21,KC_F22,KC_F23,KC_F24,KC_TRANSPARENT,KC_TRANSPARENT,KC_TRANSPARENT,KC_TRANSPARENT,KC_TRANSPARENT,KC_TRANSPARENT,KC_TRANSPARENT,KC_TRANSPARENT,KC_TRANSPARENT,KC_TRANSPARENT,KC_TRANSPARENT,KC_TRANSPARENT,KC_TRANSPARENT,TO(3),KC_F6,KC_F7,KC_F8,KC_F9,KC_F10,KC_F11,KC_PSCREEN,KC_NUMLOCK,KC_KP_7,KC_KP_8,KC_KP_9,KC_KP_PLUS,KC_F12,KC_SLCK,KC_KP_4,KC_KP_5,KC_KP_6,KC_KP_MINUS,KC_KP_ENTER,KC_TRANSPARENT,KC_TRANSPARENT,KC_KP_1,KC_KP_2,KC_KP_3,KC_KP_ASTERISK,KC_TRANSPARENT,KC_KP_0,KC_EQUAL,KC_KP_DOT,KC_KP_SLASH,KC_TRANSPARENT,KC_TRANSPARENT,KC_TRANSPARENT,KC_TRANSPARENT,KC_TRANSPARENT,KC_TRANSPARENT,KC_TRANSPARENT),

  [3] = KEYMAP(KC_HOME,KC_MS_BTN4,KC_MS_BTN3,KC_MS_BTN5,KC_MS_WH_UP,KC_MS_ACCEL0,TO(2),KC_END,KC_MS_BTN1,KC_MS_UP,KC_MS_BTN2,KC_MS_WH_DOWN,KC_MS_ACCEL1,KC_PGUP,KC_LCTL,KC_MS_LEFT,KC_MS_DOWN,KC_MS_RIGHT,KC_UP,KC_MS_ACCEL2,KC_LSHIFT,KC_MS_WH_LEFT,KC_MS_WH_RIGHT,KC_LEFT,KC_DOWN,KC_RIGHT,KC_PGDOWN,KC_SLCK,KC_APPLICATION,CTL_T(KC_NO),GUI_T(KC_NO),ALT_T(KC_NO),KC_MS_BTN4,KC_MS_BTN5,KC_MS_WH_UP,KC_TRANSPARENT,KC_TRANSPARENT,KC_MS_WH_DOWN,TO(4),KC_TRANSPARENT,KC_PSCREEN,KC_SLCK,KC_PAUSE,KC_MS_WH_LEFT,KC_MS_WH_RIGHT,KC_TRANSPARENT,KC_INSERT,KC_HOME,KC_UP,KC_END,KC_PGUP,KC_MS_WH_UP,KC_DELETE,KC_LEFT,KC_DOWN,KC_RIGHT,KC_PGDOWN,KC_MS_WH_DOWN,KC_TRANSPARENT,KC_LCBR,KC_RCBR,KC_LBRACKET,KC_RBRACKET,KC_TRANSPARENT,KC_TRANSPARENT,ALGR_T(KC_NO),RGUI_T(KC_NO),KC_TRANSPARENT,KC_TRANSPARENT,RCTL_T(KC_NO),KC_MS_BTN4,KC_MS_BTN5,KC_MS_WH_UP,KC_MS_WH_DOWN,KC_TRANSPARENT,KC_TRANSPARENT),

  [4] = KEYMAP(KC_MAIL,KC_CALCULATOR,KC_MEDIA_STOP,KC_MEDIA_EJECT,KC_WWW_REFRESH,KC_WWW_FAVORITES,TO(3),KC_MY_COMPUTER,KC_MEDIA_PREV_TRACK,KC_MEDIA_REWIND,KC_MEDIA_PLAY_PAUSE,KC_MEDIA_FAST_FORWARD,KC_MEDIA_NEXT_TRACK,KC_TRANSPARENT,KC_TRANSPARENT,KC_F20,KC_AUDIO_VOL_DOWN,KC_AUDIO_MUTE,KC_AUDIO_VOL_UP,KC_TRANSPARENT,KC_TRANSPARENT,KC_TRANSPARENT,KC_TRANSPARENT,KC_TRANSPARENT,KC_TRANSPARENT,KC_TRANSPARENT,KC_TRANSPARENT,KC_TRANSPARENT,KC_TRANSPARENT,KC_TRANSPARENT,KC_TRANSPARENT,KC_TRANSPARENT,KC_WWW_BACK,KC_WWW_FORWARD,KC_TRANSPARENT,KC_TRANSPARENT,KC_TRANSPARENT,KC_WWW_HOME,TO(5),RGB_0000FF,RGB_008000,RGB_FFA500,RGB_800080,RGB_FF0000,KC_SYSTEM_POWER,KC_TRANSPARENT,RGB_HUD,RGB_VAD,RGB_TOG,RGB_VAI,RGB_HUI,KC_SYSTEM_SLEEP,KC_B,RGB_SLD,KC_TRANSPARENT,RGB_MOD,KC_TRANSPARENT,KC_SYSTEM_WAKE,KC_PSCREEN,KC_O,KC_TRANSPARENT,KC_TRANSPARENT,KC_TRANSPARENT,KC_TRANSPARENT,KC_TRANSPARENT,KC_TRANSPARENT,KC_TRANSPARENT,KC_TRANSPARENT,KC_TRANSPARENT,KC_TRANSPARENT,KC_TRANSPARENT,KC_TRANSPARENT,KC_TRANSPARENT,KC_TRANSPARENT,KC_TRANSPARENT,KC_TRANSPARENT),

  [5] = KEYMAP(KC_TRANSPARENT,LCTL(LGUI(KC_F1)),LCTL(LGUI(KC_F2)),LCTL(LGUI(KC_F3)),LCTL(LGUI(KC_F4)),LCTL(LGUI(KC_F5)),TO(4),KC_TRANSPARENT,KC_TRANSPARENT,KC_TRANSPARENT,KC_TRANSPARENT,KC_TRANSPARENT,KC_TRANSPARENT,KC_TRANSPARENT,KC_TRANSPARENT,KC_TRANSPARENT,KC_TRANSPARENT,KC_TRANSPARENT,KC_TRANSPARENT,KC_TRANSPARENT,KC_TRANSPARENT,KC_TRANSPARENT,KC_TRANSPARENT,KC_TRANSPARENT,KC_TRANSPARENT,KC_TRANSPARENT,KC_TRANSPARENT,KC_TRANSPARENT,KC_TRANSPARENT,KC_TRANSPARENT,KC_TRANSPARENT,KC_TRANSPARENT,KC_TRANSPARENT,KC_TRANSPARENT,KC_TRANSPARENT,KC_TRANSPARENT,KC_TRANSPARENT,KC_TRANSPARENT,TO(6),LCTL(LGUI(KC_F6)),LCTL(LGUI(KC_F7)),LCTL(LGUI(KC_F8)),LCTL(LGUI(KC_F9)),LCTL(LGUI(KC_F10)),LCTL(LGUI(KC_F11)),KC_TRANSPARENT,KC_TRANSPARENT,KC_TRANSPARENT,KC_TRANSPARENT,KC_TRANSPARENT,KC_TRANSPARENT,LCTL(LGUI(KC_F12)),KC_TRANSPARENT,KC_TRANSPARENT,KC_TRANSPARENT,KC_TRANSPARENT,KC_TRANSPARENT,KC_TRANSPARENT,KC_TRANSPARENT,KC_TRANSPARENT,KC_TRANSPARENT,KC_TRANSPARENT,KC_TRANSPARENT,KC_TRANSPARENT,KC_TRANSPARENT,KC_TRANSPARENT,KC_TRANSPARENT,KC_TRANSPARENT,KC_TRANSPARENT,KC_TRANSPARENT,KC_TRANSPARENT,KC_TRANSPARENT,KC_TRANSPARENT,KC_TRANSPARENT,KC_TRANSPARENT,KC_TRANSPARENT),

  [6] = KEYMAP(KC_GRAVE,KC_TRANSPARENT,KC_TRANSPARENT,KC_TRANSPARENT,KC_TRANSPARENT,KC_TRANSPARENT,TO(5),KC_TAB,KC_TRANSPARENT,KC_TRANSPARENT,KC_TRANSPARENT,KC_TRANSPARENT,KC_TRANSPARENT,KC_Y,KC_LCTL,KC_TRANSPARENT,KC_TRANSPARENT,KC_TRANSPARENT,KC_TRANSPARENT,KC_TRANSPARENT,KC_LSHIFT,KC_TRANSPARENT,KC_TRANSPARENT,KC_TRANSPARENT,KC_TRANSPARENT,KC_TRANSPARENT,KC_H,KC_L,KC_O,KC_LCTL,KC_EQUAL,KC_LALT,KC_KP_MINUS,KC_KP_1,KC_KP_0,KC_SPACE,KC_KP_PLUS,KC_KP_ENTER,TO(7),KC_TRANSPARENT,KC_TRANSPARENT,KC_TRANSPARENT,KC_TRANSPARENT,KC_TRANSPARENT,KC_TRANSPARENT,KC_ESCAPE,KC_TRANSPARENT,KC_TRANSPARENT,KC_TRANSPARENT,KC_TRANSPARENT,KC_TRANSPARENT,KC_TRANSPARENT,KC_TRANSPARENT,KC_TRANSPARENT,KC_TRANSPARENT,KC_TRANSPARENT,KC_TRANSPARENT,KC_TRANSPARENT,KC_F11,KC_TRANSPARENT,KC_TRANSPARENT,KC_TRANSPARENT,KC_TRANSPARENT,KC_TRANSPARENT,KC_TRANSPARENT,KC_TRANSPARENT,KC_TRANSPARENT,KC_TRANSPARENT,KC_TRANSPARENT,KC_TRANSPARENT,KC_F1,KC_F2,KC_F7,KC_F8,KC_F5,KC_KP_ENTER),

  [7] = KEYMAP(KC_TRANSPARENT,KC_TRANSPARENT,KC_TRANSPARENT,KC_TRANSPARENT,KC_TRANSPARENT,KC_TRANSPARENT,TO(6),KC_TRANSPARENT,KC_TRANSPARENT,KC_TRANSPARENT,KC_TRANSPARENT,KC_TRANSPARENT,KC_TRANSPARENT,KC_TRANSPARENT,KC_TRANSPARENT,KC_TRANSPARENT,KC_TRANSPARENT,KC_TRANSPARENT,KC_TRANSPARENT,KC_TRANSPARENT,KC_TRANSPARENT,KC_TRANSPARENT,KC_TRANSPARENT,KC_TRANSPARENT,KC_TRANSPARENT,KC_TRANSPARENT,KC_TRANSPARENT,KC_TRANSPARENT,KC_TRANSPARENT,KC_TRANSPARENT,KC_TRANSPARENT,KC_TRANSPARENT,KC_TRANSPARENT,KC_TRANSPARENT,KC_TRANSPARENT,KC_TRANSPARENT,KC_TRANSPARENT,KC_TRANSPARENT,TO(0),KC_TRANSPARENT,KC_TRANSPARENT,KC_TRANSPARENT,KC_TRANSPARENT,KC_TRANSPARENT,KC_TRANSPARENT,KC_TRANSPARENT,KC_TRANSPARENT,KC_TRANSPARENT,KC_TRANSPARENT,KC_TRANSPARENT,KC_TRANSPARENT,KC_TRANSPARENT,KC_TRANSPARENT,KC_TRANSPARENT,KC_TRANSPARENT,KC_TRANSPARENT,KC_TRANSPARENT,KC_TRANSPARENT,KC_TRANSPARENT,KC_TRANSPARENT,KC_TRANSPARENT,KC_TRANSPARENT,KC_TRANSPARENT,KC_TRANSPARENT,KC_TRANSPARENT,KC_TRANSPARENT,KC_TRANSPARENT,KC_TRANSPARENT,KC_TRANSPARENT,KC_TRANSPARENT,KC_TRANSPARENT,KC_TRANSPARENT,KC_TRANSPARENT,KC_TRANSPARENT,KC_TRANSPARENT,KC_TRANSPARENT),

};

const uint16_t PROGMEM fn_actions[] = {
  [1] = ACTION_LAYER_TAP_TOGGLE(1)
};

// leaving this in place for compatibilty with old keymaps cloned and re-compiled.
const macro_t *action_get_macro(keyrecord_t *record, uint8_t id, uint8_t opt)
{
      switch(id) {
        case 0:
        if (record->event.pressed) {
          SEND_STRING (QMK_KEYBOARD "/" QMK_KEYMAP " @ " QMK_VERSION);
        }
        break;
      }
    return MACRO_NONE;
};

bool process_record_user(uint16_t keycode, keyrecord_t *record) {
  switch (keycode) {
    // dynamically generate these.
    case EPRM:
      if (record->event.pressed) {
        eeconfig_init();
      }
      return false;
      break;
    case VRSN:
      if (record->event.pressed) {
        SEND_STRING (QMK_KEYBOARD "/" QMK_KEYMAP " @ " QMK_VERSION);
      }
      return false;
      break;
    case RGB_SLD:
      if (record->event.pressed) {
        rgblight_mode(1);
      }
      return false;
      break;
    
    case RGB_0000FF:
      if (record->event.pressed) {
        #ifdef RGBLIGHT_ENABLE
          rgblight_enable();
          rgblight_mode(1);
          rgblight_setrgb(0x00,0x00,0xff);
        #endif
      }
      return false;
      break;
    
    case RGB_008000:
      if (record->event.pressed) {
        #ifdef RGBLIGHT_ENABLE
          rgblight_enable();
          rgblight_mode(1);
          rgblight_setrgb(0x00,0x80,0x00);
        #endif
      }
      return false;
      break;
    
    case RGB_FFA500:
      if (record->event.pressed) {
        #ifdef RGBLIGHT_ENABLE
          rgblight_enable();
          rgblight_mode(1);
          rgblight_setrgb(0xff,0xa5,0x00);
        #endif
      }
      return false;
      break;
    
    case RGB_800080:
      if (record->event.pressed) {
        #ifdef RGBLIGHT_ENABLE
          rgblight_enable();
          rgblight_mode(1);
          rgblight_setrgb(0x80,0x00,0x80);
        #endif
      }
      return false;
      break;
    
    case RGB_FF0000:
      if (record->event.pressed) {
        #ifdef RGBLIGHT_ENABLE
          rgblight_enable();
          rgblight_mode(1);
          rgblight_setrgb(0xff,0x00,0x00);
        #endif
      }
      return false;
      break;
    
  }
  return true;
}

void matrix_scan_user(void) {

    uint8_t layer = biton32(layer_state);

    ergodox_board_led_off();
    ergodox_right_led_1_off();
    ergodox_right_led_2_off();
    ergodox_right_led_3_off();
    switch (layer) {
        case 1:
            ergodox_right_led_1_on();
            break;
        case 2:
            ergodox_right_led_2_on();
            break;
        case 3:
            ergodox_right_led_3_on();
            break;
        case 4:
            ergodox_right_led_1_on();
            ergodox_right_led_2_on();
            break;
        case 5:
            ergodox_right_led_1_on();
            ergodox_right_led_3_on();
            break;
        case 6:
            ergodox_right_led_2_on();
            ergodox_right_led_3_on();
            break;
        case 7:
            ergodox_right_led_1_on();
            ergodox_right_led_2_on();
            ergodox_right_led_3_on();
            break;
        default:
            break;
    }

};
