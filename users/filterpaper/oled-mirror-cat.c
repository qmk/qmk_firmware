/* Copyright (C) 2021 @filterpaper
 *
 * This program is free software: you can redistribute it and/or modify
 * it under the terms of the GNU General Public License as published by
 * the Free Software Foundation, either version 2 of the License, or
 * (at your option) any later version.
 *
 * This program is distributed in the hope that it will be useful,
 * but WITHOUT ANY WARRANTY; without even the implied warranty of
 * MERCHANTABILITY or FITNESS FOR A PARTICULAR PURPOSE.  See the
 * GNU General Public License for more details.
 *
 * You should have received a copy of the GNU General Public License
 * along with this program.  If not, see <http://www.gnu.org/licenses/>.
 */

/* This includes bongo cat animation that is correctly mirrored
   for both sides of the OLED, but at the expense of storage.
   WPM feature must be disabled with WPM_ENABLE = no
   Code does not work correctly because keystrokes are not
   sent to the secondary controller without proper transport.
*/

// OLED information display and bongo cat
#ifdef OLED_DRIVER_ENABLE
// OLED setup
#define IDLE_FRAMES 5
#define IDLE_SPEED 30
#define TAP_FRAMES 2
#define TAP_SPEED 80
#define ANIM_FRAME_DURATION 200
#define ANIM_SIZE 512

bool typing = false;
bool animation_stopped = true;
uint32_t typing_timer = 0;
uint32_t anim_timer = 0;
uint32_t anim_sleep = 0; // redundant
uint8_t current_idle_frame = 0;
uint8_t current_tap_frame = 0;
static long int oled_timeout = 5000;

oled_rotation_t oled_init_user(oled_rotation_t rotation) {
	// if (!is_keyboard_master()) return OLED_ROTATION_270;
	if (is_keyboard_left()) return OLED_ROTATION_0;
	else return OLED_ROTATION_180;
}

// Render status OLED display information
static void render_status(void) { // Layout and layer indicator
	oled_write_P(PSTR("KEYS\n"), false);
	// Default layouts
	switch (biton32(default_layer_state)) {
	// Layer 1
	case 1:
		oled_write_P(PSTR("\nColmk"), false);
		break;
	// Layer 0
	default:
		oled_write_P(PSTR("\nQwert"), false);
		break;
	}
	oled_write_P(PSTR("\n\nLAYER\n"), false);
	// Shifted layers
	switch (get_highest_layer(layer_state)) {
	case 2:
		oled_write_P(PSTR("Sym"), false);
		break;
	case 3:
		oled_write_P(PSTR("Num"), false);
		break;
	case 4:
		oled_write_P(PSTR("Nav"), false);
		break;
	default:
		oled_write_P(PSTR("   "), false);
		break;
	}
}

// Render cat OLED display animation
static void render_anim(void) {
	// Idle animation
	static const char PROGMEM Lidle[IDLE_FRAMES][ANIM_SIZE] = { // Left
		{
			128,128,128,0,0,0,0,0,0,0,0,0,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0,
			0,0,0,1,1,1,1,2,2,2,2,4,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0,
			0,0,0,0,0,0,0,0,0,0,0,0,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0,
			0,0,0,0,0,0,0,0,0,0,0,0,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0,
		},
		{
			128,128,128,0,0,0,0,0,0,0,0,0,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0,
			0,0,0,1,1,1,1,2,2,2,2,4,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0,
			0,0,0,0,0,0,0,0,0,0,0,0,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0,
			0,0,0,0,0,0,0,0,0,0,0,0,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0,
		},
		{
			128,128,128,0,0,0,0,0,0,0,0,0,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0,
			0,0,0,1,1,1,1,2,2,2,2,4,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0,
			0,0,0,0,0,0,0,0,0,0,0,0,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0,
			0,0,0,0,0,0,0,0,0,0,0,0,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0,
		},
		{
			128,128,128,0,0,0,0,0,0,0,0,0,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0,
			0,0,0,1,1,1,1,2,2,2,2,4,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0,
			0,0,0,0,0,0,0,0,0,0,0,0,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0,
			0,0,0,0,0,0,0,0,0,0,0,0,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0,
		},
		{
			128,128,128,0,0,0,0,0,0,0,0,0,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0,
			0,0,0,1,1,1,1,2,2,2,2,4,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0,
			0,0,0,0,0,0,0,0,0,0,0,0,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0,
			0,0,0,0,0,0,0,0,0,0,0,0,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0,
		}
	};
	static const char PROGMEM idle[IDLE_FRAMES][ANIM_SIZE] = { // Right
		{
			0,0,0,0,0,0,0,0,0,0,0,0,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64,
			64,64,32,32,32,32,16,16,16,16,8,8,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7,
			0,0,0,0,0,0,0,0,0,0,0,0,0,0,0,0,0,0,0,0,0,0,0,0,0,0,0,0,0,0,0,0,0,0,0,0,0,0,0,0,0,0,0,0,0,0,0,0,0,0,0,0,0,0,0,0,0,0,0,0,0
		},
		{
			0,0,0,0,0,0,0,0,0,0,0,0,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64,
			64,64,32,32,32,32,16,16,16,16,8,8,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8,
			7,0,0,0,0,0,0,0,0,0,0,0,0,0,0,0,0,0,0,0,0,0,0,0,0,0,0,0,0,0,0,0,0,0,0,0,0,0,0,0,0,0,0,0,0,0,0,0,0,0,0,0,0,0,0,0,0,0,0,0,0,0
		},
		{
			0,0,0,0,0,0,0,0,0,0,0,0,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32,
			32,32,32,16,16,16,16,8,8,8,8,8,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0,
			0,0,0,0,0,0,0,0,0,0,0,0,0,0,0,0,0,0,0,0,0,0,0,0,0,0,0,0,0,0,0,0,0,0,0,0,0,0,0,0,0,0,0,0,0,0,0,0,0,0,0,0,0,0,0,0,0,0
		},
		{
			0,0,0,0,0,0,0,0,0,0,0,0,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64,
			64,64,32,32,32,32,16,16,16,16,8,8,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8,
			7,0,0,0,0,0,0,0,0,0,0,0,0,0,0,0,0,0,0,0,0,0,0,0,0,0,0,0,0,0,0,0,0,0,0,0,0,0,0,0,0,0,0,0,0,0,0,0,0,0,0,0,0,0,0,0,0,0,0,0,0,0
		},
		{
			0,0,0,0,0,0,0,0,0,0,0,0,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64,
			32,32,32,32,16,16,16,16,8,8,8,8,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0,
			0,0,0,0,0,0,0,0,0,0,0,0,0,0,0,0,0,0,0,0,0,0,0,0,0,0,0,0,0,0,0,0,0,0,0,0,0,0,0,0,0,0,0,0,0,0,0,0,0,0,0,0,0,0,0,0,0,0,0
		}
	};

	// Prep animation
	static const char PROGMEM Lprep[][ANIM_SIZE] = { // Left
		{
			128,128,128,0,0,0,0,0,0,0,0,0,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0,
			0,0,0,1,1,1,1,2,2,2,2,4,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0,
			0,0,0,0,0,0,0,0,0,0,0,0,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0,
			0,0,0,0,0,0,0,0,0,0,0,0,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0,
		}
	};
	static const char PROGMEM prep[][ANIM_SIZE] = { // Right
		{
			0,0,0,0,0,0,0,0,0,0,0,0,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128,
			0,0,0,0,0,0,0,0,0,0,0,0,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0,
			0,0,0,0,0,0,0,0,0,0,0,0,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0,
			0,0,0,0,0,0,0,0,0,0,0,0,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0,
		}
	};

	// Typing animation
	static const char PROGMEM Ltap[TAP_FRAMES][ANIM_SIZE] = { // Left
		{
			128,128,128,0,0,0,0,0,0,0,0,0,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0,
			0,0,0,1,1,1,1,2,2,2,2,4,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0,
			0,0,0,0,0,0,0,0,0,0,0,0,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0,
			0,0,0,0,0,0,0,0,0,0,0,0,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0,
		},
		{
			128,128,128,0,0,0,0,0,0,0,0,0,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0,
			0,0,0,1,1,1,1,2,2,2,2,4,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0,
			0,0,0,0,0,0,0,0,0,0,0,0,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0,
			0,0,0,0,0,0,0,0,0,0,0,0,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0,
		}
	};
	static const char PROGMEM tap[TAP_FRAMES][ANIM_SIZE] = { // Right
		{
			0,0,0,0,0,0,0,0,0,0,0,0,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128,
			0,0,0,0,0,0,0,0,0,0,0,0,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0,
			0,0,0,0,0,0,0,0,0,0,0,0,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0,
			0,0,0,0,0,0,0,0,0,0,0,0,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0,
		},
		{
			0,0,0,0,0,0,0,0,0,0,0,0,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128,
			0,0,0,0,0,0,0,0,0,0,0,0,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0,
			0,0,0,0,0,0,0,0,0,0,0,0,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0,
			0,0,0,0,0,0,0,0,0,0,0,0,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0,
		}
	};

	void animation_phase(void) {
		if (!typing) {
			current_idle_frame = (current_idle_frame + 1) % IDLE_FRAMES;
			if (is_keyboard_left()) oled_write_raw_P(Lidle[abs((IDLE_FRAMES - 1) - current_idle_frame)], ANIM_SIZE);
			else oled_write_raw_P(idle[abs((IDLE_FRAMES - 1) - current_idle_frame)], ANIM_SIZE);
		} else if (typing && animation_stopped) {
			if (is_keyboard_left()) oled_write_raw_P(Lprep[0], ANIM_SIZE);
			else oled_write_raw_P(prep[0], ANIM_SIZE);
			animation_stopped = false;
		} else if (typing && !animation_stopped) {
			current_tap_frame = (current_tap_frame + 1) % TAP_FRAMES;
			if (is_keyboard_left()) oled_write_raw_P(Ltap[abs((TAP_FRAMES - 1) - current_tap_frame)], ANIM_SIZE);
			else oled_write_raw_P(tap[abs((TAP_FRAMES - 1) - current_tap_frame)], ANIM_SIZE);
		}
	}

    if (typing) {
        oled_on();
        if (timer_elapsed32(anim_timer) > ANIM_FRAME_DURATION) {
            anim_timer = timer_read32();
            animation_phase();
        }
        anim_sleep = timer_read32();
    } else {
        if (timer_elapsed32(anim_sleep) > oled_timeout) oled_off();
        else {
            if (timer_elapsed32(anim_timer) > ANIM_FRAME_DURATION) {
                anim_timer = timer_read32();
                animation_phase();
            }
        }
    }

    if (timer_elapsed32(typing_timer) > 300) {
    	typing = false;
    	animation_stopped = true;
    }
}

// OLED display rendering
void oled_task_user(void) {
	if (!is_keyboard_master()) render_status();
	else render_anim();
}

void suspend_power_down_user(void) { oled_off(); }
#endif // OLED_DRIVER_ENABLE

bool process_record_user(uint16_t keycode, keyrecord_t *record) {

	// Set typing flag to start animation
	#ifdef OLED_DRIVER_ENABLE
	if (record->event.pressed) {
		typing = true;
		typing_timer = timer_read32();
	}
	#endif

	return true;
}
