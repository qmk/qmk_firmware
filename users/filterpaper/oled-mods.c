// OLED mod display and bongo cat
#ifdef OLED_DRIVER_ENABLE
// Animation frame defaults
#define IDLE_FRAMES 5
#define IDLE_SPEED 10
#define TAP_FRAMES 2
#define TAP_SPEED 50
#define ANIM_FRAME_DURATION 200
#define ANIM_SIZE 512

char wpm_str[10];
uint8_t prev_wpm = 0;
uint32_t anim_timer = 0;
uint32_t anim_sleep = 0;
uint8_t current_idle_frame = 0;
uint8_t current_tap_frame = 0;
static long int oled_timeout = 5000;

// Orientate OLED display
oled_rotation_t oled_init_user(oled_rotation_t rotation) {
	if (is_keyboard_master()) return OLED_ROTATION_270;
	else if (is_keyboard_left()) return OLED_ROTATION_0;
	else return OLED_ROTATION_180;
}

void render_space(void) {
	oled_write_P(PSTR("     "), false);
}

void render_mod_status_gui_alt(uint8_t modifiers) {
	static const char PROGMEM gui_off_1[] = {0x85, 0x86, 0};
	static const char PROGMEM gui_off_2[] = {0xa5, 0xa6, 0};
	static const char PROGMEM gui_on_1[] = {0x8d, 0x8e, 0};
	static const char PROGMEM gui_on_2[] = {0xad, 0xae, 0};

	static const char PROGMEM alt_off_1[] = {0x87, 0x88, 0};
	static const char PROGMEM alt_off_2[] = {0xa7, 0xa8, 0};
	static const char PROGMEM alt_on_1[] = {0x8f, 0x90, 0};
	static const char PROGMEM alt_on_2[] = {0xaf, 0xb0, 0};

	// fillers between the modifier icons bleed into the icon frames
	static const char PROGMEM off_off_1[] = {0xc5, 0};
	static const char PROGMEM off_off_2[] = {0xc6, 0};
	static const char PROGMEM on_off_1[] = {0xc7, 0};
	static const char PROGMEM on_off_2[] = {0xc8, 0};
	static const char PROGMEM off_on_1[] = {0xc9, 0};
	static const char PROGMEM off_on_2[] = {0xca, 0};
	static const char PROGMEM on_on_1[] = {0xcb, 0};
	static const char PROGMEM on_on_2[] = {0xcc, 0};

	if(modifiers & MOD_MASK_GUI) {
		oled_write_P(gui_on_1, false);
	} else {
		oled_write_P(gui_off_1, false);
	}

	if ((modifiers & MOD_MASK_GUI) && (modifiers & MOD_MASK_ALT)) {
		oled_write_P(on_on_1, false);
	} else if(modifiers & MOD_MASK_GUI) {
		oled_write_P(on_off_1, false);
	} else if(modifiers & MOD_MASK_ALT) {
		oled_write_P(off_on_1, false);
	} else {
		oled_write_P(off_off_1, false);
	}

	if(modifiers & MOD_MASK_ALT) {
		oled_write_P(alt_on_1, false);
	} else {
		oled_write_P(alt_off_1, false);
	}

	if(modifiers & MOD_MASK_GUI) {
		oled_write_P(gui_on_2, false);
	} else {
		oled_write_P(gui_off_2, false);
	}

	if (modifiers & MOD_MASK_GUI & MOD_MASK_ALT) {
		oled_write_P(on_on_2, false);
	} else if(modifiers & MOD_MASK_GUI) {
		oled_write_P(on_off_2, false);
	} else if(modifiers & MOD_MASK_ALT) {
		oled_write_P(off_on_2, false);
	} else {
		oled_write_P(off_off_2, false);
	}

	if(modifiers & MOD_MASK_ALT) {
		oled_write_P(alt_on_2, false);
	} else {
		oled_write_P(alt_off_2, false);
	}
}

void render_mod_status_ctrl_shift(uint8_t modifiers) {
	static const char PROGMEM ctrl_off_1[] = {0x89, 0x8a, 0};
	static const char PROGMEM ctrl_off_2[] = {0xa9, 0xaa, 0};
	static const char PROGMEM ctrl_on_1[] = {0x91, 0x92, 0};
	static const char PROGMEM ctrl_on_2[] = {0xb1, 0xb2, 0};

	static const char PROGMEM shift_off_1[] = {0x8b, 0x8c, 0};
	static const char PROGMEM shift_off_2[] = {0xab, 0xac, 0};
	static const char PROGMEM shift_on_1[] = {0xcd, 0xce, 0};
	static const char PROGMEM shift_on_2[] = {0xcf, 0xd0, 0};

	// fillers between the modifier icons bleed into the icon frames
	static const char PROGMEM off_off_1[] = {0xc5, 0};
	static const char PROGMEM off_off_2[] = {0xc6, 0};
	static const char PROGMEM on_off_1[] = {0xc7, 0};
	static const char PROGMEM on_off_2[] = {0xc8, 0};
	static const char PROGMEM off_on_1[] = {0xc9, 0};
	static const char PROGMEM off_on_2[] = {0xca, 0};
	static const char PROGMEM on_on_1[] = {0xcb, 0};
	static const char PROGMEM on_on_2[] = {0xcc, 0};

	if(modifiers & MOD_MASK_CTRL) {
		oled_write_P(ctrl_on_1, false);
	} else {
		oled_write_P(ctrl_off_1, false);
	}

	if ((modifiers & MOD_MASK_CTRL) && (modifiers & MOD_MASK_SHIFT)) {
		oled_write_P(on_on_1, false);
	} else if(modifiers & MOD_MASK_CTRL) {
		oled_write_P(on_off_1, false);
	} else if(modifiers & MOD_MASK_SHIFT) {
		oled_write_P(off_on_1, false);
	} else {
		oled_write_P(off_off_1, false);
	}

	if(modifiers & MOD_MASK_SHIFT) {
		oled_write_P(shift_on_1, false);
	} else {
		oled_write_P(shift_off_1, false);
	}

	if(modifiers & MOD_MASK_CTRL) {
		oled_write_P(ctrl_on_2, false);
	} else {
		oled_write_P(ctrl_off_2, false);
	}

	if (modifiers & MOD_MASK_CTRL & MOD_MASK_SHIFT) {
		oled_write_P(on_on_2, false);
	} else if(modifiers & MOD_MASK_CTRL) {
		oled_write_P(on_off_2, false);
	} else if(modifiers & MOD_MASK_SHIFT) {
		oled_write_P(off_on_2, false);
	} else {
		oled_write_P(off_off_2, false);
	}

	if(modifiers & MOD_MASK_SHIFT) {
		oled_write_P(shift_on_2, false);
	} else {
		oled_write_P(shift_off_2, false);
	}
}

void render_logo(void) {
	static const char PROGMEM corne_logo[] = {
		0x80, 0x81, 0x82, 0x83, 0x84,
		0xa0, 0xa1, 0xa2, 0xa3, 0xa4,
		0xc0, 0xc1, 0xc2, 0xc3, 0xc4, 0};
	oled_write_P(corne_logo, false);
	oled_write_P(PSTR("corne"), false);
}

void render_layer_state(void) {
	static const char PROGMEM default_layer[] = {
		0x20, 0x94, 0x95, 0x96, 0x20,
		0x20, 0xb4, 0xb5, 0xb6, 0x20,
		0x20, 0xd4, 0xd5, 0xd6, 0x20, 0};
	static const char PROGMEM raise_layer[] = {
		0x20, 0x97, 0x98, 0x99, 0x20,
		0x20, 0xb7, 0xb8, 0xb9, 0x20,
		0x20, 0xd7, 0xd8, 0xd9, 0x20, 0};
	static const char PROGMEM lower_layer[] = {
		0x20, 0x9a, 0x9b, 0x9c, 0x20,
		0x20, 0xba, 0xbb, 0xbc, 0x20,
		0x20, 0xda, 0xdb, 0xdc, 0x20, 0};
	static const char PROGMEM adjust_layer[] = {
		0x20, 0x9d, 0x9e, 0x9f, 0x20,
		0x20, 0xbd, 0xbe, 0xbf, 0x20,
		0x20, 0xdd, 0xde, 0xdf, 0x20, 0};
	if(layer_state_is(_ADJUST)) {
		oled_write_P(adjust_layer, false);
	} else if(layer_state_is(_LOWER)) {
		oled_write_P(lower_layer, false);
	} else if(layer_state_is(_RAISE)) {
		oled_write_P(raise_layer, false);
	} else {
		oled_write_P(default_layer, false);
	}
}

// Render information OLED display
static void render_status(void) {
	render_logo();
	render_space();
	// render_layer_state();
	render_space();
	render_mod_status_gui_alt(get_mods()|get_oneshot_mods());
	render_mod_status_ctrl_shift(get_mods()|get_oneshot_mods());
}

// Render bongo cat OLED animation
static void render_anim(void) {
	// Idle animation
	static const char PROGMEM idle[IDLE_FRAMES][ANIM_SIZE] = {
		{
			0,0,0,0,0,0,0,0,0,0,0,0,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64,
			64,64,32,32,32,32,16,16,16,16,8,8,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7,
			0,0,0,0,0,0,0,0,0,0,0,0,0,0,0,0,0,0,0,0,0,0,0,0,0,0,0,0,0,0,0,0,0,0,0,0,0,0,0,0,0,0,0,0,0,0,0,0,0,0,0,0,0,0,0,0,0,0,0,0,0
		},
		{
			0,0,0,0,0,0,0,0,0,0,0,0,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64,
			64,64,32,32,32,32,16,16,16,16,8,8,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8,
			7,0,0,0,0,0,0,0,0,0,0,0,0,0,0,0,0,0,0,0,0,0,0,0,0,0,0,0,0,0,0,0,0,0,0,0,0,0,0,0,0,0,0,0,0,0,0,0,0,0,0,0,0,0,0,0,0,0,0,0,0,0
		},
		{
			0,0,0,0,0,0,0,0,0,0,0,0,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32,
			32,32,32,16,16,16,16,8,8,8,8,8,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0,
			0,0,0,0,0,0,0,0,0,0,0,0,0,0,0,0,0,0,0,0,0,0,0,0,0,0,0,0,0,0,0,0,0,0,0,0,0,0,0,0,0,0,0,0,0,0,0,0,0,0,0,0,0,0,0,0,0,0
		},
		{
			0,0,0,0,0,0,0,0,0,0,0,0,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64,
			64,64,32,32,32,32,16,16,16,16,8,8,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8,
			7,0,0,0,0,0,0,0,0,0,0,0,0,0,0,0,0,0,0,0,0,0,0,0,0,0,0,0,0,0,0,0,0,0,0,0,0,0,0,0,0,0,0,0,0,0,0,0,0,0,0,0,0,0,0,0,0,0,0,0,0,0
		},
		{
			0,0,0,0,0,0,0,0,0,0,0,0,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64,
			32,32,32,32,16,16,16,16,8,8,8,8,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0,
			0,0,0,0,0,0,0,0,0,0,0,0,0,0,0,0,0,0,0,0,0,0,0,0,0,0,0,0,0,0,0,0,0,0,0,0,0,0,0,0,0,0,0,0,0,0,0,0,0,0,0,0,0,0,0,0,0,0,0
		}
	};
	// Prep animation
	static const char PROGMEM prep[][ANIM_SIZE] = {
		{
			0,0,0,0,0,0,0,0,0,0,0,0,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64,
			64,64,32,32,32,32,16,16,16,16,8,8,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0,
			0,0,0,0,0,0,0,0,0,0,0,0,0,0,0,0,0,0,0,0,0,0,0,0,0,0,0,0,0,0,0,0,0,0,0,0,0,0,0,0,0,0,0,0,0,0,0,0,0,0,0,0,0,0,0,0,0,0,0,0,0,0
		}
	};
	// Typing animation
	static const char PROGMEM tap[TAP_FRAMES][ANIM_SIZE] = {
		{
			0,0,0,0,0,0,0,0,0,0,0,0,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159,
			95,95,79,76,32,32,32,32,16,16,16,16,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1,
			1,1,1,0,0,0,0,0,0,0,0,0,0,0,0,0,0,0,0,0,0,0,0,0,0,0,0,0,0,0,0,0,0,0,0,0,0,0,0,1,3,3,0,0,0,0,0,0,0,0,0,0,0,0,0,0,0,0,0,0,0,0,0,0,0,0,0,0,0,0,0,0,0,0
		},
		{
			0,0,0,0,0,0,0,0,0,0,0,0,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32,
			32,32,32,16,16,16,16,8,8,8,8,8,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128,
			0,0,0,0,0,0,0,0,0,0,0,0,0,0,0,0,0,0,0,0,0,0,0,0,0,0,0,0,0,0,0,0,0,0,0,0,0,0,0,0,0,0,0,0,0,0,0,0,0,0,0,0,0,0,0,0,0,0,0,0
		}
	};

	void animation_phase(void) {
		if (get_current_wpm() <=IDLE_SPEED) {
			current_idle_frame = (current_idle_frame + 1) % IDLE_FRAMES;
			oled_write_raw_P(idle[abs((IDLE_FRAMES-1)-current_idle_frame)], ANIM_SIZE);
		}

		if (get_current_wpm() >IDLE_SPEED && (get_current_wpm() <TAP_SPEED || get_current_wpm() <prev_wpm)) {
			oled_write_raw_P(prep[0], ANIM_SIZE);
			prev_wpm = get_current_wpm()+1;
		}

		if (get_current_wpm() >=TAP_SPEED && get_current_wpm() >=prev_wpm) {
			current_tap_frame = (current_tap_frame + 1) % TAP_FRAMES;
			oled_write_raw_P(tap[abs((TAP_FRAMES-1)-current_tap_frame)], ANIM_SIZE);
			prev_wpm = get_current_wpm();
		}
	}

	// Turn off OLED on idle
	if (get_current_wpm() != 000) {
		oled_on();
		if (timer_elapsed32(anim_timer) > ANIM_FRAME_DURATION) {
			anim_timer = timer_read32();
			animation_phase();
		}
		anim_sleep = timer_read32();
	} else {
		if (timer_elapsed32(anim_sleep) > oled_timeout) oled_off();
		else {
			if (timer_elapsed32(anim_timer) > ANIM_FRAME_DURATION) {
				anim_timer = timer_read32();
				animation_phase();
			}
		}
	}
}

// OLED display rendering
void oled_task_user(void) {
	if (is_keyboard_master()) render_status(); // USB side
	else render_anim(); // Secondary side
}

void suspend_power_down_user(void) { oled_off(); }
#endif // OLED_DRIVER_ENABLE

